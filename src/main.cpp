#include <Arduino.h>
#include <JPEGDEC.h>
#include <LittleFS.h>
#include <Preferences.h>
#include <SD.h>
#include <SPI.h>
#include <TFT_eSPI.h>
#include <XPT2046_Touchscreen.h>
#include <nvs_flash.h>
#include <esp_system.h>

#include "tokens_generated.h"
#include "precons_generated.h"
#include "table_state.h"

// The token art is generated by tools/fetch_tokens.py and kept out of version control; without it
// (and without the art on a microSD card) the card shows a plain color where the art goes.
// CYD_NO_EMBEDDED_ART (env:shots) leaves it out so README screenshots carry no official artwork.
#if __has_include("token_art_generated.h") && !defined(CYD_NO_EMBEDDED_ART)
#include "token_art_generated.h"
#define HAS_TOKEN_ART 1
static_assert(ART_CATALOG_ID == CATALOG_ID, "token art is stale: rerun tools/fetch_tokens.py");
#else
#define HAS_TOKEN_ART 0
#endif

namespace {

// On the CYD the touch controller has its own SPI bus, separate from the display.
constexpr uint8_t TOUCH_CS_PIN = 33;
constexpr uint8_t TOUCH_IRQ_PIN = 36;
constexpr uint8_t TOUCH_SCLK_PIN = 25;
constexpr uint8_t TOUCH_MISO_PIN = 39;
constexpr uint8_t TOUCH_MOSI_PIN = 32;
// The microSD slot has pins of its own, but the touch controller's SPI peripheral is the only one left,
// so the bus switches over to the card's pins for each read.
constexpr uint8_t SD_CS_PIN = 5;
constexpr uint8_t SD_SCLK_PIN = 18;
constexpr uint8_t SD_MISO_PIN = 19;
constexpr uint8_t SD_MOSI_PIN = 23;
constexpr uint32_t SD_FREQUENCY = 20000000;
constexpr const char *SD_ART_DIR = "/mtgart";
constexpr int TOUCH_X_MIN = 300;
constexpr int TOUCH_X_MAX = 3800;
constexpr int TOUCH_Y_MIN = 300;
constexpr int TOUCH_Y_MAX = 3800;
constexpr int SCREEN_W = 240;
constexpr int SCREEN_H = 320;

constexpr uint16_t BACKGROUND = 0x10A2;
constexpr uint16_t PANEL = 0x2124;
constexpr uint16_t INK = 0xFFFF;
constexpr uint16_t PARCHMENT = 0xEF5D;  // Light ink on the art and the overlay controls.
constexpr uint16_t PLATE_BASE = 0xDED8;  // Fill of the title, type line, text and P/T boxes.
constexpr uint16_t CARD_INK = 0x10A2;
constexpr uint16_t HIGHLIGHT = 0xFFE0;
constexpr uint16_t PANEL_SELECTED = 0x322B;
constexpr uint16_t HINT = 0x8410;
constexpr uint32_t SAVE_DELAY_MS = 1500;

// The backlight runs from LEDC so its brightness can be changed. TFT_eSPI must not touch this pin,
// so TFT_BL is not defined in platformio.ini.
constexpr uint8_t BACKLIGHT_PIN = 21;
constexpr uint32_t BACKLIGHT_FREQ_HZ = 5000;
constexpr uint8_t BACKLIGHT_BITS = 8;
constexpr uint8_t BRIGHTNESS_LEVELS = 10;
// PWM duty per level, spaced so the steps look even. The lowest level stays readable.
const uint8_t BRIGHTNESS_DUTY[BRIGHTNESS_LEVELS] = {16, 28, 44, 62, 84, 110, 140, 176, 214, 255};

// Seconds without a touch before the screen turns off; 0 means never.
const uint16_t TIMEOUT_SECONDS[] = {15, 30, 60, 120, 300, 600, 0};
const char *const TIMEOUT_LABELS[] = {"15 sec", "30 sec", "1 min", "2 min", "5 min", "10 min", "Never"};
constexpr uint8_t TIMEOUT_COUNT = sizeof(TIMEOUT_SECONDS) / sizeof(TIMEOUT_SECONDS[0]);
constexpr uint32_t OVERLAY_HIDE_MS = 4000;
constexpr uint32_t TOUCH_REPEAT_MS = 220;
constexpr uint32_t POSITION_SHOW_MS = 2000;  // How long "12/76" stays up after changing token.
constexpr uint32_t COUNT_SHOW_MS = 2000;     // How long a quantity of 0 or 1 stays up after changing it.

// Classic keeps the card above a button bar. Overlay and CardOnly fill the screen with the card and
// float the controls over its art; CardOnly hides them again a few seconds after the last touch.
enum class Layout : uint8_t { Classic, Overlay, CardOnly };
constexpr uint8_t LAYOUT_COUNT = 3;
const char *const LAYOUT_LABELS[LAYOUT_COUNT] = {"CLASSIC", "OVERLAY", "CARD ONLY"};

// The TN panel washes light colors out when seen from an angle, as when the board lies on a table:
// whites blow out and the art turns pale. Each tone level darkens the card a little more: a gamma
// curve pulls the midtones down and a gain below 1 lowers the white point. It applies to the art, the
// frame and the plates of the card, but not to the rest of the interface. Level 0 leaves it all as is.
constexpr uint8_t TONE_LEVELS = 6;
constexpr float TONE_GAMMA_STEP = 0.2f;
constexpr float TONE_GAIN_STEP = 0.04f;

struct Config {
  uint8_t brightness;  // 1..BRIGHTNESS_LEVELS
  uint8_t timeout;     // Index into TIMEOUT_SECONDS.
  uint8_t layout;      // A Layout value.
  uint8_t tone;        // 0..TONE_LEVELS - 1
  uint8_t flipped;     // 1 turns the whole screen upside down.
  uint8_t gammaMode;   // Index into GAMMA_PROFILES.
  uint8_t drawArea;    // A DrawArea value: where doodles show and can be drawn.
  uint8_t drawOpen;    // A DrawOpen value: how drawing mode opens from the card.
  uint8_t drawStore;   // A DrawStore value: where SAVE keeps doodles.
};
enum class DrawArea : uint8_t { Art, Card };
enum class DrawOpen : uint8_t { Button, Hold, Both };
enum class DrawStore : uint8_t { Ram, Flash, Sd };
constexpr uint8_t DRAW_OPTION_COUNT = 3;
// Earlier firmware saved fewer fields; the others then keep their defaults.
constexpr size_t CONFIG_V1_SIZE = offsetof(Config, tone);
constexpr size_t CONFIG_V2_SIZE = offsetof(Config, gammaMode);
constexpr size_t CONFIG_V3_SIZE = offsetof(Config, drawArea);
constexpr Config DEFAULT_CONFIG = {BRIGHTNESS_LEVELS, TIMEOUT_COUNT - 1, static_cast<uint8_t>(Layout::Classic), 0, 0, 0,
                                   static_cast<uint8_t>(DrawArea::Card), static_cast<uint8_t>(DrawOpen::Both),
                                   static_cast<uint8_t>(DrawStore::Flash)};

// This board's panel needs its colors inverted, and right after the controller's own init its gamma is
// off: the image looks washed out and the lights blow out. Selecting another gamma curve and then the
// usual one again, once the display is on, corrects it (TFT_eSPI issue 2985). The profiles are what that
// step programs; the settings can switch between them for a panel that still looks wrong.
constexpr uint8_t REG_GAMMASET = 0x26;
constexpr uint8_t REG_DFUNCTR = 0xB6;
constexpr uint8_t REG_GAMMA_POS = 0xE0;
constexpr uint8_t REG_GAMMA_NEG = 0xE1;
constexpr uint8_t GAMMA_CURVE = 0x01;        // The curve the controller's init selects.
constexpr uint8_t GAMMA_CURVE_OTHER = 0x02;  // Any other curve will do to reselect the first.
constexpr uint32_t GAMMA_SETTLE_MS = 120;

// The gamma tables of the controller's init, and the ones TFT_eSPI gives ST7789 panels.
const uint8_t GAMMA_VENDOR_POS[] = {0x0F, 0x2A, 0x28, 0x08, 0x0E, 0x08, 0x54, 0xA9, 0x43, 0x0A, 0x0F, 0x00, 0x00, 0x00, 0x00};
const uint8_t GAMMA_VENDOR_NEG[] = {0x00, 0x15, 0x17, 0x07, 0x11, 0x06, 0x2B, 0x56, 0x3C, 0x05, 0x10, 0x0F, 0x3F, 0x3F, 0x0F};
const uint8_t GAMMA_ST7789_POS[] = {0xD0, 0x00, 0x02, 0x07, 0x0A, 0x28, 0x32, 0x44, 0x42, 0x06, 0x0E, 0x12, 0x14, 0x17};
const uint8_t GAMMA_ST7789_NEG[] = {0xD0, 0x00, 0x02, 0x07, 0x0A, 0x28, 0x31, 0x54, 0x47, 0x0E, 0x1C, 0x17, 0x1B, 0x1E};

struct GammaProfile {
  const char *label;
  const uint8_t *positive;  // Tables for the two polarities the panel is driven with.
  const uint8_t *negative;
  uint8_t length;
  bool normallyBlack;  // Tells the controller the glass is normally black, instead of inverting the image.
};

const GammaProfile GAMMA_PROFILES[] = {
    {"RECOMMENDED", GAMMA_VENDOR_POS, GAMMA_VENDOR_NEG, sizeof(GAMMA_VENDOR_POS), false},
    {"NO INVERSION", GAMMA_VENDOR_POS, GAMMA_VENDOR_NEG, sizeof(GAMMA_VENDOR_POS), true},
    {"ST7789 GAMMA", GAMMA_ST7789_POS, GAMMA_ST7789_NEG, sizeof(GAMMA_ST7789_POS), false},
};
constexpr uint8_t GAMMA_COUNT = sizeof(GAMMA_PROFILES) / sizeof(GAMMA_PROFILES[0]);

struct ColorStyle {
  uint16_t frame;
  uint16_t pip;
  uint16_t pipInk;
};

// Indexed by Color. The white frame is a cream rather than the lightest color the panel can show, which
// is what turns a white card into one flat glare.
const ColorStyle COLOR_STYLES[] = {
    {0xDE53, 0xF77B, CARD_INK},
    {0x12D9, 0x0B55, INK},
    {0x2945, 0x1040, INK},
    {0xD164, 0xD105, INK},
    {0x1C07, 0x0387, INK},
    {0xCCA6, 0xE5EA, CARD_INK},
    {0xA515, 0xCE17, CARD_INK},
};
const char *const COLOR_NAMES[] = {"White", "Blue", "Black", "Red", "Green", "Multicolor", "Colorless"};
constexpr int COLOR_COUNT = sizeof(COLOR_NAMES) / sizeof(COLOR_NAMES[0]);

// Mana glyphs, indexed by Color; '#' is drawn in the pip ink. Multicolor has none: drawManaSymbol
// paints the five colors around the wheel instead.
constexpr int GLYPH_SIZE = 11;
const char *const GLYPHS[COLOR_COUNT][GLYPH_SIZE] = {
    {
        // White: sun
        ".....#.....",
        ".#...#...#.",
        "..#.....#..",
        "....###....",
        "...#####...",
        "##.#####.##",
        "...#####...",
        "....###....",
        "..#.....#..",
        ".#...#...#.",
        ".....#.....",
    },
    {
        // Blue: drop
        ".....#.....",
        "....###....",
        "....###....",
        "...#####...",
        "...#####...",
        "..#######..",
        "..#######..",
        ".#########.",
        ".#########.",
        "..#######..",
        "...#####...",
    },
    {
        // Black: skull
        "...#####...",
        "..#######..",
        ".#########.",
        ".#########.",
        ".##..#..##.",
        ".##..#..##.",
        ".#########.",
        "..###.###..",
        "...#####...",
        "...#.#.#...",
        "...........",
    },
    {
        // Red: flame
        "....#......",
        "....##.....",
        "...###.....",
        "...####..#.",
        "..#####..#.",
        "..######.##",
        ".#########.",
        ".#########.",
        ".#########.",
        "..#######..",
        "...#####...",
    },
    {
        // Green: tree
        "...##.##...",
        "..#######..",
        ".#########.",
        "###########",
        ".#########.",
        "###########",
        ".#########.",
        "..#######..",
        ".....#.....",
        "....###....",
        "...#####...",
    },
    {},  // Multicolor
    {
        // Colorless: diamond
        ".....#.....",
        "....###....",
        "...#####...",
        "..#######..",
        ".#########.",
        "###########",
        ".#########.",
        "..#######..",
        "...#####...",
        "....###....",
        ".....#.....",
    },
};

// Dot offsets for the multicolor symbol, in the order of the first five colors (W, U, B, R, G).
constexpr int8_t WHEEL_DOTS[5][2] = {{0, -5}, {5, -2}, {3, 4}, {-3, 4}, {-5, -2}};

struct Geometry {
  int16_t cardX, cardY, cardW, cardH;
  int16_t radius, inset, frameRadius;  // Black border, then the colored frame inset from it.
  int16_t plateX, plateW, titleY, titleH;
  int16_t artX, artY, artW, artH;
  int16_t typeY, typeH;
  int16_t textX, textY, textW, textH;
  int16_t statusY, ptX, ptY;
  int16_t countY, groupY, groupLeftX, groupRightX;  // Inside the art.
};

constexpr int PT_W = 54;
constexpr int PT_H = 26;

// The classic card roughly follows the 63x88 mm proportions of a real card.
constexpr Geometry CLASSIC_GEO = {23, 2, 194, 270, 10, 6, 6, 34, 172, 13, 24, 38, 41, 164, 96,
                                  139, 22, 38, 163, 164, 94, 237, 152, 240, 87, 124, 68, 132};
constexpr Geometry FULL_GEO = {0, 0, 240, 320, 12, 5, 8, 9, 222, 9, 28, 13, 41, 214, 128,
                               173, 22, 13, 199, 214, 106, 285, 177, 289, 105, 150, 27, 168};
Geometry G = CLASSIC_GEO;
// Both sizes of the art: the full layouts' box, and the classic card's.
constexpr int FULL_ART_W = FULL_GEO.artW;
constexpr int FULL_ART_H = FULL_GEO.artH;
constexpr int CLASSIC_ART_W = CLASSIC_GEO.artW;
constexpr int CLASSIC_ART_H = CLASSIC_GEO.artH;

#if HAS_TOKEN_ART
static_assert(ART_FULL_W == FULL_GEO.artW && ART_FULL_H == FULL_GEO.artH && ART_CLASSIC_W == CLASSIC_GEO.artW &&
                  ART_CLASSIC_H == CLASSIC_GEO.artH,
              "the art boxes changed: update ART_SIZES in tools/fetch_tokens.py and rerun it");
#endif

constexpr int BAR_Y = 280;
constexpr int BUTTON_W = 46;
constexpr int BUTTON_H = 38;
constexpr int BUTTON_STEP = 48;

constexpr int LIST_Y = 24;
constexpr int ROW_H = 28;
constexpr int ROWS_PER_PAGE = 9;

// Floating controls of the full-screen layouts, placed relative to the art box.
constexpr int OV_MARGIN = 4;
constexpr int OV_BUTTON_W = 28;
constexpr int OV_BUTTON_H = 24;
constexpr int OV_BIG_INSET = 30;  // Art edge to the center of the - and + circles.
constexpr int OV_BIG_R = 22;
constexpr int OV_CHIP_W = 64;
constexpr int OV_CHIP_H = 22;

// Over the art, the controls are dark glass: the art under them is dimmed to this much of its
// brightness (out of 256), and the top and bottom edges fade toward it so the labels stay readable.
constexpr uint8_t GLASS_KEEP = 96;
constexpr uint8_t BAND_KEEP = 112;
constexpr uint16_t GLASS_EDGE = 0xBDD7;

// Counter badges on the text box, and the rows of the counters screen.
constexpr int BADGE_H = 12;
constexpr int BADGE_GAP = 3;
constexpr uint16_t COUNTER_PILL = 0x7A28;
constexpr uint16_t KEYWORD_PILL = 0x2A8F;
constexpr uint16_t BONUS_PILL = 0x2C05;  // A "for each" ability's bonus, such as Vren's Rats.
constexpr int COUNTER_MINUS_X = 128;
constexpr int COUNTER_PLUS_X = 198;
constexpr int COUNTER_BUTTON_W = 34;
constexpr int COUNTER_LABEL_END = 120;  // Tapping the custom counter's name left of this renames it.

constexpr int SET_X = 4;
constexpr int SET_W = SCREEN_W - 8;
constexpr int SET_BRIGHTNESS_Y = 26;
constexpr int SET_TIMEOUT_Y = 94;
constexpr int SET_LAYOUT_Y = 26;
constexpr int SET_PANEL_H = 64;
constexpr int SET_LAYOUT_H = 114;
constexpr int SET_ROW_TOP = 22;  // Control row, measured from the top of its panel.
constexpr int SET_ROW_H = 36;
constexpr int SET_STEP_W = 42;  // Width of the - and + buttons.
constexpr int SET_BAR_X = 56;
constexpr int SET_BAR_STEP = 13;
constexpr int SET_BAR_W = 11;
constexpr int THUMB_W = 60;
constexpr int THUMB_H = 80;
constexpr int THUMB_STEP = 77;
constexpr int SETTINGS_PAGES = 2;  // Global: display, gamma.
constexpr int CARD_PAGES = 3;      // Card options: layout, tone, doodles.
constexpr int SET_TONE_Y = 26;
constexpr int SET_PREVIEW_TOP = 22;  // Card preview, measured from the top of its panel.
constexpr int SET_PREVIEW_ART_W = FULL_GEO.artW / 2;
constexpr int SET_PREVIEW_ART_H = FULL_GEO.artH / 2;
constexpr int SET_PREVIEW_PAD = 5;  // Frame around the art of the preview card.
constexpr int SET_PREVIEW_PLATE_H = 14;
constexpr int SET_PREVIEW_W = SET_PREVIEW_ART_W + 2 * SET_PREVIEW_PAD;
constexpr int SET_PREVIEW_H = SET_PREVIEW_PAD + SET_PREVIEW_ART_H + 3 + SET_PREVIEW_PLATE_H + SET_PREVIEW_PAD;
constexpr int SET_TONE_H = SET_PREVIEW_TOP + SET_PREVIEW_H + 6;
constexpr int SET_TONE_TIPS_Y = SET_TONE_Y + SET_TONE_H + 8;
constexpr int SET_SCREEN_Y = SET_TIMEOUT_Y + SET_PANEL_H + 4;
constexpr int SET_TIPS_Y = SET_SCREEN_Y + SET_PANEL_H + 8;
constexpr int SET_GAMMA_Y = 26;
constexpr int RAMP_STEPS = 16;
constexpr int RAMP_ROWS = 4;  // Gray, red, green and blue.
constexpr int RAMP_TOP = 18;  // Measured from the top of the ramps panel.
constexpr int RAMP_PATCH_W = 13;
constexpr int RAMP_PATCH_H = 14;
constexpr int RAMP_GAP = 2;
constexpr int SET_RAMP_Y = SET_GAMMA_Y + SET_PANEL_H + 6;
constexpr int SET_RAMP_H = RAMP_TOP + RAMP_ROWS * (RAMP_PATCH_H + RAMP_GAP) + 4;
constexpr int SET_GAMMA_TIPS_Y = SET_RAMP_Y + SET_RAMP_H + 8;
constexpr int SET_DRAW_AREA_Y = 26;
constexpr int SET_DRAW_OPEN_Y = SET_DRAW_AREA_Y + SET_PANEL_H + 4;
constexpr int SET_DRAW_STORE_Y = SET_DRAW_OPEN_Y + SET_PANEL_H + 4;
constexpr int SET_DRAW_TIPS_Y = SET_DRAW_STORE_Y + SET_PANEL_H + 8;
constexpr uint32_t DRAW_HOLD_MS = 700;  // Holding the art this long opens drawing mode.

constexpr int EDIT_ROW_H = 30;
constexpr int EDIT_NAME_Y = 26;
constexpr int EDIT_TYPE_Y = 60;
constexpr int EDIT_COLOR_Y = 94;
constexpr int EDIT_PT_Y = 128;
constexpr int EDIT_TEXT_Y = 162;
constexpr int EDIT_TEXT_H = 112;
constexpr int COLOR_PICK_X = 64;
constexpr int COLOR_PICK_STEP = 25;
constexpr int STAT_BUTTON_W = 26;
constexpr int POWER_MINUS_X = 78;
constexpr int POWER_PLUS_X = 126;
constexpr int TOUGHNESS_MINUS_X = 160;
constexpr int TOUGHNESS_PLUS_X = 208;

constexpr char KEY_SHIFT = 1;
constexpr char KEY_DEL = 2;
constexpr char KEY_LAYER = 3;
constexpr char KEY_RET = '\n';
constexpr int KEY_UNIT = 12;
constexpr int KEY_Y = 130;
constexpr int KEY_H = 36;
constexpr int KEY_ROWS = 4;
constexpr int KEY_COLS = 10;
constexpr int BUFFER_LINES = 6;

struct Key {
  char value;
  uint8_t units;  // Width in KEY_UNIT pixels; every row adds up to the screen width.
};

// Indexed by layer (letters, symbols), row and column; a zero value ends the row.
const Key KEYBOARD[2][KEY_ROWS][KEY_COLS] = {
    {
        {{'q', 2}, {'w', 2}, {'e', 2}, {'r', 2}, {'t', 2}, {'y', 2}, {'u', 2}, {'i', 2}, {'o', 2}, {'p', 2}},
        {{'a', 2}, {'s', 2}, {'d', 2}, {'f', 2}, {'g', 2}, {'h', 2}, {'j', 2}, {'k', 2}, {'l', 2}, {'\'', 2}},
        {{KEY_SHIFT, 3}, {'z', 2}, {'x', 2}, {'c', 2}, {'v', 2}, {'b', 2}, {'n', 2}, {'m', 2}, {KEY_DEL, 3}},
        {{KEY_LAYER, 3}, {',', 2}, {' ', 10}, {'.', 2}, {KEY_RET, 3}},
    },
    {
        {{'1', 2}, {'2', 2}, {'3', 2}, {'4', 2}, {'5', 2}, {'6', 2}, {'7', 2}, {'8', 2}, {'9', 2}, {'0', 2}},
        {{'+', 2}, {'-', 2}, {'/', 2}, {':', 2}, {';', 2}, {'(', 2}, {')', 2}, {'"', 2}, {'!', 2}, {'?', 2}},
        {{'*', 3}, {'&', 2}, {'%', 2}, {'=', 2}, {'#', 2}, {'@', 2}, {'$', 2}, {'_', 2}, {KEY_DEL, 3}},
        {{KEY_LAYER, 3}, {',', 2}, {' ', 10}, {'.', 2}, {KEY_RET, 3}},
    },
};

// Not NAME_MAX: newlib's <limits.h> already defines that as a macro.
constexpr size_t NAME_LIMIT = 24;
constexpr size_t TYPE_LIMIT = 40;
constexpr size_t TEXT_LIMIT = 240;

struct CustomData {
  char name[NAME_LIMIT + 1];
  char type[TYPE_LIMIT + 1];
  char text[TEXT_LIMIT + 1];
  bool hasPT;
  int8_t power;
  int8_t toughness;
  uint8_t color;
};

CustomData custom = {"Custom", "Creature - Custom", "", true, 1, 1, static_cast<uint8_t>(Color::Colorless)};

// The custom token comes first, followed by the generated Scryfall catalog.
constexpr size_t CUSTOM_INDEX = 0;
constexpr size_t CATALOG_COUNT = sizeof(CATALOG) / sizeof(CATALOG[0]);
constexpr size_t TOKEN_COUNT = CATALOG_COUNT + 1;

// Counters besides +1/+1 and -1/-1. Keyword counters just grant their keyword, so their badge only
// shows a number when there is more than one. The first kind is named by the player, per token.
struct CounterKind {
  const char *name;
  const char *label;  // Short form for crowded badges.
  bool keyword;
};

const CounterKind COUNTER_KINDS[] = {
    {"Custom", "CUSTOM", false},      {"Shield", "SHLD", false},       {"Stun", "STUN", false},
    {"Oil", "OIL", false},            {"Charge", "CHRG", false},       {"Finality", "FINAL", false},
    {"Flying", "FLY", true},          {"First strike", "1STRK", true}, {"Double strike", "2STRK", true},
    {"Deathtouch", "DTH", true},      {"Lifelink", "LIFE", true},      {"Trample", "TRMP", true},
    {"Vigilance", "VIG", true},       {"Menace", "MENC", true},        {"Reach", "REACH", true},
    {"Hexproof", "HEX", true},        {"Indestructible", "INDST", true},
};
constexpr uint8_t KIND_COUNT = sizeof(COUNTER_KINDS) / sizeof(COUNTER_KINDS[0]);
constexpr uint8_t CUSTOM_KIND = 0;
constexpr uint8_t KIND_MAX = 99;
constexpr size_t COUNTER_NAME_LIMIT = 10;

struct TokenState {
  int16_t count;
  int16_t tapped;
  int16_t counters;  // Positive for +1/+1, negative for -1/-1.
  int16_t powerMod;
  int16_t toughnessMod;
  uint8_t kinds[KIND_COUNT];  // Indexed like COUNTER_KINDS.
};

// TokenState before the other counter kinds existed, to migrate saved counts.
struct LegacyState {
  int16_t count;
  int16_t tapped;
  int16_t counters;
  int16_t powerMod;
  int16_t toughnessMod;
};

// What - and + change on the card. Counters are edited on their own screen, from the text box.
enum class Mode : uint8_t { Quantity, Tapped, Power, Toughness };
const char *const MODE_LABELS[] = {"QTY", "TAP", "POW", "TGH"};
constexpr uint8_t MODE_COUNT = sizeof(MODE_LABELS) / sizeof(MODE_LABELS[0]);

TokenState states[TOKEN_COUNT] = {};
char counterNames[TOKEN_COUNT][COUNTER_NAME_LIMIT + 1] = {};  // Empty means "Custom".
bool counterNamesChanged = false;
// Per token, the cards (not tokens) the player controls that its "for each ..." ability also counts,
// such as Vren himself for the Rats.
uint8_t outsideCards[TOKEN_COUNT] = {};
bool outsideCardsChanged = false;
constexpr uint8_t OUTSIDE_MAX = 99;
uint8_t foodTypes[TOKEN_COUNT] = {};
bool foodTypesChanged = false;
constexpr const char *TOKEN_PARTITION = "tokenstore";
bool storageReady = false;
bool migratingStorage = false;
TFT_eSPI display;
// The art box is composed off screen (art, shading, then the controls) and sent in one go, so
// redrawing it does not flicker.
TFT_eSprite artCanvas(&display);
SPIClass touchSpi(VSPI);
XPT2046_Touchscreen touch(TOUCH_CS_PIN, TOUCH_IRQ_PIN);
Preferences prefs;
size_t selectedToken = 0;
Mode mode = Mode::Quantity;
bool quantityTapped = false;
uint32_t lastTouchAt = 0;
bool saveScheduled = false;
uint32_t lastChangeAt = 0;
bool positionVisible = false;
uint32_t positionShownAt = 0;
bool countFlash = false;
uint32_t countShownAt = 0;

enum class Screen : uint8_t {
  Card, Picker, Editor, Keyboard, Settings, Counters, Drawing, DrawingTools,
  Home, TokenMenu, Decks, Match, MatchSetup, Dice, Confirm, Precons
};
Screen screen = Screen::Home;
size_t pickerPage = 0;
size_t counterPage = 0;

Config config = DEFAULT_CONFIG;
bool screenOn = true;
bool overlaysVisible = true;  // CardOnly hides the floating controls when idle.
bool awaitRelease = false;    // Ignore the current press until the finger lifts.
uint32_t lastActivityAt = 0;
bool cardOptions = false;  // Settings shows the token card's pages instead of the global ones.
uint8_t settingsPage = 0;
Screen keyboardFrom = Screen::Editor;
Screen searchFrom = Screen::Picker;  // Where cancelling a search returns to.

// Picker filter. matches holds the token indexes on show; without a query that is every token.
char searchQuery[NAME_LIMIT + 1] = "";
uint16_t matches[TOKEN_COUNT];
size_t matchCount = 0;

// The editor works on a draft that only replaces the custom token on SAVE.
CustomData draft;
char editBuffer[TEXT_LIMIT + 1];
char *editTarget = nullptr;
size_t editLimit = 0;
bool editMultiline = false;
const char *editLabel = "";
uint8_t keyLayer = 0;
bool keyShift = false;

static_assert(TOKEN_COUNT <= tabletop::TOKEN_CAPACITY, "increase deck token capacity");
static_assert(PRECON_CATALOG_ID == CATALOG_ID, "regenerate precons_generated.h with tools/fetch_tokens.py");
tabletop::DeckBook deckBook;
tabletop::Match match;
bool resumeMatch = false;
bool tableSaveScheduled = false;
uint32_t tableChangedAt = 0;
bool editingDeckTokens = false;
uint8_t setupPlayers = 4;
int16_t setupLife = 40;
// Life screen: recent change shown on each panel, the commander-damage view and the menu.
int16_t lifeDelta[tabletop::MAX_PLAYERS] = {};
uint32_t lifeDeltaAt[tabletop::MAX_PLAYERS] = {};
int8_t damageTarget = -1;  // While >= 0, the other panels show the commander damage this player took.
uint8_t damageSlot[tabletop::MAX_PLAYERS] = {};  // Which of each source's two commanders is shown.
int8_t startingSeat = -1;
bool lifeMenu = false;
uint32_t touchReleases = 0;  // Counts lifted fingers, to tell a held press from repeated taps.
bool fingerDown = false;
uint32_t holdRelease = UINT32_MAX;
uint8_t holdSeat = 0, holdSteps = 0;
bool holdPlus = false;
uint8_t dieIndex = 2, diceCount = 1;
uint8_t diceResults[tabletop::MAX_DICE] = {};
uint8_t rolledCount = 0, rolledSides = 0;
enum class TablePrompt : uint8_t { DeleteDeck, NewMatch };
TablePrompt tablePrompt = TablePrompt::NewMatch;
String tableMessage;
char preconQuery[NAME_LIMIT + 1] = "";
uint16_t preconMatches[PRECON_COUNT];
size_t preconMatchCount = 0;
size_t preconPage = 0;

void drawTablePage();
void showTablePage(Screen next);
void saveTableState();

constexpr uint16_t DOODLE_MAX_POINTS = 1024;
constexpr size_t DOODLE_POINT_BUDGET = 8192;
constexpr uint8_t DOODLE_START = 0x80;
constexpr uint32_t DOODLE_MAGIC = 0x314C4444;  // DDL1
const uint16_t DOODLE_COLORS[] = {TFT_BLACK, TFT_WHITE, TFT_RED, TFT_YELLOW,
                                 TFT_GREEN, TFT_CYAN, TFT_BLUE, TFT_MAGENTA};
const uint8_t DOODLE_RADII[] = {1, 2, 4};
struct DoodlePoint {
  uint8_t x, style;
  uint16_t y;
};
static_assert(sizeof(DoodlePoint) == 4, "drawing file format changed");
struct Doodle {
  DoodlePoint *points = nullptr;
  uint16_t count = 0, capacity = 0;
  bool loaded = false, changed = false, saved = false, failed = false;
};
struct DoodleHeader {
  uint32_t magic, count, checksum;
};
Doodle doodles[TOKEN_COUNT];
size_t doodleCapacity = 0;
bool doodleStorageReady = false;
bool doodleDown = false;
uint8_t doodleColor = 0, doodleBrush = 1;
bool doodleEraser = false;
// Quick color/brush pop-up drawn over the canvas, just above the drawing toolbar.
bool doodlePalette = false;
constexpr int PALETTE_X = 4, PALETTE_W = SCREEN_W - 8, PALETTE_H = 90, PALETTE_Y = BAR_Y - PALETTE_H - 6;
constexpr int PALETTE_COLOR_W = PALETTE_W / 8, PALETTE_BRUSH_W = PALETTE_W / 4;
constexpr int PALETTE_SPLIT_Y = PALETTE_Y + 46;
// A press on the art waiting to become a tap (on release) or a hold that opens drawing mode.
bool artHoldPending = false;
uint32_t artHoldAt = 0;
const char *doodleMessage = "";
enum class DoodlePrompt : uint8_t { None, Clear, Initialize };
DoodlePrompt doodlePrompt = DoodlePrompt::None;

void doodleError(const char *message) {
  doodleMessage = message;
  Serial.printf("drawing: %s\n", message);
}

bool reserveDoodle(Doodle &drawing, uint16_t capacity) {
  if (capacity <= drawing.capacity) return true;
  const size_t extra = capacity - drawing.capacity;
  for (Doodle &other : doodles) {
    if (doodleCapacity + extra <= DOODLE_POINT_BUDGET) break;
    if (&other == &drawing || other.changed || !other.capacity) continue;
    doodleCapacity -= other.capacity;
    free(other.points);
    other = Doodle{};
  }
  if (doodleCapacity + extra > DOODLE_POINT_BUDGET) {
    doodleError("Session memory full");
    return false;
  }
  auto *points = static_cast<DoodlePoint *>(realloc(drawing.points, capacity * sizeof(DoodlePoint)));
  if (!points) {
    doodleError("Not enough drawing RAM");
    return false;
  }
  drawing.points = points;
  doodleCapacity += extra;
  drawing.capacity = capacity;
  return true;
}

uint32_t doodleChecksum(const DoodlePoint *points, size_t count) {
  uint32_t hash = 2166136261u;
  const auto *bytes = reinterpret_cast<const uint8_t *>(points);
  for (size_t i = 0; i < count * sizeof(DoodlePoint); i++) hash = (hash ^ bytes[i]) * 16777619u;
  return hash;
}

void useSdPins(bool sd);
bool sdMounted();

DrawStore drawStore() { return static_cast<DrawStore>(config.drawStore); }
bool drawArtOnly() { return config.drawArea == static_cast<uint8_t>(DrawArea::Art); }

// The microSD card shares its SPI bus with the touch panel: the pins switch for as long as this lives.
struct DoodleFs {
  const bool sd = drawStore() == DrawStore::Sd;
  fs::FS &fs = sd ? static_cast<fs::FS &>(SD) : static_cast<fs::FS &>(LittleFS);
  DoodleFs() { if (sd) useSdPins(true); }
  ~DoodleFs() { if (sd) useSdPins(false); }
};

bool doodleStoreReady() {
  switch (drawStore()) {
    case DrawStore::Flash: return doodleStorageReady;
    case DrawStore::Sd: return sdMounted();
    default: return false;
  }
}

const char *doodleDir() { return drawStore() == DrawStore::Sd ? "/doodles" : ""; }

void doodlePath(char *path, size_t size) {
  // Prefix IDs retain drawings across append-only catalog expansions, never across reordered entries.
  const uint32_t id = selectedToken == CUSTOM_INDEX ? 0 : CATALOG_PREFIX_IDS[selectedToken - 1];
  snprintf(path, size, "%s/d%08X-%04u.bin", doodleDir(), static_cast<unsigned>(id),
           static_cast<unsigned>(selectedToken));
}

// Saved doodles are read again from wherever the setting now points; unsaved ink stays in the session.
void forgetSavedDoodles() {
  for (Doodle &drawing : doodles) {
    if (drawing.changed) {
      drawing.saved = false;
      continue;
    }
    doodleCapacity -= drawing.capacity;
    free(drawing.points);
    drawing = Doodle{};
  }
}

void loadDoodle() {
  Doodle &drawing = doodles[selectedToken];
  if (drawing.loaded) return;
  drawing.loaded = true;
  if (!doodleStoreReady()) return;
  char path[40];
  doodlePath(path, sizeof(path));
  DoodleFs store;
  if (!store.fs.exists(path)) return;
  File file = store.fs.open(path, "r");
  DoodleHeader header{};
  if (!file || file.read(reinterpret_cast<uint8_t *>(&header), sizeof(header)) != sizeof(header) ||
      header.magic != DOODLE_MAGIC || header.count > DOODLE_MAX_POINTS ||
      file.size() != sizeof(header) + header.count * sizeof(DoodlePoint)) {
    drawing.failed = true;
    doodleError("Cannot read saved drawing");
    return;
  }
  if (header.count && !reserveDoodle(drawing, header.count)) {
    drawing.loaded = false;
    return;
  }
  bool valid = file.read(reinterpret_cast<uint8_t *>(drawing.points), header.count * sizeof(DoodlePoint)) ==
               header.count * sizeof(DoodlePoint);
  valid = valid && doodleChecksum(drawing.points, header.count) == header.checksum;
  for (size_t i = 0; valid && i < header.count; i++) {
    const DoodlePoint &point = drawing.points[i];
    valid = point.x < SCREEN_W && point.y < SCREEN_H && (point.style & 0x60) == 0 &&
            ((point.style >> 3) & 3) < 3 && (i != 0 || (point.style & DOODLE_START));
  }
  if (!valid) {
    drawing.failed = true;
    doodleError("Saved drawing is damaged");
    return;
  }
  drawing.count = header.count;
  drawing.saved = true;
}

bool saveDoodle() {
  Doodle &drawing = doodles[selectedToken];
  if (drawing.failed || !drawing.loaded) {
    doodleError("Clear unreadable drawing first");
    return false;
  }
  if (drawStore() == DrawStore::Ram) {
    doodleError("SAVE TO is RAM: see settings");
    return false;
  }
  if (!doodleStoreReady()) {
    doodleError(drawStore() == DrawStore::Sd ? "No SD card: insert, restart" : "Drawing storage unavailable");
    return false;
  }
  char path[40], temporary[40];
  doodlePath(path, sizeof(path));
  snprintf(temporary, sizeof(temporary), "%s/drawing.tmp", doodleDir());
  DoodleFs store;
  if (!drawing.count) {
    if (store.fs.exists(path) && !store.fs.remove(path)) {
      doodleError("Could not delete saved drawing");
      return false;
    }
  } else {
    if (store.sd && !store.fs.exists(doodleDir())) store.fs.mkdir(doodleDir());
    const DoodleHeader header{DOODLE_MAGIC, drawing.count, doodleChecksum(drawing.points, drawing.count)};
    File file = store.fs.open(temporary, "w");
    bool written = file && file.write(reinterpret_cast<const uint8_t *>(&header), sizeof(header)) == sizeof(header);
    if (written) written = file.write(reinterpret_cast<const uint8_t *>(drawing.points),
                                     drawing.count * sizeof(DoodlePoint)) == drawing.count * sizeof(DoodlePoint);
    file.close();
    // LittleFS rename replaces atomically, retaining the previous drawing if writing failed. FAT cannot
    // rename over a file, so on the card the old one goes first, once the new one is fully written.
    if (written && store.sd && store.fs.exists(path)) written = store.fs.remove(path);
    if (!written || !store.fs.rename(temporary, path)) {
      doodleError("Save failed / storage full");
      if (store.fs.exists(temporary) && !store.fs.remove(temporary))
        Serial.println("drawing: could not remove incomplete temporary file");
      return false;
    }
  }
  drawing.saved = drawing.count != 0;
  drawing.changed = false;
  doodleMessage = !drawing.saved ? "Saved drawing removed" : store.sd ? "Saved to the SD card" : "Saved to flash";
  return true;
}

int doodleMap(int value, const int *from, const int *to, size_t count) {
  for (size_t i = 1; i < count; i++) {
    if (value <= from[i]) {
      const int span = from[i] - from[i - 1];
      return to[i - 1] + ((value - from[i - 1]) * (to[i] - to[i - 1]) + span / 2) / span;
    }
  }
  return to[count - 1];
}

int doodleX(int x, bool toScreen) {
  const int canonical[] = {0, FULL_GEO.artX, FULL_GEO.artX + FULL_GEO.artW - 1, SCREEN_W - 1};
  const int local[] = {G.cardX, G.artX, G.artX + G.artW - 1, G.cardX + G.cardW - 1};
  return doodleMap(x, toScreen ? canonical : local, toScreen ? local : canonical, 4);
}

int doodleY(int y, bool toScreen) {
  const int canonical[] = {0, FULL_GEO.artY, FULL_GEO.artY + FULL_GEO.artH,
                            FULL_GEO.typeY, FULL_GEO.textY, SCREEN_H - 1};
  const int local[] = {G.cardY, G.artY, G.artY + G.artH, G.typeY, G.textY, G.cardY + G.cardH - 1};
  return doodleMap(y, toScreen ? canonical : local, toScreen ? local : canonical, 6);
}

void drawDoodleSegment(TFT_eSPI &out, const DoodlePoint &from, const DoodlePoint &to) {
  int x = doodleX(from.x, true), y = doodleY(from.y, true);
  const int endX = doodleX(to.x, true), endY = doodleY(to.y, true);
  const int dx = abs(endX - x), dy = -abs(endY - y);
  const int sx = x < endX ? 1 : -1, sy = y < endY ? 1 : -1;
  int error = dx + dy;
  const int radius = max(1, DOODLE_RADII[(to.style >> 3) & 3] * G.cardW / SCREEN_W);
  const uint16_t color = DOODLE_COLORS[to.style & 7];
  while (true) {
    out.fillCircle(x, y, radius, color);
    if (x == endX && y == endY) break;
    const int twice = 2 * error;
    if (twice >= dy) { error += dy; x += sx; }
    if (twice <= dx) { error += dx; y += sy; }
  }
}

void drawDoodle(TFT_eSPI &out) {
  const Doodle &drawing = doodles[selectedToken];
  for (size_t i = 0; i < drawing.count; i++) {
    const DoodlePoint &point = drawing.points[i];
    drawDoodleSegment(out, i == 0 || (point.style & DOODLE_START) ? point : drawing.points[i - 1], point);
  }
}

constexpr int ERASER_REACH = 8;  // Screen pixels beyond the edge of a stroke that still pick it.

// Removes the topmost stroke passing near the screen point; false when there is none.
bool eraseStrokeAt(int x, int y) {
  Doodle &drawing = doodles[selectedToken];
  int hit = -1, start = 0;
  for (int i = 0; i < drawing.count; i++) {
    const DoodlePoint &point = drawing.points[i];
    if (point.style & DOODLE_START) start = i;
    const DoodlePoint &from = point.style & DOODLE_START ? point : drawing.points[i - 1];
    const int ax = doodleX(from.x, true), ay = doodleY(from.y, true);
    const int bx = doodleX(point.x, true), by = doodleY(point.y, true);
    const long dx = bx - ax, dy = by - ay, length = dx * dx + dy * dy;
    long t = length ? ((x - ax) * dx + (y - ay) * dy) * 1024 / length : 0;
    t = constrain(t, 0L, 1024L);
    const long nearX = ax + dx * t / 1024 - x, nearY = ay + dy * t / 1024 - y;
    const long reach = ERASER_REACH + max(1, DOODLE_RADII[(point.style >> 3) & 3] * G.cardW / SCREEN_W);
    if (nearX * nearX + nearY * nearY <= reach * reach) hit = start;
  }
  if (hit < 0) return false;
  int end = hit + 1;
  while (end < drawing.count && !(drawing.points[end].style & DOODLE_START)) end++;
  memmove(drawing.points + hit, drawing.points + end, (drawing.count - end) * sizeof(DoodlePoint));
  drawing.count -= end - hit;
  drawing.changed = true;
  return true;
}

Token tokenAt(size_t index) {
  if (index != CUSTOM_INDEX) return CATALOG[index - 1];
  return {custom.name, custom.type, custom.text, custom.hasPT, custom.power, custom.toughness,
          static_cast<Color>(custom.color)};
}

Token currentToken() {
  return tokenAt(selectedToken);
}

String fitLabel(const char *text, int width, int font) {
  String label = text;
  if (display.textWidth(label, font) > width) {
    while (label.length() && display.textWidth(label + "...", font) > width) label.remove(label.length() - 1);
    label += "...";
  }
  return label;
}

Layout layout() {
  return static_cast<Layout>(config.layout);
}

bool fullBleed() {
  return screen != Screen::Drawing && screen != Screen::DrawingTools && layout() != Layout::Classic;
}

bool controlsVisible() {
  return layout() != Layout::CardOnly || overlaysVisible;
}

void applyLayout() {
  G = fullBleed() ? FULL_GEO : CLASSIC_GEO;
  if (artCanvas.created()) artCanvas.deleteSprite();
  // Without memory for the sprite, drawArt falls back to drawing on the display, without the art.
  if (!artCanvas.createSprite(G.artW, G.artH)) Serial.println("no memory for the art sprite");
}

void applyBacklight() {
  ledcWrite(BACKLIGHT_PIN, screenOn ? BRIGHTNESS_DUTY[config.brightness - 1] : 0);
}

void applyRotation() {
  display.setRotation(config.flipped ? 2 : 0);
}

void writeRegister(uint8_t reg, const uint8_t *params, uint8_t count) {
  display.writecommand(reg);
  for (uint8_t i = 0; i < count; i++) display.writedata(params[i]);
}

// Programs the panel's gamma on top of the controller's init. Every register a profile touches is written
// each time, so switching profiles ends up as if the board had booted with it.
void applyGamma() {
  const GammaProfile &profile = GAMMA_PROFILES[config.gammaMode];
  display.invertDisplay(!profile.normallyBlack);
  // Display function control: the init's values, with the REV bit (0x80) telling the glass type.
  const uint8_t function[] = {0x08, static_cast<uint8_t>(profile.normallyBlack ? 0x02 : 0x82), 0x27};
  writeRegister(REG_DFUNCTR, function, sizeof(function));
  writeRegister(REG_GAMMA_POS, profile.positive, profile.length);
  writeRegister(REG_GAMMA_NEG, profile.negative, profile.length);
  const uint8_t other[] = {GAMMA_CURVE_OTHER};
  const uint8_t curve[] = {GAMMA_CURVE};
  writeRegister(REG_GAMMASET, other, sizeof(other));
  delay(GAMMA_SETTLE_MS);
  writeRegister(REG_GAMMASET, curve, sizeof(curve));
}

// Tone curves for the 5-6-5 bit color channels, rebuilt when the level changes.
uint8_t toneRed[32];
uint8_t toneGreen[64];
uint8_t toneBlue[32];
uint16_t plateColor = PLATE_BASE;  // PLATE_BASE through the tone: what the card's plates are filled with.

uint16_t toneColor(uint16_t color) {
  return (toneRed[color >> 11] << 11) | (toneGreen[(color >> 5) & 0x3F] << 5) | toneBlue[color & 0x1F];
}

void applyTone() {
  const float gamma = 1.0f + config.tone * TONE_GAMMA_STEP;
  const float gain = 1.0f - config.tone * TONE_GAIN_STEP;
  for (int i = 0; i < 64; i++) toneGreen[i] = static_cast<uint8_t>(63.0f * gain * powf(i / 63.0f, gamma) + 0.5f);
  for (int i = 0; i < 32; i++) {
    toneRed[i] = toneBlue[i] = static_cast<uint8_t>(31.0f * gain * powf(i / 31.0f, gamma) + 0.5f);
  }
  plateColor = toneColor(PLATE_BASE);
}

uint16_t frameColor(const ColorStyle &style) {
  return toneColor(style.frame);
}

// Applies the tone to decoded art pixels, which are byte-swapped like the display takes them.
void toneSwapped(uint16_t *pixels, int count) {
  if (config.tone == 0) return;
  for (int i = 0; i < count; i++) pixels[i] = __builtin_bswap16(toneColor(__builtin_bswap16(pixels[i])));
}

bool savedCatalogMatches(uint32_t id, size_t count) {
  return count >= 2 && count <= TOKEN_COUNT && CATALOG_PREFIX_IDS[count - 2] == id;
}

void tableError(const char *message) {
  tableMessage = message;
  Serial.println(message);
}

void scheduleTableSave() {
  tableSaveScheduled = true;
  tableChangedAt = millis();
}

void loadTableState() {
  match.reset(4, 40);
  if (!storageReady) {
    tableError("Table storage unavailable");
    return;
  }
  Preferences tablePrefs;
  if (!tablePrefs.begin("table", false, TOKEN_PARTITION)) {
    tableError("Cannot open table storage");
    return;
  }
  if (tablePrefs.isKey("decks")) {
    if (tablePrefs.getBytesLength("decks") == sizeof(deckBook) &&
        tablePrefs.getBytes("decks", &deckBook, sizeof(deckBook)) == sizeof(deckBook) &&
        deckBook.version == 1 && deckBook.active <= tabletop::MAX_DECKS) {
      for (auto &deck : deckBook.decks) deck.name[tabletop::DECK_NAME_LIMIT] = '\0';
      if (!savedCatalogMatches(deckBook.catalog, deckBook.catalogCount)) {
        for (auto &deck : deckBook.decks) memset(deck.tokens, 0, sizeof(deck.tokens));
        deckBook.active = 0;
        tableError("Catalog changed: refill decks");
        scheduleTableSave();
      }
      if (deckBook.active && !deckBook.decks[deckBook.active - 1].name[0]) deckBook.active = 0;
    } else {
      deckBook = tabletop::DeckBook{};
      tableError("Invalid deck save");
    }
  }
  const uint8_t resume = tablePrefs.getUChar("resume", 0);
  resumeMatch = resume == 1;
  if (resume > 1) tableError("Invalid match save setting");
  const uint8_t players = tablePrefs.getUChar("players", 4);
  const int16_t initial = tablePrefs.getShort("initial", 40);
  if (players >= 1 && players <= tabletop::MAX_PLAYERS && initial >= 1 && initial <= tabletop::LIFE_LIMIT)
    match.reset(players, initial);
  else
    tableError("Invalid match defaults");
  if (resumeMatch && tablePrefs.isKey("match")) {
    if (tablePrefs.getBytesLength("match") != sizeof(match) ||
        tablePrefs.getBytes("match", &match, sizeof(match)) != sizeof(match) || !match.valid()) {
      match = tabletop::Match{};
      match.reset(4, 40);
      tableError("Invalid match save");
    }
  }
  setupPlayers = match.players;
  setupLife = match.initialLife;
  tablePrefs.end();
}

void saveTableState() {
  tableSaveScheduled = false;
  Preferences tablePrefs;
  if (!storageReady || !tablePrefs.begin("table", false, TOKEN_PARTITION)) {
    tableError("Table was not saved");
    return;
  }
  deckBook.catalog = CATALOG_ID;
  deckBook.catalogCount = TOKEN_COUNT;
  bool saved = tablePrefs.putBytes("decks", &deckBook, sizeof(deckBook)) == sizeof(deckBook);
  saved = (tablePrefs.putUChar("players", match.players) == 1) && saved;
  saved = (tablePrefs.putShort("initial", match.initialLife) == sizeof(int16_t)) && saved;
  // Disable restoration first; an interrupted erase must never restore a stale game.
  if (!resumeMatch) {
    saved = (tablePrefs.putUChar("resume", 0) == 1) && saved;
    if (tablePrefs.isKey("match")) saved = tablePrefs.remove("match") && saved;
  } else {
    const bool matchSaved = tablePrefs.putBytes("match", &match, sizeof(match)) == sizeof(match);
    saved = matchSaved && saved;
    if (matchSaved) saved = (tablePrefs.putUChar("resume", 1) == 1) && saved;
  }
  tablePrefs.end();
  if (!saved) tableError("Table save failed; see serial");
}

void loadState() {
  const esp_err_t storageError = nvs_flash_init_partition(TOKEN_PARTITION);
  storageReady = storageError == ESP_OK;
  if (!storageReady) Serial.printf("token storage init failed: %d; changes cannot be saved\n", storageError);
  migratingStorage = true;
  if (storageReady && prefs.begin("tokens", true, TOKEN_PARTITION)) {
    if (prefs.getBytesLength("catalog") == sizeof(uint32_t)) migratingStorage = false;
    else prefs.end();
  }
  if (migratingStorage && !prefs.begin("tokens", true)) {
    if (storageReady) {
      migratingStorage = true;
      saveScheduled = true;
      lastChangeAt = millis();
    }
    return;
  }
  // Settings are kept apart from the catalog check: they stay valid when the catalog changes.
  Config saved = DEFAULT_CONFIG;
  const size_t configLength = prefs.getBytesLength("config");
  if (configLength == sizeof(saved) || configLength == CONFIG_V3_SIZE || configLength == CONFIG_V2_SIZE ||
      configLength == CONFIG_V1_SIZE) {
    prefs.getBytes("config", &saved, configLength);
    if (saved.brightness >= 1 && saved.brightness <= BRIGHTNESS_LEVELS && saved.timeout < TIMEOUT_COUNT &&
        saved.layout < LAYOUT_COUNT && saved.tone < TONE_LEVELS && saved.flipped <= 1 &&
        saved.gammaMode < GAMMA_COUNT && saved.drawArea < 2 && saved.drawOpen < DRAW_OPTION_COUNT &&
        saved.drawStore < DRAW_OPTION_COUNT) {
      config = saved;
    }
  }
  const size_t length = prefs.getBytesLength("state");
  const uint32_t savedCatalog = prefs.getUInt("catalog", 0);
  size_t savedCount = length / sizeof(TokenState);
  const bool modern = length % sizeof(TokenState) == 0 && savedCatalogMatches(savedCatalog, savedCount);
  if (!modern) savedCount = length / sizeof(LegacyState);
  const bool legacy = length % sizeof(LegacyState) == 0 && savedCatalogMatches(savedCatalog, savedCount);
  if (modern || legacy) {
    if (savedCount != TOKEN_COUNT) migratingStorage = true;
    if (modern) {
      prefs.getBytes("state", states, length);
      for (TokenState &state : states) {
        for (uint8_t &kind : state.kinds) kind = min(kind, KIND_MAX);
      }
    } else {
      // Saved before the other counter kinds: keep the counts, with none of the new counters.
      prefs.getBytes("state", states, sizeof(states));
      // Expand backwards in place, without putting the whole catalog on the small ESP32 stack.
      for (size_t i = savedCount; i > 0; i--) {
        LegacyState old;
        memcpy(&old, reinterpret_cast<const uint8_t *>(states) + (i - 1) * sizeof(old), sizeof(old));
        states[i - 1] = {old.count, old.tapped, old.counters, old.powerMod, old.toughnessMod, {}};
      }
    }
    selectedToken = prefs.getUInt("sel", 0) % savedCount;
    if (prefs.getBytesLength("cnames") == savedCount * sizeof(counterNames[0])) {
      prefs.getBytes("cnames", counterNames, sizeof(counterNames));
      for (auto &name : counterNames) name[COUNTER_NAME_LIMIT] = '\0';
    }
    if (prefs.getBytesLength("outside") == savedCount * sizeof(outsideCards[0])) {
      prefs.getBytes("outside", outsideCards, sizeof(outsideCards));
      for (uint8_t &cards : outsideCards) cards = min(cards, OUTSIDE_MAX);
    }
    if (prefs.getBytesLength("foods") == savedCount * sizeof(foodTypes[0])) {
      prefs.getBytes("foods", foodTypes, sizeof(foodTypes));
      for (uint8_t &value : foodTypes) value = min(value, static_cast<uint8_t>(1));
    }
  } else if (length) {
    Serial.println("saved token catalog is incompatible; keeping custom token and settings only");
  }
  if (prefs.getBytesLength("custom") == sizeof(custom)) {
    prefs.getBytes("custom", &custom, sizeof(custom));
    custom.name[NAME_LIMIT] = '\0';
    custom.type[TYPE_LIMIT] = '\0';
    custom.text[TEXT_LIMIT] = '\0';
    if (custom.color >= COLOR_COUNT) custom.color = static_cast<uint8_t>(Color::Colorless);
  }
  prefs.end();
  if (migratingStorage && storageReady) {
    saveScheduled = true;
    lastChangeAt = millis();
  }
}

bool writeStateBytes(const char *key, const void *data, size_t size) {
  if (prefs.putBytes(key, data, size) == size) return true;
  Serial.printf("could not save '%s' (%u bytes)\n", key, static_cast<unsigned>(size));
  return false;
}

void saveState() {
  if (!storageReady || !prefs.begin("tokens", false, TOKEN_PARTITION)) {
    Serial.println("token storage unavailable; state was not saved");
    saveScheduled = false;
    return;
  }
  bool saved = writeStateBytes("state", states, sizeof(states));
  const uint32_t selection = selectedToken;
  saved = writeStateBytes("sel", &selection, sizeof(selection)) && saved;
  saved = writeStateBytes("config", &config, sizeof(config)) && saved;
  // The names rarely change, so they are only written when they do.
  if (counterNamesChanged || migratingStorage) {
    counterNamesChanged = !writeStateBytes("cnames", counterNames, sizeof(counterNames));
    saved = !counterNamesChanged && saved;
  }
  if (outsideCardsChanged || migratingStorage) {
    outsideCardsChanged = !writeStateBytes("outside", outsideCards, sizeof(outsideCards));
    saved = !outsideCardsChanged && saved;
  }
  if (foodTypesChanged || migratingStorage) {
    foodTypesChanged = !writeStateBytes("foods", foodTypes, sizeof(foodTypes));
    saved = !foodTypesChanged && saved;
  }
  if (migratingStorage) saved = writeStateBytes("custom", &custom, sizeof(custom)) && saved;
  if (saved) saved = writeStateBytes("catalog", &CATALOG_ID, sizeof(CATALOG_ID));
  if (saved) migratingStorage = false;
  prefs.end();
  saveScheduled = false;
}

void saveCustom() {
  if (migratingStorage) saveState();
  if (!storageReady || !prefs.begin("tokens", false, TOKEN_PARTITION)) {
    Serial.println("token storage unavailable; custom token was not saved");
    return;
  }
  writeStateBytes("custom", &custom, sizeof(custom));
  prefs.end();
}

void scheduleSave() {
  saveScheduled = true;
  lastChangeAt = millis();
}

String signedText(int value) {
  if (value < 0) return String(value);
  return "+" + String(value);
}

// Word-wraps text to maxW pixels and returns the line count. Lines from firstLine on are drawn
// (up to maxLines of them) only when draw is set.
int wrapText(const char *text, int font, int x, int y, int maxW, int lineH, int maxLines, bool draw,
             int firstLine = 0) {
  int lines = 0;
  String line;
  auto flush = [&]() {
    int row = lines - firstLine;
    if (draw && row >= 0 && row < maxLines) display.drawString(line, x, y + row * lineH, font);
    lines++;
    line = "";
  };
  while (*text) {
    if (*text == '\n') {
      flush();
      text++;
      continue;
    }
    if (*text == ' ') {
      text++;
      continue;
    }
    size_t length = strcspn(text, " \n");
    String word = String(text).substring(0, length);
    String candidate = line;
    if (candidate.length()) candidate += ' ';
    candidate += word;
    if (line.length() && display.textWidth(candidate, font) > maxW) {
      flush();
      candidate = word;
    }
    line = candidate;
    text += length;
  }
  if (line.length()) flush();
  return lines;
}

// Uses the larger font when the whole text fits, otherwise falls back to the small one.
void drawRulesText(const char *text, int maxH) {
  int x = G.textX + 5;
  int y = G.textY + 3;
  int maxW = G.textW - 10;
  if (wrapText(text, 2, x, y, maxW, 16, 0, false) * 16 <= maxH) {
    wrapText(text, 2, x, y, maxW, 16, maxH / 16, true);
  } else {
    wrapText(text, 1, x, y, maxW, 10, maxH / 10, true);
  }
}

const ColorStyle &styleOf(const Token &token) {
  return COLOR_STYLES[static_cast<uint8_t>(token.color)];
}

// Draws the mana symbol of a color centered on (x, y): a disc with a ring and the color's glyph. On the
// card itself the disc goes through the tone, like the rest of the card.
void drawManaSymbol(int x, int y, int radius, uint8_t color, uint16_t ring, bool toned = false) {
  const ColorStyle &style = COLOR_STYLES[color];
  auto disc = [toned](const ColorStyle &of) { return toned ? toneColor(of.pip) : of.pip; };
  display.fillCircle(x, y, radius, disc(style));
  display.drawCircle(x, y, radius, ring);

  if (color == static_cast<uint8_t>(Color::Multicolor)) {
    for (int i = 0; i < 5; i++) {
      display.fillRect(x + WHEEL_DOTS[i][0] - 1, y + WHEEL_DOTS[i][1] - 1, 3, 3, disc(COLOR_STYLES[i]));
    }
    return;
  }

  for (int row = 0; row < GLYPH_SIZE; row++) {
    const char *line = GLYPHS[color][row];
    for (int col = 0; col < GLYPH_SIZE; col++) {
      if (line[col] != '#') continue;
      int start = col;
      while (col + 1 < GLYPH_SIZE && line[col + 1] == '#') col++;
      display.drawFastHLine(x - GLYPH_SIZE / 2 + start, y - GLYPH_SIZE / 2 + row, col - start + 1, style.pipInk);
    }
  }
}

String kindName(uint8_t kind) {
  if (kind == CUSTOM_KIND && counterNames[selectedToken][0]) return counterNames[selectedToken];
  return COUNTER_KINDS[kind].name;
}

String kindLabel(uint8_t kind) {
  if (kind != CUSTOM_KIND || !counterNames[selectedToken][0]) return COUNTER_KINDS[kind].label;
  String label = String(counterNames[selectedToken]).substring(0, 7);
  label.toUpperCase();
  return label;
}

String modeLabel() {
  return MODE_LABELS[static_cast<uint8_t>(mode)];
}

// POW and TGH only apply to creatures.
bool modeAvailable(Mode value) {
  return value <= Mode::Tapped || currentToken().hasPT;
}

// Falls back to QTY when the mode does not apply to the token on show.
void validateMode() {
  if (!modeAvailable(mode)) mode = Mode::Quantity;
}

// A creature's "gets +1/+1 for each [other] Rat you control": the bonus follows what is in play.
struct Scaling {
  bool active;
  bool other;  // "each other": the creature does not count itself.
  int8_t power;
  int8_t toughness;
  char what[24];  // A type or subtype, like "Rat" or "artifact".
};

Scaling scalingOf(const Token &token) {
  Scaling scaling = {};
  if (!token.hasPT) return scaling;
  for (const char *at = strstr(token.text, "gets "); at; at = strstr(at + 1, "gets ")) {
    int power = 0;
    int toughness = 0;
    int used = 0;
    if (sscanf(at, "gets %d/%d for each %n", &power, &toughness, &used) != 2 || !used) continue;
    const char *what = at + used;
    const bool other = strncmp(what, "other ", 6) == 0;
    if (other) what += 6;
    const char *end = strstr(what, " you control");
    if (!end || end == what || static_cast<size_t>(end - what) >= sizeof(scaling.what)) continue;
    scaling = {true, other, static_cast<int8_t>(power), static_cast<int8_t>(toughness), {}};
    memcpy(scaling.what, what, end - what);
    return scaling;
  }
  return scaling;
}

// Whole words, ignoring case: "Rat" is in "Creature - Rat" but not in "Creature - Pirate".
bool typeIncludes(const char *type, const char *what) {
  const size_t length = strlen(what);
  for (const char *at = type; *at; at++) {
    if (at > type && isalpha(static_cast<unsigned char>(at[-1]))) continue;
    size_t i = 0;
    while (i < length && at[i] &&
           tolower(static_cast<unsigned char>(at[i])) == tolower(static_cast<unsigned char>(what[i]))) {
      i++;
    }
    if (i == length && !isalpha(static_cast<unsigned char>(at[length]))) return true;
  }
  return false;
}

bool markedFood(size_t index) {
  return foodTypes[index] && typeIncludes(tokenAt(index).type, "Creature");
}

String effectiveType(size_t index) {
  String type = tokenAt(index).type;
  if (markedFood(index)) {
    if (!typeIncludes(type.c_str(), "Artifact")) type = "Artifact " + type;
    if (!typeIncludes(type.c_str(), "Food")) type += " Food";
  }
  return type;
}

bool hasType(size_t index, const char *what) {
  return typeIncludes(effectiveType(index).c_str(), what);
}

// How many times the selected token's bonus applies: the matching tokens in play plus the cards the
// player added. With none of it in play yet, it counts as if one were, to show the P/T it would enter with.
int scalingCount(const Scaling &scaling) {
  int matches = outsideCards[selectedToken];
  for (size_t i = 0; i < TOKEN_COUNT; i++) {
    if (hasType(i, scaling.what)) matches += states[i].count;
  }
  if (hasType(selectedToken, scaling.what)) {
    if (states[selectedToken].count <= 0) matches++;
    if (scaling.other) matches--;
  }
  return max(matches, 0);
}

// "Rat" -> "Rats", "artifact" -> "Artifacts".
String pluralType(const char *what) {
  char text[sizeof(Scaling::what) + 1];
  const size_t length = strlen(what);
  memcpy(text, what, length + 1);
  if (length) text[0] = static_cast<char>(toupper(static_cast<unsigned char>(text[0])));
  if (length && text[length - 1] != 's') {
    text[length] = 's';
    text[length + 1] = '\0';
  }
  return text;
}

void drawMenuIcon(TFT_eSPI &out, int x, int y, uint16_t color) {
  for (int row = -1; row <= 1; ++row)
    out.fillRoundRect(x - 7, y + row * 5 - 1, 15, 3, 1, color);
}

void drawSearchIcon(TFT_eSPI &out, int x, int y, uint16_t color) {
  out.drawCircle(x - 2, y - 2, 5, color);
  out.drawCircle(x - 2, y - 2, 4, color);
  out.drawLine(x + 2, y + 2, x + 6, y + 6, color);
  out.drawLine(x + 3, y + 2, x + 6, y + 5, color);
  out.drawLine(x + 2, y + 3, x + 5, y + 6, color);
}

// Slot 0..3: previous, menu, search, next.
int overlaySlotX(const Geometry &g, int slot) {
  const int step = OV_BUTTON_W + OV_MARGIN;
  if (slot < 2) return g.artX + OV_MARGIN + slot * step;
  return g.artX + g.artW - OV_MARGIN - OV_BUTTON_W - (3 - slot) * step;
}

// Scales the brightness of an RGB565 color to keep/256.
uint16_t dimColor(uint16_t color, uint16_t keep) {
  const uint16_t r = ((color >> 11) * keep) >> 8;
  const uint16_t g = (((color >> 5) & 0x3F) * keep) >> 8;
  const uint16_t b = ((color & 0x1F) * keep) >> 8;
  return (r << 11) | (g << 5) | b;
}

// Dims a run of art pixels in the sprite; x and y are relative to the art box. The sprite keeps its
// colors byte-swapped, in the order they are sent to the display.
void dimSpan(int x, int y, int w, uint16_t keep) {
  if (y < 0 || y >= G.artH) return;
  const int end = min(x + w, static_cast<int>(G.artW));
  uint16_t *row = static_cast<uint16_t *>(artCanvas.getPointer()) + y * G.artW;
  for (int i = max(x, 0); i < end; i++) row[i] = __builtin_bswap16(dimColor(__builtin_bswap16(row[i]), keep));
}

// Dark glass under a control: dims the art inside a rounded rectangle given in screen coordinates.
void dimRoundRect(int x, int y, int w, int h, int r, uint16_t keep) {
  for (int row = 0; row < h; row++) {
    const int fromEdge = min(row, h - 1 - row);
    int inset = 0;
    if (fromEdge < r) {
      const float dy = r - fromEdge - 0.5f;
      inset = r - static_cast<int>(sqrtf(r * r - dy * dy) + 0.5f);
    }
    dimSpan(x - G.artX + inset, y - G.artY + row, w - 2 * inset, keep);
  }
}

// Fades the art rows [from, to) from keepFrom to keepTo of their brightness.
void dimBand(int from, int to, int keepFrom, int keepTo) {
  for (int y = from; y < to; y++) dimSpan(0, y, G.artW, keepFrom + (keepTo - keepFrom) * (y - from) / (to - from));
}

#if HAS_TOKEN_ART
static_assert(sizeof(TOKEN_ART) / sizeof(TOKEN_ART[0]) == CATALOG_COUNT, "token art does not match the catalog");
#endif

JPEGDEC jpeg;

// JPEGDEC hands the picture over in blocks of whole MCUs, which can run past the art box.
int copyArtBlock(JPEGDRAW *block) {
  const int w = min(block->iWidth, G.artW - block->x);
  const int h = min(block->iHeight, G.artH - block->y);
  uint16_t *pixels = static_cast<uint16_t *>(artCanvas.getPointer());
  for (int row = 0; row < h && w > 0; row++) {
    uint16_t *target = pixels + (block->y + row) * G.artW + block->x;
    memcpy(target, block->pPixels + row * block->iWidth, w * 2);
    toneSwapped(target, w);
  }
  return 1;
}

// For the thumbnails, which go straight to the display; its viewport clips the blocks.
int thumbShiftX = 0, thumbShiftY = 0;

int pushArtBlock(JPEGDRAW *block) {
  toneSwapped(block->pPixels, block->iWidth * block->iHeight);
  display.pushImage(block->x + thumbShiftX, block->y + thumbShiftY, block->iWidth, block->iHeight, block->pPixels);
  return 1;
}

// Art on a microSD card, in /mtgart, takes the place of the firmware's: it has room for the best
// quality at both sizes. tools/fetch_tokens.py writes it.
enum class SdArt : uint8_t { NoCard, Missing, Stale, Ready };
SdArt sdArt = SdArt::NoCard;
char *sdArtistText = nullptr;
const char *sdArtists[CATALOG_COUNT] = {};

void useSdPins(bool sd) {
  touchSpi.end();
  if (sd) {
    touchSpi.begin(SD_SCLK_PIN, SD_MISO_PIN, SD_MOSI_PIN, SD_CS_PIN);
  } else {
    touchSpi.begin(TOUCH_SCLK_PIN, TOUCH_MISO_PIN, TOUCH_MOSI_PIN, TOUCH_CS_PIN);
  }
}

// Reads a whole file from the card into a new, zero-terminated buffer for free(); nullptr if it is missing.
uint8_t *readSdFile(const char *path, size_t &size) {
  useSdPins(true);
  uint8_t *data = nullptr;
  File file = SD.open(path, FILE_READ);
  if (file) {
    size = file.size();
    data = static_cast<uint8_t *>(malloc(size + 1));
    if (data && file.read(data, size) != size) {
      free(data);
      data = nullptr;
    }
    if (data) data[size] = 0;
    file.close();
  }
  useSdPins(false);
  return data;
}

// Mounts the card and checks its art was made for this catalog: art files are named by catalog position.
void initSdArt() {
  sdArt = SdArt::NoCard;
  free(sdArtistText);
  sdArtistText = nullptr;
  for (const char *&artist : sdArtists) artist = nullptr;
  useSdPins(true);
  const bool mounted = SD.begin(SD_CS_PIN, touchSpi, SD_FREQUENCY);
  useSdPins(false);
  if (!mounted) {
    Serial.println("SD art: no card");
    return;
  }
  sdArt = SdArt::Missing;
  char path[40];
  size_t size = 0;
  snprintf(path, sizeof(path), "%s/catalog.txt", SD_ART_DIR);
  uint8_t *id = readSdFile(path, size);
  if (!id) {
    Serial.printf("SD art: no %s\n", path);
    return;
  }
  const uint32_t catalog = strtoul(reinterpret_cast<char *>(id), nullptr, 16);
  free(id);
  if (catalog != CATALOG_ID) {
    sdArt = SdArt::Stale;
    Serial.printf("SD art: made for catalog %08X, not %08X; rerun tools/fetch_tokens.py\n",
                  static_cast<unsigned>(catalog), static_cast<unsigned>(CATALOG_ID));
    return;
  }
  sdArt = SdArt::Ready;
  snprintf(path, sizeof(path), "%s/artists.txt", SD_ART_DIR);
  sdArtistText = reinterpret_cast<char *>(readSdFile(path, size));
  char *line = sdArtistText;
  for (size_t i = 0; line && i < CATALOG_COUNT; i++) {
    sdArtists[i] = line;
    line = strchr(line, '\n');
    if (line) *line++ = 0;
    char *end = const_cast<char *>(sdArtists[i]) + strlen(sdArtists[i]);
    if (end > sdArtists[i] && end[-1] == '\r') end[-1] = 0;
  }
  Serial.println("SD art: using the card's art");
}

const char *sdArtLabel() {
  switch (sdArt) {
    case SdArt::Missing: return "SD: NO ART";
    case SdArt::Stale: return "SD: OLD ART";
    case SdArt::Ready: return "SD HD ART";
    default: return nullptr;
  }
}

bool sdMounted() { return sdArt != SdArt::NoCard; }

// The last art file read from the card, kept so redrawing the card does not read it again.
struct SdArtCache {
  size_t token = 0;
  bool classic = false;
  uint8_t *data = nullptr;
  size_t size = 0;
} sdCache;

// Opens the card's art for the token in one size; false when there is none.
bool openSdArt(JPEG_DRAW_CALLBACK *draw, bool classic) {
  if (sdArt != SdArt::Ready) return false;
  if (!sdCache.data || sdCache.token != selectedToken || sdCache.classic != classic) {
    free(sdCache.data);
    char path[40];
    snprintf(path, sizeof(path), "%s/%s/%04u.jpg", SD_ART_DIR, classic ? "classic" : "full",
             static_cast<unsigned>(selectedToken));
    sdCache.data = readSdFile(path, sdCache.size);
    sdCache.token = selectedToken;
    sdCache.classic = classic;
  }
  return sdCache.data && jpeg.openRAM(sdCache.data, static_cast<int>(sdCache.size), draw);
}

// Opens the token's art at the full layout's size, or with classic set only the card's classic size;
// false when the token has none.
bool openArt(JPEG_DRAW_CALLBACK *draw, bool classic = false) {
  if (selectedToken == CUSTOM_INDEX) return false;
  bool opened = openSdArt(draw, classic);
#if HAS_TOKEN_ART
  if (!opened && !classic) {
    const TokenArt &art = TOKEN_ART[selectedToken - 1];
    opened = art.size != 0 && jpeg.openFLASH(const_cast<uint8_t *>(ART_DATA + art.offset), art.size, draw);
  }
#endif
  if (!opened) return false;
  // Big-endian RGB565 is the byte order the sprite stores and the display takes.
  jpeg.setPixelType(RGB565_BIG_ENDIAN);
  return true;
}

// The classic layout decodes the full layout's art here and scales it down: JPEGDEC itself only
// scales by powers of two.
uint16_t *artSource = nullptr;

int copySourceBlock(JPEGDRAW *block) {
  const int w = min(block->iWidth, FULL_ART_W - block->x);
  const int h = min(block->iHeight, FULL_ART_H - block->y);
  for (int row = 0; row < h && w > 0; row++) {
    memcpy(artSource + (block->y + row) * FULL_ART_W + block->x, block->pPixels + row * block->iWidth, w * 2);
  }
  return 1;
}

// Bilinear mix of four byte-swapped RGB565 pixels; fx and fy weigh the right and bottom ones (0-256).
uint16_t mixSwapped(uint16_t a, uint16_t b, uint16_t c, uint16_t d, int fx, int fy) {
  const uint32_t pixels[4] = {__builtin_bswap16(a), __builtin_bswap16(b), __builtin_bswap16(c), __builtin_bswap16(d)};
  const uint32_t weights[4] = {static_cast<uint32_t>((256 - fx) * (256 - fy)), static_cast<uint32_t>(fx * (256 - fy)),
                               static_cast<uint32_t>((256 - fx) * fy), static_cast<uint32_t>(fx * fy)};
  uint16_t mixed = 0;
  constexpr int SHIFTS[3] = {11, 5, 0};
  constexpr uint32_t MASKS[3] = {31, 63, 31};
  for (int channel = 0; channel < 3; channel++) {
    uint32_t sum = 32768;
    for (int i = 0; i < 4; i++) sum += ((pixels[i] >> SHIFTS[channel]) & MASKS[channel]) * weights[i];
    mixed |= (sum >> 16) << SHIFTS[channel];
  }
  return __builtin_bswap16(mixed);
}

// Scales artSource into the classic art box with one factor for both axes, trimming the rows that
// the slightly flatter box leaves over at the top and bottom.
void scaleArtSource() {
  constexpr int32_t STEP = (FULL_ART_W << 16) / CLASSIC_ART_W;
  constexpr int32_t TOP = ((FULL_ART_H << 16) - CLASSIC_ART_H * STEP) / 2;
  uint16_t *out = static_cast<uint16_t *>(artCanvas.getPointer());
  for (int y = 0; y < CLASSIC_ART_H; y++) {
    const int32_t sy = TOP + y * STEP + STEP / 2 - 0x8000;
    const int y0 = constrain(sy >> 16, 0, FULL_ART_H - 2);
    const int fy = constrain((sy - (y0 << 16)) >> 8, 0, 256);
    for (int x = 0; x < CLASSIC_ART_W; x++) {
      const int32_t sx = x * STEP + STEP / 2 - 0x8000;
      const int x0 = constrain(sx >> 16, 0, FULL_ART_W - 2);
      const int fx = constrain((sx - (x0 << 16)) >> 8, 0, 256);
      const uint16_t *p = artSource + y0 * FULL_ART_W + x0;
      *out++ = mixSwapped(p[0], p[1], p[FULL_ART_W], p[FULL_ART_W + 1], fx, fy);
    }
  }
}

// Decodes the token's art into the sprite; false when the token has none.
bool decodeArt() {
  // The card's classic-size art needs no scaling; the full-size art needs it only in the classic layout.
  if (fullBleed() ? openArt(copyArtBlock) : openArt(copyArtBlock, true)) {
    const bool decoded = jpeg.decode(0, 0, 0);
    jpeg.close();
    return decoded;
  }
  if (fullBleed()) return false;
  artSource = static_cast<uint16_t *>(malloc(FULL_ART_W * FULL_ART_H * sizeof(uint16_t)));
  if (!artSource) {
    Serial.println("no memory to scale the art");
    return false;
  }
  bool decoded = openArt(copySourceBlock);
  if (decoded) {
    decoded = jpeg.decode(0, 0, 0);
    jpeg.close();
  }
  if (decoded) {
    scaleArtSource();
    toneSwapped(static_cast<uint16_t *>(artCanvas.getPointer()), CLASSIC_ART_W * CLASSIC_ART_H);
  }
  free(artSource);
  artSource = nullptr;
  return decoded;
}

// Draws the art at a quarter (or, with half set, half) of its size, centered and cropped to the box at (x, y).
bool drawArtThumb(int x, int y, int w, int h, bool half = false) {
  if (!openArt(pushArtBlock)) return false;
  const int scale = half ? 2 : 4;
  thumbShiftX = (w - FULL_ART_W / scale) / 2;
  thumbShiftY = (h - FULL_ART_H / scale) / 2;
  display.setViewport(x, y, w, h);
  const bool decoded = jpeg.decode(0, 0, half ? JPEG_SCALE_HALF : JPEG_SCALE_QUARTER);
  display.resetViewport();
  jpeg.close();
  return decoded;
}

// Light text with a dark outline, readable on any art. Uses the current text datum.
void drawOutlined(TFT_eSPI &out, const String &text, int x, int y, int font, uint16_t color) {
  out.setTextColor(TFT_BLACK);
  for (int dy = -1; dy <= 1; dy++) {
    for (int dx = -1; dx <= 1; dx++) {
      if (dx || dy) out.drawString(text, x + dx, y + dy, font);
    }
  }
  out.setTextColor(color);
  out.drawString(text, x, y, font);
}

// Button labels too wide for font 2 fall back to the small font.
int labelFont(const String &label, int maxW) {
  return display.textWidth(label, 2) <= maxW ? 2 : 1;
}

void drawOverlayControls(TFT_eSPI &out, uint16_t artColor, bool overArt) {
  // Over the art the glass dims what is under it; on a plain color it is a darker shade of it.
  const uint16_t glass = display.alphaBlend(120, TFT_BLACK, artColor);
  auto drawGlass = [&](int x, int y, int w, int h, int r) {
    if (overArt) {
      dimRoundRect(x, y, w, h, r, GLASS_KEEP);
    } else {
      out.fillRoundRect(x, y, w, h, r, glass);
    }
    out.drawRoundRect(x, y, w, h, r, GLASS_EDGE);
  };
  const int top = G.artY + OV_MARGIN;
  const int centerY = top + OV_BUTTON_H / 2;

  for (int slot = 0; slot < 4; slot++) drawGlass(overlaySlotX(G, slot), top, OV_BUTTON_W, OV_BUTTON_H, 6);
  out.setTextDatum(MC_DATUM);
  out.setTextColor(PARCHMENT);
  out.drawString("<", overlaySlotX(G, 0) + OV_BUTTON_W / 2, centerY, 2);
  out.drawString(">", overlaySlotX(G, 3) + OV_BUTTON_W / 2, centerY, 2);
  drawMenuIcon(out, overlaySlotX(G, 1) + OV_BUTTON_W / 2, centerY, PARCHMENT);
  drawSearchIcon(out, overlaySlotX(G, 2) + OV_BUTTON_W / 2, centerY, PARCHMENT);

  for (int side = 0; side < 2; side++) {
    int x = side == 0 ? G.artX + OV_BIG_INSET : G.artX + G.artW - OV_BIG_INSET;
    drawGlass(x - OV_BIG_R, G.countY - OV_BIG_R, 2 * OV_BIG_R + 1, 2 * OV_BIG_R + 1, OV_BIG_R);
    out.fillRect(x - 8, G.countY - 1, 17, 3, PARCHMENT);
    if (side == 1) out.fillRect(x - 1, G.countY - 8, 3, 17, PARCHMENT);
  }

  const int chipX = G.artX + (G.artW - OV_CHIP_W) / 2;
  const int chipY = G.groupY - OV_CHIP_H / 2;
  drawGlass(chipX, chipY, OV_CHIP_W, OV_CHIP_H, 11);
  const String label = modeLabel();
  out.setTextColor(HIGHLIGHT);
  out.drawString(label, chipX + OV_CHIP_W / 2, G.groupY, labelFont(label, OV_CHIP_W - 8));
}

bool tapGroupsVisible() {
  return screen == Screen::Card &&
         (states[selectedToken].count > 0 ||
          (mode == Mode::Quantity && (layout() != Layout::CardOnly || countFlash)));
}

void drawTapGroup(TFT_eSPI &out, int x, int count, bool tapped) {
  bool active = (mode == Mode::Tapped && tapped) ||
                (mode == Mode::Quantity && quantityTapped == tapped);
  uint16_t color = active ? HIGHLIGHT : PARCHMENT;
  int iconW = tapped ? 16 : 11;
  int iconH = tapped ? 11 : 16;
  int y = G.groupY;
  // Dark rims keep the card outline visible on light art.
  out.drawRoundRect(x - 1, y - iconH / 2 - 1, iconW + 2, iconH + 2, 3, TFT_BLACK);
  if (active) {
    out.fillRoundRect(x, y - iconH / 2, iconW, iconH, 2, HIGHLIGHT);
  } else {
    out.drawRoundRect(x, y - iconH / 2, iconW, iconH, 2, color);
    out.drawRoundRect(x + 1, y - iconH / 2 + 1, iconW - 2, iconH - 2, 1, TFT_BLACK);
  }
  out.setTextDatum(ML_DATUM);
  drawOutlined(out, String(count), x + iconW + 5, y, 2, color);
}

void drawArt() {
  const Token token = currentToken();
  const TokenState &state = states[selectedToken];
  const uint16_t artColor = display.alphaBlend(120, frameColor(styleOf(token)), TFT_BLACK);
  const bool composed = artCanvas.created();
  TFT_eSPI &out = composed ? static_cast<TFT_eSPI &>(artCanvas) : display;
  const int centerX = G.artX + G.artW / 2;

  if (composed) {
    if (!decodeArt()) artCanvas.fillSprite(artColor);
    // Darker top and bottom edges under the labels and controls.
    const int band = fullBleed() ? 34 : 28;
    dimBand(0, band, BAND_KEEP, 256);
    dimBand(G.artH - band, G.artH, 256, BAND_KEEP);
    // From here on the sprite is drawn in screen coordinates, like the rest of the card.
    artCanvas.setViewport(-G.artX, -G.artY, G.artX + G.artW, G.artY + G.artH);
  } else {
    display.fillRect(G.artX, G.artY, G.artW, G.artH, artColor);
  }

  // A single token (or none) leaves the art clear, except briefly after the quantity changes.
  const bool editingDrawing = screen == Screen::Drawing;
  const bool showCount = !editingDrawing && (state.count > 1 || countFlash);
  out.setTextDatum(TC_DATUM);
  if (showCount) drawOutlined(out, "IN PLAY", centerX, G.artY + (fullBleed() ? 5 : 6), 2, PARCHMENT);
  if (positionVisible && !editingDrawing) {
    size_t ordinal = 0;
    for (size_t i = 0; i <= selectedToken; ++i) if (deckBook.includes(i)) ++ordinal;
    String position = String(ordinal) + "/" + String(deckBook.count(TOKEN_COUNT));
    if (fullBleed()) {
      drawOutlined(out, position, centerX, G.artY + 22, 1, PARCHMENT);
    } else {
      out.setTextDatum(TR_DATUM);
      drawOutlined(out, position, G.artX + G.artW - 5, G.artY + 5, 1, PARCHMENT);
    }
  }
  out.setTextDatum(MC_DATUM);
  if (showCount) drawOutlined(out, String(state.count), centerX, G.countY, 7, PARCHMENT);

  if (tapGroupsVisible()) {
    drawTapGroup(out, G.groupLeftX, state.count - state.tapped, false);
    drawTapGroup(out, G.groupRightX, state.tapped, true);
  }
  if (!composed) display.setViewport(G.artX, G.artY, G.artW, G.artH, false);
  drawDoodle(out);
  if (!composed) display.resetViewport();
  if (fullBleed() && controlsVisible()) drawOverlayControls(out, artColor, composed);

  if (composed) {
    artCanvas.resetViewport();
    artCanvas.pushSprite(G.artX, G.artY);
  }
}

// Counters and modifiers share one line to the left of the P/T box.
void drawStatusLine(const TokenState &state) {
  String counters;
  String mods;
  if (state.counters != 0) {
    counters = state.counters >= 0 ? "+1/+1 x" : "-1/-1 x";
    counters += abs(state.counters);
  }
  if (state.powerMod != 0 || state.toughnessMod != 0 || mode == Mode::Power || mode == Mode::Toughness) {
    mods = "Mod " + signedText(state.powerMod) + "/" + signedText(state.toughnessMod);
  }

  int font = display.textWidth(counters + "  " + mods, 2) <= G.ptX - G.textX - 6 ? 2 : 1;
  int x = G.textX + 4;
  int y = G.statusY + (font == 2 ? 1 : 5);
  display.setTextDatum(TL_DATUM);
  display.setTextColor(CARD_INK, plateColor);
  if (counters.length()) {
    display.drawString(counters, x, y, font);
    x += display.textWidth(counters, font) + (font == 2 ? 10 : 6);
  }
  if (mods.length()) display.drawString(mods, x, y, font);
}

// What the selected token's "for each" ability adds right now, like "Rats +4/+4"; empty when nothing.
String scalingBonusText() {
  const Scaling scaling = scalingOf(currentToken());
  const int times = scaling.active ? scalingCount(scaling) : 0;
  if (!times) return String();
  return pluralType(scaling.what) + " " + signedText(scaling.power * times) + "/" +
         signedText(scaling.toughness * times);
}

bool hasKindCounters() {
  for (uint8_t value : states[selectedToken].kinds) {
    if (value) return true;
  }
  return false;
}

// Top of the badge row: above the status line on creatures, at the bottom of the text box otherwise.
int badgeRowY() {
  return currentToken().hasPT ? G.statusY - BADGE_H - 2 : G.textY + G.textH - BADGE_H - 3;
}

String badgeText(uint8_t kind, bool shortForm) {
  const uint8_t value = states[selectedToken].kinds[kind];
  String text = shortForm ? kindLabel(kind) : kindName(kind);
  if (!COUNTER_KINDS[kind].keyword || value > 1) text += " " + String(value);
  return text;
}

int badgeWidth(const String &text) {
  return display.textWidth(text, 1) + 6;
}

void drawBadge(int x, int y, const String &text, uint16_t fill, uint16_t ink) {
  display.fillRoundRect(x, y, badgeWidth(text), BADGE_H, 4, fill);
  display.setTextColor(ink, fill);
  display.drawString(text, x + 3, y + BADGE_H / 2, 1);
}

// One row of pills: the "for each" bonus first, then the token's other counters, in full words when
// they all fit. Whatever does not fit even in short form is summed up in a last "+N" pill.
void drawBadges(int y) {
  const TokenState &state = states[selectedToken];
  const String bonus = scalingBonusText();
  const bool food = markedFood(selectedToken);
  const int left = G.textX + 4;
  const int right = G.textX + G.textW - 4;
  display.setTextDatum(ML_DATUM);
  int remaining = 0;
  int fullWidth = -BADGE_GAP;
  for (int kind = -2; kind < KIND_COUNT; kind++) {
    if (kind == -2 ? !bonus.length() : kind == -1 ? !food : !state.kinds[kind]) continue;
    const String text = kind == -2 ? bonus : kind == -1 ? String("Food (Ygra)") : badgeText(kind, false);
    remaining++;
    fullWidth += badgeWidth(text) + BADGE_GAP;
  }
  const bool shortForm = fullWidth > right - left;
  int x = left;
  for (int kind = -2; kind < KIND_COUNT; kind++) {
    if (kind == -2 ? !bonus.length() : kind == -1 ? !food : !state.kinds[kind]) continue;
    const String text = kind == -2 ? bonus : kind == -1 ? String("Food (Ygra)") : badgeText(kind, shortForm);
    remaining--;
    // Each badge leaves room for the "+N" pill that would follow it.
    const int reserve = remaining ? badgeWidth("+" + String(remaining)) + BADGE_GAP : 0;
    if (x + badgeWidth(text) + reserve > right) {
      drawBadge(x, y, "+" + String(remaining + 1), HINT, INK);
      return;
    }
    const uint16_t fill = kind < 0 ? BONUS_PILL : COUNTER_KINDS[kind].keyword ? KEYWORD_PILL : COUNTER_PILL;
    drawBadge(x, y, text, fill, PARCHMENT);
    x += badgeWidth(text) + BADGE_GAP;
  }
}

void drawTextBox() {
  const Token token = currentToken();
  display.fillRect(G.textX, G.textY, G.textW, G.textH, plateColor);
  display.setTextDatum(TL_DATUM);
  if (selectedToken == CUSTOM_INDEX && token.text[0] == '\0') {
    display.setTextColor(HINT, plateColor);
    display.drawString("Tap here to edit", G.textX + 5, G.textY + 3, 2);
  }
  display.setTextColor(CARD_INK, plateColor);
  const bool badges = hasKindCounters() || scalingBonusText().length() || markedFood(selectedToken);
  int rulesH = token.hasPT ? G.textH - 26 : G.textH - 6;
  if (badges) rulesH = badgeRowY() - G.textY - 5;
  drawRulesText(token.text, rulesH);
  if (badges) drawBadges(badgeRowY());
  if (token.hasPT) drawStatusLine(states[selectedToken]);
}

String statLabel(int base, const char *symbol, int modifier) {
  if (!symbol) return String(base + modifier);
  return String(symbol) + (modifier ? signedText(modifier) : String());
}

String printedPT(const Token &token) {
  return statLabel(token.power, token.powerSymbol, 0) + "/" +
         statLabel(token.toughness, token.toughnessSymbol, 0);
}

// Unknown variable stats stay symbolic rather than pretending they are zero.
String ptLabel() {
  const Token token = currentToken();
  const TokenState &state = states[selectedToken];
  int powerMod = state.counters + state.powerMod;
  int toughnessMod = state.counters + state.toughnessMod;
  const Scaling scaling = scalingOf(token);
  if (scaling.active) {
    const int times = scalingCount(scaling);
    powerMod += scaling.power * times;
    toughnessMod += scaling.toughness * times;
  }
  return statLabel(token.power, token.powerSymbol, powerMod) + "/" +
         statLabel(token.toughness, token.toughnessSymbol, toughnessMod);
}

void drawPT() {
  const Token token = currentToken();
  if (!token.hasPT) return;

  uint16_t border = (mode == Mode::Power || mode == Mode::Toughness) ? HIGHLIGHT : TFT_BLACK;
  display.fillRoundRect(G.ptX, G.ptY, PT_W, PT_H, 5, plateColor);
  display.drawRoundRect(G.ptX, G.ptY, PT_W, PT_H, 5, border);
  display.drawRoundRect(G.ptX + 1, G.ptY + 1, PT_W - 2, PT_H - 2, 4, border);

  const String label = ptLabel();
  int font = display.textWidth(label, 4) <= PT_W - 6 ? 4 : display.textWidth(label, 2) <= PT_W - 6 ? 2 : 1;
  display.setTextDatum(MC_DATUM);
  display.setTextColor(CARD_INK, plateColor);
  if (display.textWidth(label, font) <= PT_W - 6) {
    display.drawString(label, G.ptX + PT_W / 2, G.ptY + PT_H / 2 + 1, font);
  } else {
    const size_t slash = strchr(label.c_str(), '/') - label.c_str();
    display.drawString(label.substring(0, slash), G.ptX + PT_W / 2, G.ptY + 8, 1);
    display.drawString(label.substring(slash), G.ptX + PT_W / 2, G.ptY + 18, 1);
  }
}

// The P/T box overlaps the text box, so it must be drawn after it.
void drawCardValues() {
  drawArt();
  drawTextBox();
  drawPT();
  // Ink outside the art only shows when doodles may cover the whole card; it stays stored either way.
  if (drawArtOnly()) return;
  display.setViewport(G.cardX, G.cardY, G.cardW, G.artY - G.cardY, false);
  drawDoodle(display);
  display.setViewport(G.cardX, G.artY + G.artH, G.cardW, G.cardY + G.cardH - G.artY - G.artH, false);
  drawDoodle(display);
  display.setViewport(G.cardX, G.artY, G.artX - G.cardX, G.artH, false);
  drawDoodle(display);
  display.setViewport(G.artX + G.artW, G.artY, G.cardX + G.cardW - G.artX - G.artW, G.artH, false);
  drawDoodle(display);
  display.resetViewport();
}

// Long type lines (Enchantment Artifact Creature - Golem) wrap onto two lines of the small font.
void drawTypeLine(const char *type) {
  const int x = G.plateX + 6;
  const int maxW = G.plateW - 12;
  display.setTextColor(CARD_INK, plateColor);
  int font = display.textWidth(type, 2) <= maxW ? 2 : 1;
  if (display.textWidth(type, font) <= maxW) {
    display.setTextDatum(ML_DATUM);
    display.drawString(type, x, G.typeY + G.typeH / 2, font);
  } else {
    display.setTextDatum(TL_DATUM);
    wrapText(type, 1, x, G.typeY + 3, maxW, 9, 2, true);
  }
}

// The illustrator's name under the text box, where a real card prints it.
void drawArtistCredit(const ColorStyle &style) {
  if (selectedToken == CUSTOM_INDEX) return;
  const char *name = sdArtists[selectedToken - 1];
#if HAS_TOKEN_ART
  if (!name) name = TOKEN_ART[selectedToken - 1].artist;
#endif
  String artist = name ? name : "";
  if (artist.length() == 0) return;
  const int x = G.textX + 2;
  const int y = G.textY + G.textH + 1;
  const int maxW = (currentToken().hasPT ? G.ptX - 4 : G.textX + G.textW) - x - 10;
  if (display.textWidth(artist, 1) > maxW) {
    while (artist.length() > 1 && display.textWidth(artist + ".", 1) > maxW) artist.remove(artist.length() - 1);
    artist += ".";
  }
  // A little paintbrush, as on the cards.
  display.drawLine(x + 6, y, x + 3, y + 3, style.pipInk);
  display.drawLine(x + 7, y + 1, x + 4, y + 4, style.pipInk);
  display.fillRect(x + 1, y + 4, 3, 2, style.pipInk);
  display.drawPixel(x, y + 6, style.pipInk);
  display.setTextDatum(TL_DATUM);
  display.setTextColor(style.pipInk, frameColor(style));
  display.drawString(artist, x + 10, y, 1);
}

void drawCard() {
  const Token token = currentToken();
  const ColorStyle &style = styleOf(token);
  display.fillRoundRect(G.cardX, G.cardY, G.cardW, G.cardH, G.radius, TFT_BLACK);
  display.fillRoundRect(G.cardX + G.inset, G.cardY + G.inset, G.cardW - 2 * G.inset, G.cardH - 2 * G.inset,
                        G.frameRadius, frameColor(style));

  display.fillRoundRect(G.plateX, G.titleY, G.plateW, G.titleH, 4, plateColor);
  display.setTextColor(CARD_INK, plateColor);
  display.setTextDatum(ML_DATUM);
  int nameFont = display.textWidth(token.name, 2) <= G.plateW - 32 ? 2 : 1;
  display.drawString(fitLabel(token.name, G.plateW - 32, nameFont), G.plateX + 6, G.titleY + G.titleH / 2, nameFont);
  drawManaSymbol(G.plateX + G.plateW - 13, G.titleY + G.titleH / 2, 9, static_cast<uint8_t>(token.color), TFT_BLACK,
                 true);

  display.fillRoundRect(G.plateX, G.typeY, G.plateW, G.typeH, 4, plateColor);
  drawTypeLine(effectiveType(selectedToken).c_str());
  drawArtistCredit(style);

  drawCardValues();
}

void drawButton(int index, const String &label, uint16_t color) {
  int x = 1 + index * BUTTON_STEP;
  display.fillRoundRect(x, BAR_Y, BUTTON_W, BUTTON_H, 4, PANEL);
  display.drawRoundRect(x, BAR_Y, BUTTON_W, BUTTON_H, 4, 0x7BEF);
  display.setTextDatum(MC_DATUM);
  display.setTextColor(color, PANEL);
  display.drawString(label, x + BUTTON_W / 2, BAR_Y + BUTTON_H / 2, labelFont(label, BUTTON_W - 4));
}

// The full-screen layouts have no bar: their controls float over the art.
void drawControls() {
  if (fullBleed()) return;
  drawButton(0, "<", INK);
  drawButton(1, "-", INK);
  drawButton(2, modeLabel(), HIGHLIGHT);
  drawButton(3, "+", INK);
  drawButton(4, ">", INK);
}

void drawDoodlePalette() {
  display.fillRoundRect(PALETTE_X, PALETTE_Y, PALETTE_W, PALETTE_H, 6, BACKGROUND);
  display.drawRoundRect(PALETTE_X, PALETTE_Y, PALETTE_W, PALETTE_H, 6, HINT);
  for (int i = 0; i < 8; i++) {
    const int x = PALETTE_X + PALETTE_COLOR_W / 2 + i * PALETTE_COLOR_W, y = PALETTE_Y + 23;
    display.fillCircle(x, y, 10, DOODLE_COLORS[i]);
    display.drawCircle(x, y, 13, !doodleEraser && doodleColor == i ? HIGHLIGHT : HINT);
  }
  display.setTextDatum(MC_DATUM);
  const uint16_t dot = doodleEraser || DOODLE_COLORS[doodleColor] == TFT_BLACK ? INK : DOODLE_COLORS[doodleColor];
  for (int i = 0; i < 4; i++) {
    const int x = PALETTE_X + PALETTE_BRUSH_W / 2 + i * PALETTE_BRUSH_W, y = PALETTE_SPLIT_Y + 20;
    const bool selected = i == 3 ? doodleEraser : !doodleEraser && doodleBrush == i;
    display.drawRoundRect(x - 25, y - 16, 50, 32, 5, selected ? HIGHLIGHT : HINT);
    if (i < 3) {
      display.fillCircle(x, y, DOODLE_RADII[i] + 1, dot);
    } else {
      display.setTextColor(selected ? HIGHLIGHT : INK, BACKGROUND);
      display.drawString("ERASE", x, y, 1);
    }
  }
}

void drawScreen() {
  loadDoodle();
  display.fillScreen(BACKGROUND);
  drawCard();
  if (screen == Screen::Drawing) {
    drawButton(0, "BACK", INK);
    drawButton(1, doodleEraser ? "ERASE" : "PEN",
               doodleEraser || DOODLE_COLORS[doodleColor] == TFT_BLACK ? HINT : DOODLE_COLORS[doodleColor]);
    drawButton(2, "UNDO", INK);
    drawButton(3, "CLEAR", INK);
    drawButton(4, "SAVE", drawStore() == DrawStore::Ram ? HINT : HIGHLIGHT);
    if (doodlePalette) drawDoodlePalette();
    return;
  }
  drawControls();
  if (!fullBleed()) {
    // The card leaves a margin on each side for the menu and search icons.
    drawMenuIcon(display, G.cardX / 2, 16, HINT);
    drawSearchIcon(display, SCREEN_W - G.cardX / 2 - 1, 16, HINT);
  }
}

bool containsWord(const char *text, const char *word, size_t length) {
  for (; *text; text++) {
    size_t i = 0;
    while (i < length && text[i] &&
           tolower(static_cast<unsigned char>(text[i])) == tolower(static_cast<unsigned char>(word[i]))) {
      i++;
    }
    if (i == length) return true;
  }
  return false;
}

// Every word of the query must appear (in any order, ignoring case) in the name, type line, rules
// text, color name or the printed power/toughness such as "3/3".
bool matchesQuery(size_t index, const char *query) {
  const Token token = tokenAt(index);
  const String powerToughness = token.hasPT ? printedPT(token) : String();
  const String type = effectiveType(index);
  const char *fields[] = {token.name, type.c_str(), token.text, COLOR_NAMES[static_cast<uint8_t>(token.color)],
                          powerToughness.c_str()};
  while (*query) {
    if (*query == ' ') {
      query++;
      continue;
    }
    size_t length = strcspn(query, " ");
    bool found = false;
    for (const char *field : fields) {
      if (containsWord(field, query, length)) {
        found = true;
        break;
      }
    }
    if (!found) return false;
    query += length;
  }
  return true;
}

size_t countMatches(const char *query) {
  size_t count = 0;
  for (size_t i = 0; i < TOKEN_COUNT; i++) {
    if ((editingDeckTokens || deckBook.includes(i)) && matchesQuery(i, query)) count++;
  }
  return count;
}

void rebuildMatches() {
  matchCount = 0;
  for (size_t i = 0; i < TOKEN_COUNT; i++) {
    if ((editingDeckTokens || deckBook.includes(i)) && matchesQuery(i, searchQuery)) matches[matchCount++] = i;
  }
}

void clearSearch() {
  searchQuery[0] = '\0';
  rebuildMatches();
}

// Every word of the query must appear in the precon's name, set code or release year.
bool preconMatchesQuery(size_t index, const char *query) {
  const PreconDeck &precon = PRECONS[index];
  char year[6];
  snprintf(year, sizeof(year), "%u", precon.year);
  const char *fields[] = {precon.name, precon.code, year};
  while (*query) {
    if (*query == ' ') {
      query++;
      continue;
    }
    const size_t length = strcspn(query, " ");
    bool found = false;
    for (const char *field : fields) found = found || containsWord(field, query, length);
    if (!found) return false;
    query += length;
  }
  return true;
}

void rebuildPreconMatches() {
  preconMatchCount = 0;
  for (size_t i = 0; i < PRECON_COUNT; i++)
    if (preconMatchesQuery(i, preconQuery)) preconMatches[preconMatchCount++] = i;
  preconPage = 0;
}

size_t preconPageCount() {
  const size_t pages = (preconMatchCount + ROWS_PER_PAGE - 1) / ROWS_PER_PAGE;
  return pages ? pages : 1;
}

// The deck slot holding this precon (matched by its possibly shortened name), or MAX_DECKS.
uint8_t preconSlot(size_t index) {
  char name[tabletop::DECK_NAME_LIMIT + 1];
  strlcpy(name, PRECONS[index].name, sizeof(name));
  for (uint8_t slot = 0; slot < tabletop::MAX_DECKS; ++slot)
    if (!strcmp(deckBook.decks[slot].name, name)) return slot;
  return tabletop::MAX_DECKS;
}

uint8_t freeDeckSlot() {
  uint8_t slot = 0;
  while (slot < tabletop::MAX_DECKS && deckBook.decks[slot].name[0]) ++slot;
  return slot;
}

// Copies a precon's tokens into a deck slot (replacing an earlier copy of it) and activates it.
bool importPrecon(size_t index) {
  uint8_t slot = preconSlot(index);
  if (slot == tabletop::MAX_DECKS) slot = freeDeckSlot();
  if (slot == tabletop::MAX_DECKS) return false;
  const PreconDeck &precon = PRECONS[index];
  tabletop::Deck deck;
  strlcpy(deck.name, precon.name, sizeof(deck.name));
  for (uint16_t i = 0; i < precon.count; ++i) {
    const uint16_t token = PRECON_TOKENS[precon.first + i];
    if (token < TOKEN_COUNT && !deck.contains(token)) deck.toggle(token);
  }
  deckBook.decks[slot] = deck;
  deckBook.active = slot + 1;
  scheduleTableSave();
  return true;
}

size_t pageCount() {
  size_t pages = (matchCount + ROWS_PER_PAGE - 1) / ROWS_PER_PAGE;
  return pages ? pages : 1;
}

void drawPicker() {
  display.fillScreen(BACKGROUND);
  display.setTextColor(INK, BACKGROUND);
  String pages = String(pickerPage + 1) + "/" + String(pageCount());
  if (searchQuery[0]) {
    display.setTextColor(HIGHLIGHT, BACKGROUND);
    display.setTextDatum(ML_DATUM);
    display.drawString(searchQuery, 8, 12, display.textWidth(searchQuery, 2) <= 170 ? 2 : 1);
    display.setTextColor(HINT, BACKGROUND);
    display.setTextDatum(MR_DATUM);
    display.drawString(pages, SCREEN_W - 8, 12, 2);
  } else {
    display.setTextDatum(MC_DATUM);
    const String title = editingDeckTokens ? "ADD/REMOVE " : deckBook.active ? "DECK TOKENS " : "SELECT TOKEN ";
    display.drawString(title + pages, SCREEN_W / 2, 12, 2);
  }

  if (matchCount == 0) {
    display.setTextDatum(MC_DATUM);
    display.setTextColor(HINT, BACKGROUND);
    display.drawString("No token matches", SCREEN_W / 2, LIST_Y + 60, 2);
    display.drawString("Press FIND to try again", SCREEN_W / 2, LIST_Y + 84, 2);
  }

  for (int row = 0; row < ROWS_PER_PAGE; row++) {
    size_t position = pickerPage * ROWS_PER_PAGE + row;
    if (position >= matchCount) break;
    size_t index = matches[position];
    const Token token = tokenAt(index);
    int y = LIST_Y + row * ROW_H;
    int centerY = y + ROW_H / 2;
    uint16_t rowColor = index == selectedToken ? PANEL_SELECTED : PANEL;
    display.fillRoundRect(4, y + 1, SCREEN_W - 8, ROW_H - 2, 4, rowColor);

    drawManaSymbol(18, centerY, 9, static_cast<uint8_t>(token.color), HINT);

    display.setTextDatum(ML_DATUM);
    display.setTextColor(INK, rowColor);
    int nameFont = display.textWidth(token.name, 2) <= 130 ? 2 : 1;
    display.drawString(fitLabel(token.name, 130, nameFont), 32, centerY, nameFont);

    display.setTextDatum(MR_DATUM);
    if (token.hasPT && !editingDeckTokens) {
      const String pt = printedPT(token);
      display.drawString(pt, SCREEN_W - 46, centerY, display.textWidth(pt, 2) <= 40 ? 2 : 1);
    }
    if (editingDeckTokens) {
      display.setTextColor(deckBook.includes(index) ? HIGHLIGHT : HINT, rowColor);
      display.drawString(deckBook.includes(index) ? "YES" : "-", SCREEN_W - 8, centerY, 1);
    } else if (states[index].count > 0) {
      display.setTextColor(HIGHLIGHT, rowColor);
      display.drawString("x" + String(states[index].count), SCREEN_W - 10, centerY, 2);
    }
  }

  drawButton(0, "<", INK);
  drawButton(1, "FIND", searchQuery[0] ? HIGHLIGHT : INK);
  drawButton(2, "BACK", INK);
  drawButton(3, "DECKS", HIGHLIGHT);
  drawButton(4, ">", INK);
}

// A quarter-scale sketch of the card screen, drawn from the real geometry so it always matches.
void drawLayoutThumb(int x, int y, Layout which) {
  const Geometry &g = which == Layout::Classic ? CLASSIC_GEO : FULL_GEO;
  const ColorStyle &style = styleOf(currentToken());
  const uint16_t frame = frameColor(style);
  const uint16_t artColor = display.alphaBlend(120, frame, TFT_BLACK);
  auto sx = [x](int value) { return x + value / 4; };
  auto sy = [y](int value) { return y + value / 4; };

  display.fillRect(x, y, THUMB_W, THUMB_H, BACKGROUND);
  display.fillRoundRect(sx(g.cardX), sy(g.cardY), g.cardW / 4, g.cardH / 4, 3, TFT_BLACK);
  display.fillRoundRect(sx(g.cardX + g.inset), sy(g.cardY + g.inset), (g.cardW - 2 * g.inset) / 4,
                        (g.cardH - 2 * g.inset) / 4, 2, frame);
  display.fillRect(sx(g.plateX), sy(g.titleY), g.plateW / 4, g.titleH / 4, plateColor);
  if (!drawArtThumb(sx(g.artX), sy(g.artY), g.artW / 4, g.artH / 4)) {
    display.fillRect(sx(g.artX), sy(g.artY), g.artW / 4, g.artH / 4, artColor);
  }
  display.fillRect(sx(g.plateX), sy(g.typeY), g.plateW / 4, g.typeH / 4, plateColor);
  display.fillRect(sx(g.textX), sy(g.textY), g.textW / 4, g.textH / 4, plateColor);
  display.fillRect(sx(g.ptX), sy(g.ptY), PT_W / 4, PT_H / 4, plateColor);
  display.drawRect(sx(g.ptX), sy(g.ptY), PT_W / 4, PT_H / 4, TFT_BLACK);
  display.fillRect(sx(g.artX + g.artW / 2) - 2, sy(g.countY) - 4, 4, 8, PARCHMENT);

  if (which == Layout::Classic) {
    for (int i = 0; i < 5; i++) {
      display.fillRect(sx(1 + i * BUTTON_STEP), sy(BAR_Y), BUTTON_W / 4, BUTTON_H / 4, PANEL);
      display.drawRect(sx(1 + i * BUTTON_STEP), sy(BAR_Y), BUTTON_W / 4, BUTTON_H / 4, HINT);
    }
  } else if (which == Layout::Overlay) {
    const uint16_t glass = display.alphaBlend(120, TFT_BLACK, artColor);
    for (int slot = 0; slot < 4; slot++) {
      display.fillRect(sx(overlaySlotX(g, slot)), sy(g.artY + OV_MARGIN), OV_BUTTON_W / 4, OV_BUTTON_H / 4, glass);
    }
    display.fillCircle(sx(g.artX + OV_BIG_INSET), sy(g.countY), OV_BIG_R / 4, glass);
    display.fillCircle(sx(g.artX + g.artW - OV_BIG_INSET), sy(g.countY), OV_BIG_R / 4, glass);
    display.fillRoundRect(sx(g.artX + (g.artW - OV_CHIP_W) / 2), sy(g.groupY - OV_CHIP_H / 2), OV_CHIP_W / 4,
                          OV_CHIP_H / 4, 2, glass);
  }
}

void drawStepButton(int x, int y, const char *label) {
  display.fillRoundRect(x, y, SET_STEP_W, SET_ROW_H, 6, PANEL_SELECTED);
  display.setTextDatum(MC_DATUM);
  display.setTextColor(INK, PANEL_SELECTED);
  display.drawString(label, x + SET_STEP_W / 2, y + SET_ROW_H / 2, 4);
}

void drawSettingsPanel(int y, int height, const char *label) {
  display.fillRoundRect(SET_X, y, SET_W, height, 4, PANEL);
  display.setTextDatum(TL_DATUM);
  display.setTextColor(HINT, PANEL);
  display.drawString(label, SET_X + 6, y + 5, 1);
}

void drawBrightnessPanel() {
  drawSettingsPanel(SET_BRIGHTNESS_Y, SET_PANEL_H, "BRIGHTNESS");
  display.setTextDatum(TR_DATUM);
  display.setTextColor(INK, PANEL);
  display.drawString(String(config.brightness * 100 / BRIGHTNESS_LEVELS) + "%", SET_X + SET_W - 6,
                     SET_BRIGHTNESS_Y + 3, 2);

  const int rowY = SET_BRIGHTNESS_Y + SET_ROW_TOP;
  drawStepButton(SET_X + 4, rowY, "-");
  drawStepButton(SET_X + SET_W - 4 - SET_STEP_W, rowY, "+");
  // Rising bars, like a signal meter.
  for (int i = 0; i < BRIGHTNESS_LEVELS; i++) {
    int height = 8 + 3 * i;
    display.fillRect(SET_BAR_X + i * SET_BAR_STEP, rowY + SET_ROW_H - 1 - height, SET_BAR_W, height,
                     i < config.brightness ? HIGHLIGHT : PANEL_SELECTED);
  }
}

void drawTimeoutPanel() {
  drawSettingsPanel(SET_TIMEOUT_Y, SET_PANEL_H, "SCREEN OFF AFTER");
  const int rowY = SET_TIMEOUT_Y + SET_ROW_TOP;
  drawStepButton(SET_X + 4, rowY, "-");
  drawStepButton(SET_X + SET_W - 4 - SET_STEP_W, rowY, "+");
  display.setTextDatum(MC_DATUM);
  display.setTextColor(config.timeout == TIMEOUT_COUNT - 1 ? INK : HIGHLIGHT, PANEL);
  display.drawString(TIMEOUT_LABELS[config.timeout], SCREEN_W / 2, rowY + SET_ROW_H / 2, 4);
}

void drawLayoutPanel() {
  drawSettingsPanel(SET_LAYOUT_Y, SET_LAYOUT_H, "LAYOUT");
  const int y = SET_LAYOUT_Y + 17;
  for (int i = 0; i < LAYOUT_COUNT; i++) {
    const int x = SET_X + 8 + i * THUMB_STEP;
    const bool selected = i == config.layout;
    drawLayoutThumb(x, y, static_cast<Layout>(i));
    if (selected) {
      display.drawRoundRect(x - 3, y - 3, THUMB_W + 6, THUMB_H + 6, 3, HIGHLIGHT);
      display.drawRoundRect(x - 2, y - 2, THUMB_W + 4, THUMB_H + 4, 3, HIGHLIGHT);
    } else {
      display.drawRect(x - 1, y - 1, THUMB_W + 2, THUMB_H + 2, HINT);
    }
    display.setTextDatum(TC_DATUM);
    display.setTextColor(selected ? HIGHLIGHT : INK, PANEL);
    display.drawString(LAYOUT_LABELS[i], x + THUMB_W / 2, y + THUMB_H + 6, 1);
  }
}

// A small card in the current tone: the token's frame, art and a plate with its name.
void drawTonePreview(int x, int y) {
  const Token token = currentToken();
  const int artX = x + SET_PREVIEW_PAD;
  const int artY = y + SET_PREVIEW_PAD;
  const int plateY = artY + SET_PREVIEW_ART_H + 3;

  display.fillRoundRect(x, y, SET_PREVIEW_W, SET_PREVIEW_H, 5, TFT_BLACK);
  display.fillRoundRect(x + 1, y + 1, SET_PREVIEW_W - 2, SET_PREVIEW_H - 2, 4, frameColor(styleOf(token)));
  if (!drawArtThumb(artX, artY, SET_PREVIEW_ART_W, SET_PREVIEW_ART_H, true)) {
    // Without art, a gray ramp shows the curve.
    for (int i = 0; i < SET_PREVIEW_ART_W; i++) {
      const uint16_t v = i * 31 / (SET_PREVIEW_ART_W - 1);
      display.drawFastVLine(artX + i, artY, SET_PREVIEW_ART_H, toneColor((v << 11) | (v << 6) | v));
    }
  }
  display.fillRoundRect(artX, plateY, SET_PREVIEW_ART_W, SET_PREVIEW_PLATE_H, 3, plateColor);
  String name = token.name;
  while (name.length() > 1 && display.textWidth(name, 1) > SET_PREVIEW_ART_W - 10) name.remove(name.length() - 1);
  display.setTextDatum(ML_DATUM);
  display.setTextColor(CARD_INK, plateColor);
  display.drawString(name, artX + 5, plateY + SET_PREVIEW_PLATE_H / 2, 1);
}

void drawTonePanel() {
  drawSettingsPanel(SET_TONE_Y, SET_TONE_H, "CARD TONE");
  display.setTextDatum(TR_DATUM);
  display.setTextColor(config.tone == 0 ? INK : HIGHLIGHT, PANEL);
  char level[12] = "ORIGINAL";
  if (config.tone > 0) snprintf(level, sizeof(level), "DARKER %d", config.tone);
  display.drawString(level, SET_X + SET_W - 6, SET_TONE_Y + 3, 2);

  const int previewY = SET_TONE_Y + SET_PREVIEW_TOP;
  const int rowY = previewY + (SET_PREVIEW_H - SET_ROW_H) / 2;
  drawStepButton(SET_X + 4, rowY, "-");
  drawStepButton(SET_X + SET_W - 4 - SET_STEP_W, rowY, "+");
  drawTonePreview((SCREEN_W - SET_PREVIEW_W) / 2, previewY);
}

void drawScreenPanel() {
  drawSettingsPanel(SET_SCREEN_Y, SET_PANEL_H, "SCREEN");
  const int rowY = SET_SCREEN_Y + SET_ROW_TOP;
  const int w = (SET_W - 12) / 2;
  for (int i = 0; i < 2; i++) {
    const int x = SET_X + 4 + i * (w + 4);
    const bool selected = config.flipped == i;
    const uint16_t fill = selected ? HIGHLIGHT : PANEL_SELECTED;
    display.fillRoundRect(x, rowY, w, SET_ROW_H, 6, fill);
    display.setTextDatum(MC_DATUM);
    display.setTextColor(selected ? TFT_BLACK : INK, fill);
    display.drawString(i ? "FLIPPED" : "NORMAL", x + w / 2, rowY + SET_ROW_H / 2, 2);
  }
}

void drawTips(const char *const *tips, int count, int y) {
  display.setTextDatum(TC_DATUM);
  display.setTextColor(HINT, BACKGROUND);
  for (int i = 0; i < count; i++) display.drawString(tips[i], SCREEN_W / 2, y + i * 16, 2);
}

void drawScreenTips() {
  static const char *const TIPS[] = {"Board lying flat? Flip the screen", "and turn the board around."};
  drawTips(TIPS, 2, SET_TIPS_Y);
}

void drawGammaPanel() {
  const bool recommended = config.gammaMode == 0;
  drawSettingsPanel(SET_GAMMA_Y, SET_PANEL_H, "DISPLAY GAMMA");
  display.setTextDatum(TR_DATUM);
  display.setTextColor(recommended ? INK : HIGHLIGHT, PANEL);
  display.drawString(String(config.gammaMode + 1) + "/" + String(GAMMA_COUNT), SET_X + SET_W - 6, SET_GAMMA_Y + 3, 2);

  const int rowY = SET_GAMMA_Y + SET_ROW_TOP;
  drawStepButton(SET_X + 4, rowY, "-");
  drawStepButton(SET_X + SET_W - 4 - SET_STEP_W, rowY, "+");
  display.setTextDatum(MC_DATUM);
  display.setTextColor(recommended ? INK : HIGHLIGHT, PANEL);
  display.drawString(GAMMA_PROFILES[config.gammaMode].label, SCREEN_W / 2, rowY + SET_ROW_H / 2, 2);
}

// Ramps from black to the full color, straight from the display with no tone. On a panel with a good
// gamma every step differs from its neighbors and the first ones are dark.
void drawRampPanel() {
  drawSettingsPanel(SET_RAMP_Y, SET_RAMP_H, "TEST RAMPS");
  const int left = SET_X + (SET_W - RAMP_STEPS * RAMP_PATCH_W) / 2;
  for (int row = 0; row < RAMP_ROWS; row++) {
    const int y = SET_RAMP_Y + RAMP_TOP + row * (RAMP_PATCH_H + RAMP_GAP);
    for (int step = 0; step < RAMP_STEPS; step++) {
      const uint8_t level = step * 255 / (RAMP_STEPS - 1);
      const uint8_t red = row <= 1 ? level : 0;
      const uint8_t green = row == 0 || row == 2 ? level : 0;
      const uint8_t blue = row == 0 || row == 3 ? level : 0;
      display.fillRect(left + step * RAMP_PATCH_W, y, RAMP_PATCH_W, RAMP_PATCH_H, display.color565(red, green, blue));
    }
  }
}

void drawGammaTips() {
  static const char *const TIPS[] = {"Colors still washed out? Try the", "other options: every step of the",
                                     "ramps should look different.", "Looks negative? Go back to 1/3."};
  drawTips(TIPS, 4, SET_GAMMA_TIPS_Y);
}

// A row of options, one of them chosen, like the SCREEN panel.
void drawChoicePanel(int y, const char *title, const char *const *labels, int count, int selected) {
  drawSettingsPanel(y, SET_PANEL_H, title);
  const int rowY = y + SET_ROW_TOP;
  const int w = (SET_W - 4 - 4 * count) / count;
  for (int i = 0; i < count; i++) {
    const int x = SET_X + 4 + i * (w + 4);
    const uint16_t fill = i == selected ? HIGHLIGHT : PANEL_SELECTED;
    display.fillRoundRect(x, rowY, w, SET_ROW_H, 6, fill);
    display.setTextDatum(MC_DATUM);
    display.setTextColor(i == selected ? TFT_BLACK : INK, fill);
    display.drawString(labels[i], x + w / 2, rowY + SET_ROW_H / 2, 2);
  }
}

int choiceAt(int x, int count) {
  return constrain((x - SET_X - 4) * count / (SET_W - 4), 0, count - 1);
}

void drawDoodlePanels() {
  static const char *const AREAS[] = {"ART ONLY", "WHOLE CARD"};
  static const char *const OPENERS[] = {"BUTTON", "HOLD ART", "BOTH"};
  static const char *const STORES[] = {"RAM", "FLASH", "SD CARD"};
  drawChoicePanel(SET_DRAW_AREA_Y, "DOODLE AREA", AREAS, 2, config.drawArea);
  drawChoicePanel(SET_DRAW_OPEN_Y, "START DRAWING WITH", OPENERS, 3, config.drawOpen);
  drawChoicePanel(SET_DRAW_STORE_Y, "SAVE DOODLES TO", STORES, 3, config.drawStore);

  static const char *const OPEN_TIPS[] = {"DRAW button on the counters page.", "Hold the art for a second.",
                                          "Hold the art, or counters DRAW."};
  static const char *const STORE_TIPS[] = {"RAM: doodles are gone on restart.", "FLASH: kept inside the board.",
                                           "SD: kept in /doodles on the card."};
  const bool noCard = drawStore() == DrawStore::Sd && !sdMounted();
  display.fillRect(0, SET_DRAW_TIPS_Y, SCREEN_W, 34, BACKGROUND);
  display.setTextDatum(TC_DATUM);
  display.setTextColor(HINT, BACKGROUND);
  display.drawString(OPEN_TIPS[config.drawOpen], SCREEN_W / 2, SET_DRAW_TIPS_Y, 2);
  display.setTextColor(noCard ? HIGHLIGHT : HINT, BACKGROUND);
  display.drawString(noCard ? "No SD card: insert it, restart." : STORE_TIPS[config.drawStore], SCREEN_W / 2,
                     SET_DRAW_TIPS_Y + 16, 2);
}

// Settings pages 0-1 are global; 2-4 belong to the token card and open from its menu.
int settingsKind() {
  return cardOptions ? SETTINGS_PAGES + settingsPage : settingsPage;
}

void drawSettings() {
  display.fillScreen(BACKGROUND);
  display.setTextDatum(MC_DATUM);
  display.setTextColor(INK, BACKGROUND);
  char title[24];
  snprintf(title, sizeof(title), "%s %d/%d", cardOptions ? "CARD OPTIONS" : "SETTINGS", settingsPage + 1,
           cardOptions ? CARD_PAGES : SETTINGS_PAGES);
  display.drawString(title, SCREEN_W / 2, 12, 2);
  if (const char *sd = sdArtLabel()) {
    display.setTextDatum(TR_DATUM);
    display.setTextColor(sdArt == SdArt::Ready ? HINT : HIGHLIGHT, BACKGROUND);
    display.drawString(sd, SCREEN_W - 4, 8, 1);
  }
  switch (settingsKind()) {
    case 0:
      drawBrightnessPanel();
      drawTimeoutPanel();
      drawScreenPanel();
      drawScreenTips();
      break;
    case 1:
      drawGammaPanel();
      drawRampPanel();
      drawGammaTips();
      break;
    case 2:
      drawLayoutPanel();
      break;
    case 3: {
      static const char *const TIPS[] = {"Board lying flat? A darker tone", "brings the colors back."};
      drawTonePanel();
      drawTips(TIPS, 2, SET_TONE_TIPS_Y);
      break;
    }
    default:
      drawDoodlePanels();
      break;
  }
  drawButton(0, "<", INK);
  drawButton(2, "BACK", INK);
  drawButton(4, ">", INK);
}

void drawFieldRow(int y, const char *label, const char *value) {
  display.fillRoundRect(4, y, SCREEN_W - 8, EDIT_ROW_H, 4, PANEL);
  display.setTextDatum(TL_DATUM);
  display.setTextColor(HINT, PANEL);
  display.drawString(label, 10, y + 3, 1);
  display.setTextColor(INK, PANEL);
  int font = display.textWidth(value, 2) <= SCREEN_W - 20 ? 2 : 1;
  display.drawString(value, 10, y + 13, font);
}

void drawStatButton(int x, const char *label, uint16_t color) {
  display.fillRoundRect(x, EDIT_PT_Y + 3, STAT_BUTTON_W, EDIT_ROW_H - 6, 4, PANEL_SELECTED);
  display.setTextDatum(MC_DATUM);
  display.setTextColor(color, PANEL_SELECTED);
  display.drawString(label, x + STAT_BUTTON_W / 2, EDIT_PT_Y + EDIT_ROW_H / 2, 2);
}

void drawEditor() {
  display.fillScreen(BACKGROUND);
  display.setTextDatum(TC_DATUM);
  display.setTextColor(INK, BACKGROUND);
  display.drawString("EDIT CUSTOM TOKEN", SCREEN_W / 2, 5, 2);

  drawFieldRow(EDIT_NAME_Y, "NAME", draft.name);
  drawFieldRow(EDIT_TYPE_Y, "TYPE LINE", draft.type);

  int colorY = EDIT_COLOR_Y + EDIT_ROW_H / 2;
  display.fillRoundRect(4, EDIT_COLOR_Y, SCREEN_W - 8, EDIT_ROW_H, 4, PANEL);
  display.setTextDatum(ML_DATUM);
  display.setTextColor(HINT, PANEL);
  display.drawString("COLOR", 10, colorY, 1);
  for (int i = 0; i < COLOR_COUNT; i++) {
    int x = COLOR_PICK_X + i * COLOR_PICK_STEP;
    if (i == draft.color) display.fillCircle(x, colorY, 13, HIGHLIGHT);
    drawManaSymbol(x, colorY, 10, i, HINT);
  }

  int statY = EDIT_PT_Y + EDIT_ROW_H / 2;
  uint16_t statColor = draft.hasPT ? INK : HINT;
  display.fillRoundRect(4, EDIT_PT_Y, SCREEN_W - 8, EDIT_ROW_H, 4, PANEL);
  display.setTextDatum(ML_DATUM);
  display.setTextColor(draft.hasPT ? HIGHLIGHT : HINT, PANEL);
  display.drawString(draft.hasPT ? "P/T ON" : "P/T OFF", 10, statY, 2);
  drawStatButton(POWER_MINUS_X, "-", statColor);
  drawStatButton(POWER_PLUS_X, "+", statColor);
  drawStatButton(TOUGHNESS_MINUS_X, "-", statColor);
  drawStatButton(TOUGHNESS_PLUS_X, "+", statColor);
  display.setTextDatum(MC_DATUM);
  display.setTextColor(statColor, PANEL);
  display.drawNumber(draft.power, (POWER_MINUS_X + STAT_BUTTON_W + POWER_PLUS_X) / 2, statY, 2);
  display.drawString("/", (POWER_PLUS_X + STAT_BUTTON_W + TOUGHNESS_MINUS_X) / 2, statY, 2);
  display.drawNumber(draft.toughness, (TOUGHNESS_MINUS_X + STAT_BUTTON_W + TOUGHNESS_PLUS_X) / 2, statY, 2);

  display.fillRoundRect(4, EDIT_TEXT_Y, SCREEN_W - 8, EDIT_TEXT_H, 4, PANEL);
  display.setTextDatum(TL_DATUM);
  display.setTextColor(HINT, PANEL);
  display.drawString("ORACLE TEXT", 10, EDIT_TEXT_Y + 3, 1);
  display.setTextColor(INK, PANEL);
  wrapText(draft.text, 1, 10, EDIT_TEXT_Y + 15, SCREEN_W - 20, 10, (EDIT_TEXT_H - 18) / 10, true);

  drawButton(0, "BACK", INK);
  drawButton(4, "SAVE", HIGHLIGHT);
}

String keyLabel(char value) {
  switch (value) {
    case KEY_SHIFT:
      return "SHIFT";
    case KEY_DEL:
      return "DEL";
    case KEY_LAYER:
      return keyLayer == 0 ? "123" : "ABC";
    case KEY_RET:
      return editMultiline ? "RET" : "OK";
    case ' ':
      return "SPACE";
  }
  return String(static_cast<char>(keyShift ? toupper(value) : value));
}

void drawKeyboard() {
  display.fillRect(0, KEY_Y, SCREEN_W, KEY_ROWS * KEY_H, BACKGROUND);
  display.setTextDatum(MC_DATUM);
  for (int row = 0; row < KEY_ROWS; row++) {
    int x = 0;
    int y = KEY_Y + row * KEY_H;
    for (int col = 0; col < KEY_COLS && KEYBOARD[keyLayer][row][col].value; col++) {
      const Key &key = KEYBOARD[keyLayer][row][col];
      int width = key.units * KEY_UNIT;
      uint16_t fill = key.value <= ' ' ? PANEL_SELECTED : PANEL;
      display.fillRoundRect(x + 1, y + 1, width - 2, KEY_H - 2, 4, fill);
      display.setTextColor(key.value == KEY_SHIFT && keyShift ? HIGHLIGHT : INK, fill);
      String label = keyLabel(key.value);
      display.drawString(label, x + width / 2, y + KEY_H / 2, label.length() > 3 ? 1 : 2);
      x += width;
    }
  }
}

// Shows the end of the text with a cursor, scrolling once it no longer fits.
void drawEditBuffer() {
  display.fillRect(0, 0, SCREEN_W, KEY_Y, BACKGROUND);
  display.setTextDatum(TL_DATUM);
  display.setTextColor(HINT, BACKGROUND);
  display.drawString(String(editLabel) + "  " + String(strlen(editBuffer)) + "/" + String(editLimit), 8, 6, 2);
  if (keyboardFrom == Screen::Picker) {
    display.setTextDatum(TR_DATUM);
    display.setTextColor(HIGHLIGHT, BACKGROUND);
    display.drawString(String(countMatches(editBuffer)) + " found", SCREEN_W - 8, 6, 2);
  }
  display.fillRoundRect(4, 26, SCREEN_W - 8, KEY_Y - 30, 4, PARCHMENT);
  display.setTextColor(CARD_INK, PARCHMENT);
  display.setTextDatum(TL_DATUM);
  String shown = String(editBuffer) + "_";
  int lines = wrapText(shown.c_str(), 2, 10, 28, SCREEN_W - 20, 16, 0, false);
  wrapText(shown.c_str(), 2, 10, 28, SCREEN_W - 20, 16, BUFFER_LINES, true, max(0, lines - BUFFER_LINES));
}

// Special P/T rows come first, then counters, then the optional Ygra Food toggle.
constexpr int PLUS_ONE_ROW = -1;
constexpr int OUTSIDE_ROW = -2;
constexpr int FOOD_ROW = -3;

int counterRowCount() {
  const Token token = currentToken();
  return KIND_COUNT + (token.hasPT ? 1 : 0) + (scalingOf(token).active ? 1 : 0) +
         (typeIncludes(token.type, "Creature") ? 1 : 0);
}

size_t counterPageCount() {
  return (counterRowCount() + ROWS_PER_PAGE - 1) / ROWS_PER_PAGE;
}

// The counter kind of a row, or one of the special rows above.
int rowKind(int row) {
  const Token token = currentToken();
  if (token.hasPT && row-- == 0) return PLUS_ONE_ROW;
  if (scalingOf(token).active && row-- == 0) return OUTSIDE_ROW;
  if (row == KIND_COUNT) return FOOD_ROW;
  return row;
}

int counterValue(int kind) {
  const TokenState &state = states[selectedToken];
  if (kind == PLUS_ONE_ROW) return state.counters;
  if (kind == OUTSIDE_ROW) return outsideCards[selectedToken];
  if (kind == FOOD_ROW) return markedFood(selectedToken) ? 1 : 0;
  return state.kinds[kind];
}

void drawCounterButton(int x, int y, const char *label) {
  display.fillRoundRect(x, y + 3, COUNTER_BUTTON_W, ROW_H - 6, 4, BACKGROUND);
  display.setTextDatum(MC_DATUM);
  display.setTextColor(INK, BACKGROUND);
  display.drawString(label, x + COUNTER_BUTTON_W / 2, y + ROW_H / 2, 2);
}

void drawCounterRow(int row) {
  const int slot = row - static_cast<int>(counterPage) * ROWS_PER_PAGE;
  if (slot < 0 || slot >= ROWS_PER_PAGE) return;
  const int kind = rowKind(row);
  const int value = counterValue(kind);
  const int y = LIST_Y + slot * ROW_H;
  const int centerY = y + ROW_H / 2;
  const uint16_t fill = value ? PANEL_SELECTED : PANEL;
  display.fillRoundRect(4, y + 1, SCREEN_W - 8, ROW_H - 2, 4, fill);

  String label;
  if (kind == PLUS_ONE_ROW) {
    label = value < 0 ? "-1/-1" : "+1/+1";
  } else if (kind == OUTSIDE_ROW) {
    // Matching cards that are not tokens, like Vren for the Rats: "Rat cards".
    String what = pluralType(scalingOf(currentToken()).what);
    what.remove(what.length() - 1);
    label = what + " cards";
  } else if (kind == FOOD_ROW) {
    label = "Food (Ygra)";
  } else {
    label = kindName(kind);
  }
  display.setTextDatum(ML_DATUM);
  display.setTextColor(kind >= 0 && COUNTER_KINDS[kind].keyword ? 0xAEFF : INK, fill);
  display.drawString(label, 10, centerY, display.textWidth(label, 2) <= COUNTER_LABEL_END - 24 ? 2 : 1);
  if (kind == CUSTOM_KIND) {
    // A pencil: the name can be changed.
    const int x = COUNTER_LABEL_END - 12;
    display.drawLine(x, centerY + 4, x + 7, centerY - 3, HINT);
    display.drawLine(x + 1, centerY + 4, x + 8, centerY - 3, HINT);
    display.drawPixel(x, centerY + 5, HINT);
  }

  drawCounterButton(COUNTER_MINUS_X, y, "-");
  drawCounterButton(COUNTER_PLUS_X, y, "+");
  display.setTextDatum(MC_DATUM);
  display.setTextColor(value ? HIGHLIGHT : HINT, fill);
  display.drawNumber(abs(value), (COUNTER_MINUS_X + COUNTER_BUTTON_W + COUNTER_PLUS_X) / 2, centerY, 2);
}

void drawCounters() {
  display.fillScreen(BACKGROUND);
  const Token token = currentToken();
  display.setTextDatum(ML_DATUM);
  display.setTextColor(INK, BACKGROUND);
  const int nameFont = display.textWidth(token.name, 2) <= 130 ? 2 : 1;
  display.drawString(fitLabel(token.name, 130, nameFont), 8, 12, nameFont);
  display.setTextDatum(MR_DATUM);
  display.setTextColor(HINT, BACKGROUND);
  display.drawString("COUNTERS " + String(counterPage + 1) + "/" + String(counterPageCount()), SCREEN_W - 8, 12, 2);
  for (int row = counterPage * ROWS_PER_PAGE; row < counterRowCount(); row++) drawCounterRow(row);

  drawButton(0, "<", INK);
  if (config.drawOpen != static_cast<uint8_t>(DrawOpen::Hold)) drawButton(1, "DRAW", HIGHLIGHT);
  drawButton(2, "BACK", INK);
  drawButton(4, ">", INK);
}

void drawDrawingTools() {
  display.fillScreen(BACKGROUND);
  display.setTextDatum(TC_DATUM);
  display.setTextColor(INK, BACKGROUND);
  display.drawString("DOODLE TOOLS", SCREEN_W / 2, 8, 2);
  if (doodlePrompt != DoodlePrompt::None) {
    const bool clear = doodlePrompt == DoodlePrompt::Clear;
    display.drawString(clear ? "Clear this token's drawing?" : "Initialize drawing storage?", SCREEN_W / 2, 60, 2);
    display.setTextColor(HINT, BACKGROUND);
    display.drawString(clear ? "Temporary until you press SAVE." : "Formats only the drawing area.", SCREEN_W / 2, 94, 1);
    display.drawString(clear ? "Saved ink returns after reboot" : "Saved drawings there are erased.", SCREEN_W / 2, 112, 1);
    display.drawString(clear ? "unless you save the empty drawing." : "Token counts and SD are untouched.", SCREEN_W / 2, 130, 1);
    drawButton(0, "CANCEL", INK);
    drawButton(4, clear ? "CLEAR" : "INIT", HIGHLIGHT);
    return;
  }
  display.setTextColor(HINT, BACKGROUND);
  display.drawString("COLOR", SCREEN_W / 2, 38, 1);
  for (int i = 0; i < 8; i++) {
    const int x = 30 + (i % 4) * 60, y = 70 + (i / 4) * 44;
    display.fillCircle(x, y, 16, DOODLE_COLORS[i]);
    display.drawCircle(x, y, 19, doodleColor == i ? HIGHLIGHT : HINT);
  }
  display.setTextColor(HINT, BACKGROUND);
  display.drawString("BRUSH SIZE / ERASER", SCREEN_W / 2, 145, 1);
  for (int i = 0; i < 4; i++) {
    const int x = 30 + i * 60;
    const bool selected = i == 3 ? doodleEraser : !doodleEraser && doodleBrush == i;
    display.drawRoundRect(x - 25, 163, 50, 36, 5, selected ? HIGHLIGHT : HINT);
    if (i < 3) {
      display.fillCircle(x, 181, DOODLE_RADII[i], INK);
    } else {
      display.fillRoundRect(x - 12, 168, 24, 12, 3, TFT_PINK);
      display.setTextColor(selected ? HIGHLIGHT : INK, BACKGROUND);
      display.drawString("ERASE", x, 184, 1);
    }
  }
  const Doodle &drawing = doodles[selectedToken];
  display.setTextColor(INK, BACKGROUND);
  display.drawString(drawing.changed ? "SESSION CHANGES (not saved)" :
                     drawing.saved ? "SAVED DRAWING" : "TEMPORARY DRAWING", SCREEN_W / 2, 214, 1);
  display.setTextColor(HINT, BACKGROUND);
  display.drawString("BACK keeps ink for this session.", SCREEN_W / 2, 232, 1);
  switch (drawStore()) {
    case DrawStore::Ram:
      display.drawString("SAVE TO is RAM: lost on restart.", SCREEN_W / 2, 246, 1);
      break;
    case DrawStore::Flash:
      display.drawString("SAVE keeps it in flash.", SCREEN_W / 2, 246, 1);
      break;
    case DrawStore::Sd:
      display.drawString(sdMounted() ? "SAVE keeps it on the SD card." : "No SD card: insert, restart.",
                         SCREEN_W / 2, 246, 1);
      break;
  }
  display.setTextColor(HIGHLIGHT, BACKGROUND);
  display.drawString(doodleMessage, SCREEN_W / 2, 263, 1);
  drawButton(0, "BACK", INK);
  drawButton(4, "SAVE", drawStore() == DrawStore::Ram ? HINT : HIGHLIGHT);
}

// Every screen change waits for the finger to lift, so the press that caused it cannot also hit a
// control of the new screen.
void navigate(Screen next) {
  screen = next;
  awaitRelease = true;
}

bool ensureDeckToken() {
  if (!deckBook.count(TOKEN_COUNT)) {
    tableMessage = "Empty deck: EDIT to add tokens";
    showTablePage(Screen::Decks);
    return false;
  }
  if (!deckBook.includes(selectedToken)) selectedToken = deckBook.next(selectedToken, 1, TOKEN_COUNT);
  return true;
}

void showCard() {
  if (!ensureDeckToken()) return;
  navigate(Screen::Card);
  if (G.cardW != (fullBleed() ? FULL_GEO.cardW : CLASSIC_GEO.cardW)) applyLayout();
  overlaysVisible = true;
  validateMode();
  drawScreen();
}

void openDrawing() {
  if (!ensureDeckToken()) return;
  doodleDown = false;
  doodlePalette = false;
  doodlePrompt = DoodlePrompt::None;
  doodleMessage = "";
  loadDoodle();
  navigate(Screen::Drawing);
  applyLayout();
  drawScreen();
}

void openDrawingTools(DoodlePrompt prompt = DoodlePrompt::None) {
  doodleDown = false;
  doodlePalette = false;
  doodlePrompt = prompt;
  navigate(Screen::DrawingTools);
  drawDrawingTools();
}

void requestDoodleSave() {
  if (drawStore() == DrawStore::Flash && !doodleStorageReady) {
    openDrawingTools(DoodlePrompt::Initialize);
    return;
  }
  saveDoodle();
  openDrawingTools();
}

void openCounters() {
  counterPage = 0;
  navigate(Screen::Counters);
  drawCounters();
}

void openPicker() {
  editingDeckTokens = false;
  navigate(Screen::Picker);
  clearSearch();
  pickerPage = 0;
  for (size_t i = 0; i < matchCount; ++i)
    if (matches[i] == selectedToken) pickerPage = i / ROWS_PER_PAGE;
  drawPicker();
}

void openEditor() {
  draft = custom;
  navigate(Screen::Editor);
  drawEditor();
}

void openSettings(bool card) {
  cardOptions = card;
  settingsPage = 0;
  navigate(Screen::Settings);
  drawSettings();
}

void closeSettings() {
  if (cardOptions) showCard();
  else showTablePage(Screen::Home);
}

void openKeyboard(const char *label, char *target, size_t limit, bool multiline) {
  editLabel = label;
  editTarget = target;
  editLimit = limit;
  editMultiline = multiline;
  strlcpy(editBuffer, target, sizeof(editBuffer));
  keyLayer = 0;
  keyboardFrom = screen;
  // The token search is case-insensitive, so it does not start with a capital.
  keyShift = editBuffer[0] == '\0' && keyboardFrom != Screen::Picker && keyboardFrom != Screen::Precons;
  navigate(Screen::Keyboard);
  display.fillScreen(BACKGROUND);
  drawEditBuffer();
  drawKeyboard();
  drawButton(0, "BACK", INK);
  drawButton(4, "OK", HIGHLIGHT);
}

// Search works on the picker's list, so from the card it first sets that up without drawing it.
void startSearch() {
  searchFrom = screen;
  if (screen != Screen::Picker) {
    clearSearch();
    pickerPage = 0;
    screen = Screen::Picker;
  }
  openKeyboard("FIND TOKEN", searchQuery, NAME_LIMIT, false);
}

void closeKeyboard(bool accept) {
  if (keyboardFrom == Screen::Decks) {
    if (accept) {
      strlcpy(editTarget, editBuffer, editLimit + 1);
      if (!editTarget[0]) strlcpy(editTarget, "Deck", editLimit + 1);
      scheduleTableSave();
    }
    showTablePage(Screen::Decks);
    return;
  }
  if (keyboardFrom == Screen::Precons) {
    if (accept) {
      strlcpy(preconQuery, editBuffer, sizeof(preconQuery));
      rebuildPreconMatches();
    }
    showTablePage(Screen::Precons);
    return;
  }
  if (accept) strlcpy(editTarget, editBuffer, editLimit + 1);
  if (keyboardFrom == Screen::Counters) {
    if (accept) {
      counterNamesChanged = true;
      scheduleSave();
    }
    navigate(Screen::Counters);
    drawCounters();
    return;
  }
  if (keyboardFrom == Screen::Picker) {
    if (!accept && searchFrom == Screen::Card) {
      showCard();
      return;
    }
    if (accept) {
      rebuildMatches();
      pickerPage = 0;
    }
    navigate(Screen::Picker);
    drawPicker();
    return;
  }
  navigate(Screen::Editor);
  drawEditor();
}

void tableLabel(const String &text, int x, int y, int font = 2, uint16_t color = INK) {
  display.setTextDatum(MC_DATUM);
  display.setTextColor(color, BACKGROUND);
  display.drawString(text, x, y, font);
}

void tableTile(int x, int y, int w, int h, const String &text, bool selected = false) {
  const uint16_t fill = selected ? PANEL_SELECTED : PANEL;
  display.fillRoundRect(x, y, w, h, 4, fill);
  display.setTextDatum(MC_DATUM);
  display.setTextColor(selected ? HIGHLIGHT : INK, fill);
  const int font = labelFont(text, w - 8);
  display.drawString(fitLabel(text.c_str(), w - 8, font), x + w / 2, y + h / 2, font);
}

void tableSteps(int y) {
  const char *const labels[] = {"-5", "-1", "+1", "+5"};
  for (int i = 0; i < 4; ++i) tableTile(i * 60 + 2, y, 56, 32, labels[i]);
}

int tableDelta(int x) {
  const int deltas[] = {-5, -1, 1, 5};
  return deltas[min(x / 60, 3)];
}

constexpr uint16_t rgb565(uint8_t r, uint8_t g, uint8_t b) {
  return uint16_t(((r & 0xF8) << 8) | ((g & 0xFC) << 3) | (b >> 3));
}

constexpr uint16_t PLAYER_COLORS[tabletop::MAX_PLAYERS] = {
    rgb565(178, 34, 52),  rgb565(31, 94, 170),  rgb565(34, 139, 84), rgb565(196, 120, 20),
    rgb565(110, 60, 160), rgb565(20, 140, 150), rgb565(170, 60, 120), rgb565(90, 90, 100)};
constexpr uint16_t LETHAL_INK = rgb565(255, 120, 120);
constexpr uint32_t LIFE_DELTA_MS = 2500;
constexpr int LIFE_STRIP_H = 24;
constexpr int LIFE_BUTTON_R = 17;
constexpr int LIFE_HOLD_FAST = 4;  // Repeats of a held press before it steps by 10.
constexpr int MENU_X = 40, MENU_W = 160, MENU_Y = 62, MENU_STEP = 34;
constexpr int LIFE_MENU_ROWS = 6, TOKEN_MENU_ROWS = 5;
// The empty row is the SAVE MATCH switch, whose label shows its state.
const char *const LIFE_MENU[LIFE_MENU_ROWS] = {"DICE / COIN", "WHO STARTS?", "NEW GAME", nullptr, "MAIN MENU",
                                               "CLOSE"};
const char *const TOKEN_MENU[TOKEN_MENU_ROWS] = {"CHOOSE TOKEN", "DECKS / PRECONS", "CARD OPTIONS", "MAIN MENU",
                                                 "CLOSE"};
// Palette entries of a life panel sprite.
enum LifeInk : uint8_t { InkBack, InkPanel, InkStrip, InkText, InkDim, InkGold, InkBlack, InkLethal, InkSoft };

bool choosingStart = false;
Screen diceReturn = Screen::Home;

tabletop::Seat lifeSeat(uint8_t player) {
  return tabletop::seatOf(player, match.players, SCREEN_W, SCREEN_H);
}

void lifeButtonCenter(int &x, int &y) {
  x = SCREEN_W / 2;
  if (match.players <= 1) y = LIFE_BUTTON_R + 6;
  else if (match.players == 2) y = SCREEN_H / 2;
  else y = tabletop::sideHeight(match.players, SCREEN_H) / 2;
}

void drawLifeButton() {
  int x, y;
  lifeButtonCenter(x, y);
  const bool damage = damageTarget >= 0;
  display.fillCircle(x, y, LIFE_BUTTON_R + 2, BACKGROUND);
  display.fillCircle(x, y, LIFE_BUTTON_R, damage ? HIGHLIGHT : PANEL);
  display.drawCircle(x, y, LIFE_BUTTON_R, damage ? HIGHLIGHT : HINT);
  if (damage) {
    // A check mark: leave the commander damage view.
    for (int t = 0; t < 3; ++t) {
      display.drawLine(x - 7, y + t - 1, x - 2, y + t + 4, TFT_BLACK);
      display.drawLine(x - 2, y + t + 4, x + 7, y + t - 6, TFT_BLACK);
    }
  } else {
    for (int row = -1; row <= 1; ++row) display.fillRoundRect(x - 8, y + row * 6 - 1, 16, 3, 1, INK);
  }
}

// Text drawn into a panel in its reader's frame; pills get a rounded background.
void panelPill(TFT_eSprite &panel, const String &text, int x, int y, int font, uint8_t fill, uint8_t ink,
               uint8_t datum) {
  const int w = panel.textWidth(text, font) + 12;
  const int h = panel.fontHeight(font) + 4;
  const int left = datum == ML_DATUM ? x : datum == MR_DATUM ? x - w : x - w / 2;
  panel.fillRoundRect(left, y - h / 2, w, h, h / 2, fill);
  panel.setTextDatum(MC_DATUM);
  panel.setTextColor(ink, fill);
  panel.drawString(text, left + w / 2, y, font);
}

// Copies the panel onto the screen, turned toward the seat's player.
void pushSeat(TFT_eSprite &panel, const tabletop::Seat &seat, const uint16_t *palette) {
  static uint16_t line[SCREEN_W];
  display.startWrite();
  display.setAddrWindow(seat.x, seat.y, seat.w, seat.h);
  for (int py = seat.y; py < seat.y + seat.h; ++py) {
    for (int px = seat.x; px < seat.x + seat.w; ++px) {
      int u = 0, v = 0;
      seat.toReader(px, py, u, v);
      line[px - seat.x] = palette[panel.readPixelValue(u, v) & 0x0F];
    }
    display.pushColors(line, seat.w, true);
  }
  display.endWrite();
}

void drawSeat(uint8_t player) {
  const tabletop::Seat seat = lifeSeat(player);
  const int w = seat.readerW(), h = seat.readerH();
  const bool damageView = damageTarget >= 0 && player != damageTarget;
  const bool lethal = match.life[player] <= 0 || match.commanderLethal(player);
  const int value = damageView ? match.damage[damageTarget][player][damageSlot[player]] : match.life[player];
  uint16_t base = PLAYER_COLORS[player];
  if (damageView || lethal) base = display.alphaBlend(110, base, TFT_BLACK);
  uint16_t palette[16] = {};
  palette[InkBack] = BACKGROUND;
  palette[InkPanel] = base;
  palette[InkStrip] = display.alphaBlend(160, base, TFT_BLACK);
  palette[InkText] = TFT_WHITE;
  palette[InkDim] = display.alphaBlend(110, TFT_WHITE, base);
  palette[InkGold] = HIGHLIGHT;
  palette[InkBlack] = TFT_BLACK;
  palette[InkLethal] = LETHAL_INK;
  palette[InkSoft] = display.alphaBlend(170, TFT_WHITE, palette[InkStrip]);

  TFT_eSprite panel(&display);
  panel.setColorDepth(4);
  if (!panel.createSprite(w, h)) {
    // Not enough memory for the turned panel: an upright one still shows the life total.
    display.fillRect(seat.x, seat.y, seat.w, seat.h, BACKGROUND);
    display.fillRoundRect(seat.x + 1, seat.y + 1, seat.w - 2, seat.h - 2, 8, base);
    display.setTextDatum(MC_DATUM);
    display.setTextColor(TFT_WHITE, base);
    display.drawString(String(value), seat.x + seat.w / 2, seat.y + seat.h / 2, 4);
    return;
  }
  panel.createPalette(palette, 16);
  panel.fillSprite(InkBack);
  panel.fillRoundRect(1, 1, w - 2, h - 2, 8, InkPanel);
  const int stripTop = h - 1 - LIFE_STRIP_H;
  panel.fillRoundRect(1, stripTop, w - 2, LIFE_STRIP_H, 8, InkStrip);
  panel.fillRect(1, stripTop, w - 2, LIFE_STRIP_H / 2, InkStrip);
  const bool starting = player == startingSeat;
  if (starting) {
    for (int k = 1; k <= 3; ++k) panel.drawRoundRect(k, k, w - 2 * k, h - 2 * k, 9 - k, InkGold);
  }

  // The biggest number that fits, leaving room for the - and + hints when possible.
  const String text(value);
  const int areaH = stripTop - 2;
  const bool hints = !(damageTarget >= 0 && !damageView);
  struct Size { uint8_t font, scale; };
  static const Size SIZES[] = {{7, 2}, {7, 1}, {4, 2}, {4, 1}, {2, 1}};
  Size chosen = {2, 1};
  bool found = false, roomForHints = false;
  for (int pass = hints ? 0 : 1; pass < 2 && !found; ++pass) {
    const int maxW = w - (pass == 0 ? 56 : 12);
    for (const Size &size : SIZES) {
      panel.setTextSize(size.scale);
      if (panel.textWidth(text, size.font) <= maxW && panel.fontHeight(size.font) <= areaH - 2) {
        chosen = size;
        found = true;
        roomForHints = pass == 0;
        break;
      }
    }
  }
  const int centerY = 1 + areaH / 2;
  panel.setTextDatum(MC_DATUM);
  panel.setTextSize(chosen.scale);
  const bool red = damageView ? value >= 21 : lethal;
  panel.setTextColor(red ? InkLethal : InkText);
  panel.drawString(text, w / 2, centerY, chosen.font);
  panel.setTextSize(1);
  if (roomForHints) {
    panel.setTextColor(InkDim);
    panel.drawString("-", 16, centerY, 4);
    panel.drawString("+", w - 16, centerY, 4);
  }

  // Bottom strip: seat, recent change and commander damage.
  const bool narrow = w < 120;
  const int smallFont = narrow ? 1 : 2;
  const int stripY = stripTop + LIFE_STRIP_H / 2;
  panel.setTextDatum(ML_DATUM);
  panel.setTextColor(InkSoft);
  panel.drawString("P" + String(player + 1), 7, stripY, smallFont);
  if (damageTarget >= 0 && !damageView) {
    panelPill(panel, "DONE", w / 2, stripY, smallFont, InkGold, InkBlack, MC_DATUM);
  } else if (damageView) {
    panel.setTextDatum(MC_DATUM);
    panel.setTextColor(InkSoft);
    panel.drawString(narrow ? String("DMG") : "TO P" + String(damageTarget + 1), w / 2, stripY, 1);
    panelPill(panel, "C" + String(damageSlot[player] + 1), w - 6, stripY, smallFont, InkGold, InkBlack, MR_DATUM);
  } else {
    // Narrow panels have no room in the strip, so the bubble floats above the number.
    const int bubbleY = narrow ? 11 : stripY;
    if (lifeDelta[player]) {
      const String delta = (lifeDelta[player] > 0 ? "+" : "") + String(lifeDelta[player]);
      panelPill(panel, delta, w / 2, bubbleY, smallFont, InkGold, InkBlack, MC_DATUM);
    } else if (starting && !choosingStart) {
      panelPill(panel, "FIRST", w / 2, bubbleY, smallFont, InkGold, InkBlack, MC_DATUM);
    }
    if (match.players > 1) {
      uint16_t most = 0;
      for (uint8_t source = 0; source < match.players; ++source)
        for (uint8_t c = 0; c < 2; ++c) most = max(most, match.damage[player][source][c]);
      const String cmd = narrow ? "C" + String(most) : "CMD " + String(most);
      panelPill(panel, cmd, w - 6, stripY, 1, most >= 21 ? InkLethal : InkStrip, most >= 21 ? InkBlack : InkSoft,
                MR_DATUM);
    }
  }
  pushSeat(panel, seat, palette);
  panel.deleteSprite();
}

// A popup list over the current screen, shared by the life and token menus.
void drawPopupMenu(const char *const *rows, int count, int lit) {
  const int top = MENU_Y - 10;
  const int height = count * MENU_STEP + 16;
  display.fillRoundRect(MENU_X - 10, top, MENU_W + 20, height, 10, BACKGROUND);
  display.drawRoundRect(MENU_X - 10, top, MENU_W + 20, height, 10, HINT);
  for (int row = 0; row < count; ++row) {
    const char *label = rows[row] ? rows[row] : resumeMatch ? "SAVE MATCH: ON" : "SAVE MATCH: OFF";
    tableTile(MENU_X, MENU_Y + row * MENU_STEP, MENU_W, MENU_STEP - 4, label,
              row == lit || (!rows[row] && resumeMatch));
  }
}

// The popup row under the finger, or -1 outside every row.
int popupRow(int x, int y, int count) {
  const int row = (y - MENU_Y) / MENU_STEP;
  const bool inside = x >= MENU_X && x < MENU_X + MENU_W && y >= MENU_Y && row < count &&
                      (y - MENU_Y) % MENU_STEP < MENU_STEP - 4;
  return inside ? row : -1;
}

void drawLifeMenu() {
  drawPopupMenu(LIFE_MENU, LIFE_MENU_ROWS, 1);
}

void drawLifeScreen() {
  for (uint8_t player = 0; player < match.players; ++player) drawSeat(player);
  drawLifeButton();
  if (lifeMenu) drawLifeMenu();
}

void openLife() {
  lifeMenu = false;
  damageTarget = -1;
  startingSeat = -1;
  tableMessage = "";
  navigate(Screen::Match);
  drawTablePage();
}

// Highlights the seats in turn, slowing down until it stops on a random player.
void chooseStartingPlayer() {
  if (match.players < 2) return;
  const uint8_t winner = tabletop::roll(match.players, []() { return esp_random(); }) - 1;
  const int steps = match.players * 2 + winner + 1;
  choosingStart = true;
  int previous = -1;
  for (int step = 0; step < steps; ++step) {
    startingSeat = step % match.players;
    if (step == steps - 1) choosingStart = false;
    drawSeat(startingSeat);
    if (previous >= 0) drawSeat(previous);
    drawLifeButton();
    previous = startingSeat;
    if (step < steps - 1) delay(40 + 320 * step * step / (steps * steps));
  }
  awaitRelease = true;
}

void lifeChanged(uint8_t player, int before) {
  const int change = match.life[player] - before;
  if (!change) return;
  lifeDelta[player] += change;
  lifeDeltaAt[player] = millis();
}

void handleLifeTouch(int x, int y, bool redrawAll) {
  if (lifeMenu) {
    lifeMenu = false;
    const int row = popupRow(x, y, LIFE_MENU_ROWS);
    if (row < 0 || row == 5) drawTablePage();
    else if (row == 0) {
      diceReturn = Screen::Match;
      showTablePage(Screen::Dice);
    } else if (row == 1) {
      drawTablePage();
      chooseStartingPlayer();
    } else if (row == 2) {
      setupPlayers = match.players;
      setupLife = match.initialLife;
      showTablePage(Screen::MatchSetup);
    } else if (row == 3) {
      resumeMatch = !resumeMatch;
      saveTableState();
      lifeMenu = true;
      drawLifeMenu();
    } else showTablePage(Screen::Home);
    return;
  }
  if (redrawAll) drawTablePage();
  if (startingSeat >= 0) {
    // The first tap after choosing who starts only clears the result.
    const uint8_t seat = startingSeat;
    startingSeat = -1;
    drawSeat(seat);
    drawLifeButton();
    return;
  }
  int cx, cy;
  lifeButtonCenter(cx, cy);
  const int reach = LIFE_BUTTON_R + 5;
  if ((x - cx) * (x - cx) + (y - cy) * (y - cy) <= reach * reach) {
    if (damageTarget >= 0) {
      damageTarget = -1;
      drawTablePage();
    } else {
      lifeMenu = true;
      drawLifeMenu();
    }
    return;
  }
  uint8_t player = 0;
  int u = 0, v = 0;
  tabletop::Seat seat{};
  for (; player < match.players; ++player) {
    seat = lifeSeat(player);
    if (seat.toReader(x, y, u, v)) break;
  }
  if (player >= match.players) return;
  const bool inStrip = v >= seat.readerH() - 1 - LIFE_STRIP_H;
  if (damageTarget >= 0) {
    if (player == damageTarget) {
      damageTarget = -1;
      drawTablePage();
      return;
    }
    if (inStrip) {
      damageSlot[player] ^= 1;
      drawSeat(player);
      drawLifeButton();
      return;
    }
  } else if (inStrip) {
    if (match.players < 2) return;
    damageTarget = player;
    drawTablePage();
    return;
  }

  // Life and damage repeat while held, and speed up to steps of 10.
  const bool plus = u >= seat.readerW() / 2;
  if (holdRelease == touchReleases && holdSeat == player && holdPlus == plus) {
    if (holdSteps < 255) ++holdSteps;
  } else {
    holdSteps = 0;
    holdRelease = touchReleases;
    holdSeat = player;
    holdPlus = plus;
  }
  awaitRelease = false;
  const int amount = (holdSteps >= LIFE_HOLD_FAST ? 10 : 1) * (plus ? 1 : -1);
  const uint8_t target = damageTarget >= 0 ? damageTarget : player;
  const int before = match.life[target];
  const bool changed = damageTarget >= 0 ? match.adjustDamage(target, player, damageSlot[player], amount)
                                         : match.adjustLife(player, amount);
  if (!changed) return;
  lifeChanged(target, before);
  if (resumeMatch) scheduleTableSave();
  drawSeat(player);
  if (target != player) drawSeat(target);
  drawLifeButton();
}

// Clears each panel's change bubble a moment after the last tap.
void tableTick() {
  if (screen != Screen::Match || lifeMenu) return;
  const uint32_t now = millis();
  bool drawn = false;
  for (uint8_t player = 0; player < match.players; ++player) {
    if (lifeDelta[player] && now - lifeDeltaAt[player] > LIFE_DELTA_MS) {
      lifeDelta[player] = 0;
      if (damageTarget < 0 || player == damageTarget) {
        drawSeat(player);
        drawn = true;
      }
    }
  }
  if (drawn) drawLifeButton();
}

constexpr int DICE_AREA_Y = 172;
constexpr int DICE_AREA_H = 102;
constexpr int DICE_TOP = DICE_AREA_Y - 24;  // The results line sits above the dice.
constexpr int DICE_STAGE_H = DICE_AREA_H + 24;
int8_t diceSpin[tabletop::MAX_DICE] = {};  // Degrees each die rests turned on the table.

struct Vec3 {
  float x, y, z;
};

Vec3 operator+(Vec3 a, Vec3 b) { return {a.x + b.x, a.y + b.y, a.z + b.z}; }
Vec3 operator-(Vec3 a, Vec3 b) { return {a.x - b.x, a.y - b.y, a.z - b.z}; }
Vec3 operator*(Vec3 a, float k) { return {a.x * k, a.y * k, a.z * k}; }
float dot(Vec3 a, Vec3 b) { return a.x * b.x + a.y * b.y + a.z * b.z; }
Vec3 cross(Vec3 a, Vec3 b) { return {a.y * b.z - a.z * b.y, a.z * b.x - a.x * b.z, a.x * b.y - a.y * b.x}; }
Vec3 normalized(Vec3 a) {
  const float length = sqrtf(dot(a, a));
  return length > 1e-6f ? a * (1 / length) : Vec3{0, 0, 1};
}

// A convex polyhedron centered on the origin, scaled to fit a unit sphere.
constexpr int MESH_VERTS = 20, MESH_FACES = 20;
struct DieMesh {
  uint8_t sides, verts, faces, corners;
  Vec3 v[MESH_VERTS];
  Vec3 n[MESH_FACES];  // Outward normals.
  uint8_t f[MESH_FACES][5];
  uint8_t label[MESH_FACES];
  float inner;  // From a face's center to its edge, which sizes the numbers.
};
DieMesh dieMesh = {};

// Adds a face from its corners in any order: they are sorted around the face's center.
void addFace(const uint8_t *corners, uint8_t count) {
  DieMesh &m = dieMesh;
  Vec3 center = {0, 0, 0};
  for (uint8_t i = 0; i < count; ++i) center = center + m.v[corners[i]];
  center = center * (1.0f / count);
  const Vec3 axis = normalized(center);
  const Vec3 u = normalized(m.v[corners[0]] - center);
  const Vec3 w = cross(axis, u);
  uint8_t *face = m.f[m.faces];
  float angle[5];
  for (uint8_t i = 0; i < count; ++i) {
    const Vec3 d = m.v[corners[i]] - center;
    const float a = atan2f(dot(d, w), dot(d, u));
    uint8_t j = i;
    for (; j > 0 && angle[j - 1] > a; --j) {
      angle[j] = angle[j - 1];
      face[j] = face[j - 1];
    }
    angle[j] = a;
    face[j] = corners[i];
  }
  Vec3 normal = normalized(cross(m.v[face[1]] - m.v[face[0]], m.v[face[2]] - m.v[face[0]]));
  if (dot(normal, center) < 0) normal = normal * -1;
  m.n[m.faces++] = normal;
  m.corners = count;
}

void buildDieMesh(uint8_t sides) {
  DieMesh &m = dieMesh;
  if (m.sides == sides) return;
  m = DieMesh{};
  m.sides = sides;
  auto vert = [&m](float x, float y, float z) { m.v[m.verts++] = {x, y, z}; };
  if (sides == 4) {
    vert(1, 1, 1), vert(1, -1, -1), vert(-1, 1, -1), vert(-1, -1, 1);
    for (uint8_t skip = 0; skip < 4; ++skip) {
      uint8_t face[3], k = 0;
      for (uint8_t i = 0; i < 4; ++i)
        if (i != skip) face[k++] = i;
      addFace(face, 3);
    }
  } else if (sides == 6) {
    for (int i = 0; i < 8; ++i) vert(i & 1 ? 1 : -1, i & 2 ? 1 : -1, i & 4 ? 1 : -1);
    for (int axis = 0; axis < 3; ++axis)
      for (int bit = 1; bit >= 0; --bit) {
        uint8_t face[4], k = 0;
        for (uint8_t i = 0; i < 8; ++i)
          if (((i >> axis) & 1) == bit) face[k++] = i;
        addFace(face, 4);
      }
  } else if (sides == 8) {
    for (int axis = 0; axis < 3; ++axis)
      for (int sign = 1; sign >= -1; sign -= 2) vert(axis == 0 ? sign : 0, axis == 1 ? sign : 0, axis == 2 ? sign : 0);
    for (uint8_t i = 0; i < 8; ++i) {
      const uint8_t face[3] = {uint8_t(i & 1), uint8_t(2 + ((i >> 1) & 1)), uint8_t(4 + ((i >> 2) & 1))};
      addFace(face, 3);
    }
  } else if (sides == 10) {
    // Pentagonal trapezohedron: the apex height keeps each kite flat.
    const float ring = 0.1f, apex = ring * (1 + cosf(PI / 5)) / (1 - cosf(PI / 5));
    vert(0, 0, apex), vert(0, 0, -apex);
    for (int k = 0; k < 5; ++k) vert(cosf(2 * PI * k / 5), sinf(2 * PI * k / 5), ring);
    for (int k = 0; k < 5; ++k) vert(cosf(2 * PI * k / 5 + PI / 5), sinf(2 * PI * k / 5 + PI / 5), -ring);
    for (uint8_t k = 0; k < 5; ++k) {
      const uint8_t next = (k + 1) % 5;
      const uint8_t up[4] = {0, uint8_t(2 + k), uint8_t(7 + k), uint8_t(2 + next)};
      const uint8_t down[4] = {1, uint8_t(7 + k), uint8_t(2 + next), uint8_t(7 + next)};
      addFace(up, 4);
      addFace(down, 4);
    }
  } else {
    // The icosahedron, whose face centers are also the corners of the dodecahedron.
    const float phi = (1 + sqrtf(5)) / 2;
    Vec3 ico[12];
    int count = 0;
    for (int a = -1; a <= 1; a += 2)
      for (int b = -1; b <= 1; b += 2) {
        ico[count++] = {0, float(a), b * phi};
        ico[count++] = {float(a), b * phi, 0};
        ico[count++] = {b * phi, 0, float(a)};
      }
    auto edge = [&ico](int i, int j) { return dot(ico[i] - ico[j], ico[i] - ico[j]) < 4.1f; };
    uint8_t tri[20][3];
    int tris = 0;
    for (uint8_t i = 0; i < 12; ++i)
      for (uint8_t j = i + 1; j < 12; ++j)
        for (uint8_t k = j + 1; k < 12 && edge(i, j); ++k)
          if (edge(j, k) && edge(i, k) && tris < 20) tri[tris][0] = i, tri[tris][1] = j, tri[tris++][2] = k;
    if (sides == 20) {
      for (const Vec3 &p : ico) vert(p.x, p.y, p.z);
      for (int t = 0; t < tris; ++t) addFace(tri[t], 3);
    } else {
      for (int t = 0; t < tris; ++t) {
        const Vec3 c = (ico[tri[t][0]] + ico[tri[t][1]] + ico[tri[t][2]]) * (1.0f / 3);
        vert(c.x, c.y, c.z);
      }
      for (uint8_t corner = 0; corner < 12; ++corner) {
        uint8_t face[5], k = 0;
        for (uint8_t t = 0; t < tris && k < 5; ++t)
          if (tri[t][0] == corner || tri[t][1] == corner || tri[t][2] == corner) face[k++] = t;
        addFace(face, 5);
      }
    }
  }
  float reach = 0;
  for (uint8_t i = 0; i < m.verts; ++i) reach = max(reach, dot(m.v[i], m.v[i]));
  for (uint8_t i = 0; i < m.verts; ++i) m.v[i] = m.v[i] * (1 / sqrtf(reach));
  Vec3 center = {0, 0, 0};
  for (uint8_t i = 0; i < m.corners; ++i) center = center + m.v[m.f[0][i]];
  center = center * (1.0f / m.corners);
  const Vec3 edgeMiddle = (m.v[m.f[0][0]] + m.v[m.f[0][1]]) * 0.5f;
  m.inner = sqrtf(dot(edgeMiddle - center, edgeMiddle - center));
  // Opposite faces of the cube add up to 7, like a real d6.
  static const uint8_t CUBE[6] = {1, 6, 2, 5, 3, 4};
  for (uint8_t f = 0; f < m.faces; ++f) m.label[f] = sides == 6 ? CUBE[f] : f + 1;
}

Vec3 rotate(const float *m, Vec3 v) {
  return {m[0] * v.x + m[1] * v.y + m[2] * v.z, m[3] * v.x + m[4] * v.y + m[5] * v.z,
          m[6] * v.x + m[7] * v.y + m[8] * v.z};
}

void axisAngle(float *m, Vec3 a, float angle) {
  const float c = cosf(angle), s = sinf(angle), t = 1 - c;
  const float values[9] = {t * a.x * a.x + c,       t * a.x * a.y - s * a.z, t * a.x * a.z + s * a.y,
                           t * a.x * a.y + s * a.z, t * a.y * a.y + c,       t * a.y * a.z - s * a.x,
                           t * a.x * a.z - s * a.y, t * a.y * a.z + s * a.x, t * a.z * a.z + c};
  memcpy(m, values, sizeof(values));
}

void multiply(float *out, const float *a, const float *b) {
  for (int row = 0; row < 3; ++row)
    for (int col = 0; col < 3; ++col)
      out[row * 3 + col] = a[row * 3] * b[col] + a[row * 3 + 1] * b[3 + col] + a[row * 3 + 2] * b[6 + col];
}

// The orientation that shows the face with this value to the viewer, turned by spin on the table.
void restingPose(float *m, uint8_t value, float spin) {
  uint8_t face = 0;
  while (face + 1 < dieMesh.faces && dieMesh.label[face] != value) ++face;
  const Vec3 n = dieMesh.n[face];
  const float side = sqrtf(n.x * n.x + n.y * n.y);
  float align[9], turn[9];
  if (side < 1e-4f) axisAngle(align, {1, 0, 0}, n.z > 0 ? 0 : PI);
  else axisAngle(align, {n.y / side, -n.x / side, 0}, atan2f(side, n.z));
  axisAngle(turn, {0, 0, 1}, spin);
  multiply(m, turn, align);
}

uint16_t dieColor(uint8_t sides) {
  switch (sides) {
    case 4: return rgb565(40, 150, 80);
    case 6: return rgb565(240, 238, 228);
    case 8: return rgb565(120, 70, 170);
    case 10: return rgb565(40, 100, 190);
    case 12: return rgb565(210, 110, 30);
    default: return rgb565(190, 40, 50);
  }
}

// Flat-shaded polyhedron, lit from the upper left, with numbers (or d6 pips) on the faces toward the viewer.
void drawPolyDie(TFT_eSPI &out, int x, int y, float r, const float *m) {
  const DieMesh &d = dieMesh;
  int16_t sx[MESH_VERTS], sy[MESH_VERTS];
  for (uint8_t i = 0; i < d.verts; ++i) {
    const Vec3 p = rotate(m, d.v[i]);
    sx[i] = x + lroundf(p.x * r);
    sy[i] = y - lroundf(p.y * r);
  }
  const uint16_t base = dieColor(d.sides);
  const Vec3 light = normalized({-0.45f, 0.55f, 0.75f});
  for (uint8_t f = 0; f < d.faces; ++f) {
    const Vec3 n = rotate(m, d.n[f]);
    if (n.z <= 0.01f) continue;
    const float lit = 0.3f + 0.7f * max(0.0f, dot(n, light));
    const uint16_t shade = display.alphaBlend(uint8_t(lit * 255), base, TFT_BLACK);
    const uint8_t *c = d.f[f];
    for (uint8_t k = 1; k + 1 < d.corners; ++k)
      out.fillTriangle(sx[c[0]], sy[c[0]], sx[c[k]], sy[c[k]], sx[c[k + 1]], sy[c[k + 1]], shade);
    const uint16_t edge = display.alphaBlend(uint8_t(lit * 140), base, TFT_BLACK);
    int cx = 0, cy = 0;
    for (uint8_t k = 0; k < d.corners; ++k) {
      const uint8_t next = c[(k + 1) % d.corners];
      out.drawLine(sx[c[k]], sy[c[k]], sx[next], sy[next], edge);
      cx += sx[c[k]];
      cy += sy[c[k]];
    }
    cx /= d.corners;
    cy /= d.corners;
    if (d.sides == 6) {
      if (n.z < 0.3f) continue;
      static const uint16_t PIPS[6] = {0x10, 0x44, 0x54, 0x145, 0x155, 0x16D};
      const uint16_t pips = PIPS[d.label[f] - 1];
      // Half-axes of the face, from its center to the middle of two neighboring edges.
      const float ax = (sx[c[1]] + sx[c[2]]) / 2.0f - cx, ay = (sy[c[1]] + sy[c[2]]) / 2.0f - cy;
      const float bx = (sx[c[2]] + sx[c[3]]) / 2.0f - cx, by = (sy[c[2]] + sy[c[3]]) / 2.0f - cy;
      const int pip = max(1, int(r * 0.1f * sqrtf(n.z)));
      for (int cell = 0; cell < 9; ++cell)
        if (pips & (1 << cell)) {
          const int i = cell % 3 - 1, j = cell / 3 - 1;
          out.fillCircle(cx + lroundf((ax * i + bx * j) * 0.5f), cy + lroundf((ay * i + by * j) * 0.5f), pip,
                         rgb565(25, 25, 35));
        }
      continue;
    }
    const float size = d.inner * r * n.z;
    const int font = size >= 20 ? 4 : size >= 9 ? 2 : (size >= 4 || n.z > 0.95f) ? 1 : 0;
    if (!font || n.z < 0.45f) continue;
    out.setTextDatum(MC_DATUM);
    out.setTextColor(TFT_WHITE);
    out.drawString(String(d.label[f]), cx, cy, font);
  }
}

// A coin seen from above while it flips end over end: the face shrinks to an ellipse and the edge shows.
void drawCoin(TFT_eSPI &out, int x, int y, int r, float flip) {
  const float c = cosf(flip);
  const bool heads = c >= 0;
  const int ry = max(1, int(r * fabsf(c)));
  const int edge = int(max(2, r / 7) * fabsf(sinf(flip)));
  const uint16_t metal = heads ? rgb565(230, 180, 40) : rgb565(190, 195, 205);
  const uint16_t rim = heads ? rgb565(150, 105, 10) : rgb565(110, 115, 125);
  const uint16_t face = display.alphaBlend(uint8_t(130 + 125 * fabsf(c)), metal, TFT_BLACK);
  if (edge) {
    out.fillEllipse(x, y + edge, r, ry, rim);
    out.fillRect(x - r, y, 2 * r + 1, edge, rim);
  }
  out.fillEllipse(x, y, r, ry, rim);
  if (ry > 3) out.fillEllipse(x, y, max(1, r - 2), max(1, ry - 2), face);
  if (fabsf(c) > 0.6f) {
    out.setTextDatum(MC_DATUM);
    out.setTextColor(rim);
    out.drawString(heads ? "H" : "T", x, y, ry >= 24 ? 4 : ry >= 10 ? 2 : 1);
  }
}

// One rolled die or coin; turn is how far it still spins about axis before resting on its result.
void drawRolledDie(TFT_eSPI &out, uint8_t i, int x, int y, float r, float turn, Vec3 axis) {
  if (rolledSides == 2) {
    drawCoin(out, x, y, lroundf(r), (diceResults[i] == 2 ? 0 : PI) + turn);
    return;
  }
  float rest[9], spin[9], m[9];
  restingPose(rest, diceResults[i], diceSpin[i] * DEG_TO_RAD);
  axisAngle(spin, axis, turn);
  multiply(m, rest, spin);
  drawPolyDie(out, x, y, r, m);
}

void drawDieShadow(TFT_eSPI &out, int x, int y, float r) {
  const int radius = max(1, int(r));
  out.fillEllipse(x, y, radius, radius * 9 / 10, display.alphaBlend(120, TFT_BLACK, BACKGROUND));
}

// The grid that gives the dice the most room, with a short last row centered.
void diceCell(uint8_t index, uint8_t count, int &x, int &y, int &cell) {
  int cols = 1;
  cell = 0;
  for (int c = 1; c <= count; ++c) {
    const int rows = (count + c - 1) / c;
    const int size = min(SCREEN_W / c, DICE_AREA_H / rows);
    if (size > cell) {
      cell = size;
      cols = c;
    }
  }
  const int rows = (count + cols - 1) / cols;
  const int row = index / cols, col = index % cols;
  const int inRow = row == rows - 1 ? count - row * cols : cols;
  x = SCREEN_W / 2 + (col * 2 + 1 - inRow) * cell / 2;
  y = DICE_AREA_Y + DICE_AREA_H / 2 + (row * 2 + 1 - rows) * cell / 2;
}

int dieSize(int cell) {
  return min(cell - 8, 84);
}

// Dice are sized by their corners, so they need a bit more radius than a flat coin to look as big.
float dieRadius(int cell) {
  return dieSize(cell) * (rolledSides == 2 ? 0.5f : 0.6f);
}

void diceLabel(TFT_eSPI &out, int top, const String &text, int y, uint16_t color) {
  out.setTextDatum(MC_DATUM);
  out.setTextColor(color, BACKGROUND);
  out.drawString(text, 120, y - top, 2);
}

// Draws the dice area into out, whose row 0 is screen row top (0 for the display, DICE_TOP for a sprite).
void drawDiceResults(TFT_eSPI &out, int top) {
  out.fillRect(0, DICE_TOP - top, SCREEN_W, DICE_STAGE_H, BACKGROUND);
  if (!rolledCount) {
    diceLabel(out, top, "Tap here or ROLL", DICE_AREA_Y + DICE_AREA_H / 2, HINT);
    return;
  }
  if (rolledSides != 2) buildDieMesh(rolledSides);
  int total = 0, heads = 0;
  for (uint8_t i = 0; i < rolledCount; ++i) {
    total += diceResults[i];
    if (diceResults[i] == 2) ++heads;
    int x, y, cell;
    diceCell(i, rolledCount, x, y, cell);
    const float r = dieRadius(cell);
    drawDieShadow(out, x + int(r * 0.12f), y - top + int(r * 0.12f), r * 0.85f);
    drawRolledDie(out, i, x, y - top, r, 0, {0, 0, 1});
  }
  diceLabel(out, top,
            rolledSides == 2 ? String(heads) + " HEADS / " + String(rolledCount - heads) + " TAILS"
                             : String(rolledCount) + "d" + String(rolledSides) + " TOTAL: " + String(total),
            DICE_AREA_Y - 12, HIGHLIGHT);
}

void drawDiceResults() {
  drawDiceResults(display, 0);
}

float randomUnit() {
  return (esp_random() & 0xFFFF) / 65535.0f;
}

// Tosses the dice (or flips the coins) in 3D: each flies in from below, arcs up toward the viewer,
// bounces once and tumbles to rest on its result. Frames are drawn off-screen to avoid flicker.
void rollDice() {
  rolledCount = diceCount;
  rolledSides = tabletop::DIE_SIDES[dieIndex];
  const bool coin = rolledSides == 2;
  if (!coin) buildDieMesh(rolledSides);
  struct Toss {
    Vec3 axis;
    float turns, startX, startY;
  } toss[tabletop::MAX_DICE];
  for (uint8_t i = 0; i < rolledCount; ++i) {
    diceResults[i] = tabletop::roll(rolledSides, []() { return esp_random(); });
    diceSpin[i] = int8_t(int(esp_random() % 61) - 30);
    int x, y, cell;
    diceCell(i, rolledCount, x, y, cell);
    Toss &t = toss[i];
    t.axis = coin ? Vec3{1, 0, 0} : normalized({randomUnit() - 0.5f, randomUnit() - 0.5f, randomUnit() - 0.5f});
    t.turns = 2 * PI * (coin ? 4 + 2 * randomUnit() : 2 + 1.5f * randomUnit());
    t.startX = (randomUnit() * 1.8f - 0.9f) * cell;
    t.startY = (0.5f + 0.5f * randomUnit()) * cell;
  }

  TFT_eSprite stage(&display);
  stage.setColorDepth(16);
  bool staged = stage.createSprite(SCREEN_W, DICE_STAGE_H) != nullptr;
  if (!staged) {
    stage.setColorDepth(8);
    staged = stage.createSprite(SCREEN_W, DICE_STAGE_H) != nullptr;
  }
  TFT_eSPI &out = staged ? static_cast<TFT_eSPI &>(stage) : display;
  const int top = staged ? DICE_TOP : 0;

  constexpr int FRAMES = 30;
  for (int frame = 0; frame < FRAMES; ++frame) {
    const uint32_t started = millis();
    const float t = float(frame) / FRAMES, left = 1 - t;
    // Height above the table: one high arc, then a small bounce.
    const float height = t < 0.7f ? 4 * (t / 0.7f) * (1 - t / 0.7f) : 0.3f * 4 * ((t - 0.7f) / 0.3f) * (1 - (t - 0.7f) / 0.3f);
    const float glide = left * left * left;
    out.fillRect(0, DICE_TOP - top, SCREEN_W, DICE_STAGE_H, BACKGROUND);
    diceLabel(out, top, coin ? "FLIPPING..." : "ROLLING...", DICE_AREA_Y - 12, HINT);
    for (int pass = 0; pass < 2; ++pass)
      for (uint8_t i = 0; i < rolledCount; ++i) {
        int x, y, cell;
        diceCell(i, rolledCount, x, y, cell);
        const float r0 = dieRadius(cell);
        const int px = x + int(toss[i].startX * glide), py = y - top + int(toss[i].startY * glide);
        if (pass == 0) {
          const float offset = r0 * (0.12f + 0.6f * height);
          drawDieShadow(out, px + int(offset), py + int(offset), r0 * (0.85f - 0.25f * height));
        } else {
          const float r = min(r0 * (1 + 0.4f * height), r0 + 22);
          drawRolledDie(out, i, px, py - int(r0 * 0.5f * height), r, toss[i].turns * left * left, toss[i].axis);
        }
      }
    if (staged) stage.pushSprite(0, DICE_TOP);
    const uint32_t spent = millis() - started;
    if (spent < 33) delay(33 - spent);
  }
  drawDiceResults(out, top);
  if (staged) {
    stage.pushSprite(0, DICE_TOP);
    stage.deleteSprite();
  }
  awaitRelease = true;
}

void drawTablePage() {
  if (screen == Screen::TokenMenu) {
    // A popup over the card, which stays on screen behind it.
    drawPopupMenu(TOKEN_MENU, TOKEN_MENU_ROWS, 0);
    return;
  }
  if (screen == Screen::Match) {
    // The panels cover the screen; clearing it first would only make it flicker.
    drawLifeScreen();
  } else {
    display.fillScreen(BACKGROUND);
  }
  if (screen == Screen::Home) {
    tableLabel("MAIN MENU", 120, 26, 4);
    tableLabel("Choose your table companion", 120, 54, 1, HINT);
    tableTile(12, 78, 216, 48, "TOKENS");
    tableTile(12, 134, 216, 48, "LIFE COUNTER");
    tableTile(12, 190, 216, 48, "DICE / COIN");
    tableTile(12, 246, 216, 48, "SETTINGS");
  } else if (screen == Screen::Decks) {
    tableLabel("DECKS - TAP TO ACTIVATE", 120, 12);
    for (uint8_t row = 0; row <= tabletop::MAX_DECKS; ++row) {
      String name = row ? String(deckBook.decks[row - 1].name) : String("ALL TOKENS");
      if (!name.length()) name = "(empty slot)";
      if (row && deckBook.decks[row - 1].name[0]) {
        size_t count = 0;
        for (size_t i = 0; i < TOKEN_COUNT; ++i)
          if (deckBook.decks[row - 1].contains(i)) ++count;
        name += " (" + String(count) + ")";
      }
      tableTile(4, LIST_Y + row * ROW_H + 1, 232, ROW_H - 2, name, row == deckBook.active);
    }
    drawButton(0, "NEW", INK);
    drawButton(1, "NAME", deckBook.active ? INK : HINT);
    drawButton(2, "EDIT", deckBook.active ? HIGHLIGHT : HINT);
    drawButton(3, "DEL", deckBook.active ? INK : HINT);
    drawButton(4, "BACK", INK);
  } else if (screen == Screen::Precons) {
    const String pages = String(preconPage + 1) + "/" + String(preconPageCount());
    if (preconQuery[0]) {
      display.setTextDatum(ML_DATUM);
      display.setTextColor(HIGHLIGHT, BACKGROUND);
      display.drawString(fitLabel(preconQuery, 170, 2), 8, 12, 2);
      display.setTextDatum(MR_DATUM);
      display.setTextColor(HINT, BACKGROUND);
      display.drawString(pages, SCREEN_W - 8, 12, 2);
    } else {
      tableLabel("PRECONS - TAP TO IMPORT " + pages, 120, 12, 1);
    }
    if (!preconMatchCount) {
      tableLabel("No precon matches", 120, LIST_Y + 60);
      tableLabel("Search by name, set code or year", 120, LIST_Y + 84, 1, HINT);
    }
    for (int row = 0; row < ROWS_PER_PAGE; ++row) {
      const size_t position = preconPage * ROWS_PER_PAGE + row;
      if (position >= preconMatchCount) break;
      const size_t index = preconMatches[position];
      const PreconDeck &precon = PRECONS[index];
      const int y = LIST_Y + row * ROW_H;
      const int centerY = y + ROW_H / 2;
      const uint8_t slot = preconSlot(index);
      const uint16_t rowColor = slot < tabletop::MAX_DECKS ? PANEL_SELECTED : PANEL;
      display.fillRoundRect(4, y + 1, SCREEN_W - 8, ROW_H - 2, 4, rowColor);
      display.setTextDatum(ML_DATUM);
      display.setTextColor(slot < tabletop::MAX_DECKS ? HIGHLIGHT : INK, rowColor);
      const int nameFont = display.textWidth(precon.name, 2) <= 164 ? 2 : 1;
      display.drawString(fitLabel(precon.name, 164, nameFont), 10, centerY, nameFont);
      display.setTextDatum(MR_DATUM);
      display.setTextColor(HINT, rowColor);
      display.drawString(String(precon.code) + " " + String(precon.year), SCREEN_W - 10, centerY - 6, 1);
      display.drawString(String(precon.count) + (precon.count == 1 ? " token" : " tokens"), SCREEN_W - 10,
                         centerY + 6, 1);
    }
    drawButton(0, "<", INK);
    drawButton(1, "FIND", preconQuery[0] ? HIGHLIGHT : INK);
    drawButton(2, "BACK", INK);
    drawButton(3, "EMPTY", INK);
    drawButton(4, ">", INK);
  } else if (screen == Screen::MatchSetup) {
    tableLabel("NEW MATCH", 120, 12);
    tableLabel("PLAYERS (1-8)", 120, 38);
    tableTile(4, 54, 50, 36, "-");
    tableLabel(String(setupPlayers), 120, 72, 4);
    tableTile(186, 54, 50, 36, "+");
    tableLabel("INITIAL LIFE: " + String(setupLife), 120, 116);
    tableSteps(138);
    for (int i = 0; i < 4; ++i) {
      static const int16_t PRESETS[4] = {20, 25, 30, 40};
      tableTile(2 + i * 60, 188, 56, 36, String(PRESETS[i]), setupLife == PRESETS[i]);
    }
    tableLabel("START resets life and commander damage.", 120, 250, 1, HINT);
    drawButton(0, "BACK", INK);
    drawButton(4, "START", HIGHLIGHT);
  } else if (screen == Screen::Dice) {
    tableLabel("DICE / COINS", 120, 12);
    for (uint8_t i = 0; i < sizeof(tabletop::DIE_SIDES); ++i) {
      const String name = i ? "d" + String(tabletop::DIE_SIDES[i]) : String("COIN");
      tableTile(2 + (i % 4) * 60, 28 + (i / 4) * 40, 56, 36, name, i == dieIndex);
    }
    tableTile(4, 112, 50, 32, "-");
    tableLabel("COUNT: " + String(diceCount), 120, 128);
    tableTile(186, 112, 50, 32, "+");
    drawDiceResults();
    drawButton(0, "BACK", INK);
    drawButton(2, dieIndex == 0 ? "FLIP" : "ROLL", HIGHLIGHT);
  } else if (screen == Screen::Confirm) {
    const bool deleting = tablePrompt == TablePrompt::DeleteDeck;
    tableLabel(deleting ? "DELETE DECK?" : "START NEW MATCH?", 120, 60);
    tableLabel(deleting ? "Only this deck's token filter is removed." : "Life and commander damage will reset.",
               120, 116, 1);
    tableLabel("Token counts/counters stay unchanged.", 120, 140, 1, HINT);
    drawButton(0, "CANCEL", INK);
    drawButton(4, "YES", HIGHLIGHT);
  }
  if (tableMessage.length()) {
    display.fillRect(0, 0, SCREEN_W, 24, BACKGROUND);
    tableLabel(fitLabel(tableMessage.c_str(), 232, 1), 120, 12, 1, HIGHLIGHT);
  }
}

void showTablePage(Screen next) {
  navigate(next);
  drawTablePage();
}

// A blank deck, named on the keyboard and filled with EDIT.
void newEmptyDeck() {
  const uint8_t slot = freeDeckSlot();
  if (slot == tabletop::MAX_DECKS) {
    tableError("All 8 deck slots are in use - DEL one first");
    drawTablePage();
    return;
  }
  deckBook.decks[slot] = tabletop::Deck{};
  snprintf(deckBook.decks[slot].name, sizeof(deckBook.decks[slot].name), "Deck %u", slot + 1);
  deckBook.active = slot + 1;
  scheduleTableSave();
  // The keyboard returns to wherever it opened from, and the new deck belongs to the deck list.
  screen = Screen::Decks;
  openKeyboard("DECK NAME", deckBook.decks[slot].name, tabletop::DECK_NAME_LIMIT, false);
}

void handleTableTouch(int x, int y) {
  // Menus, rolls and destructive actions advance once per press, not on hold-repeat.
  awaitRelease = true;
  const bool hadMessage = tableMessage.length();
  tableMessage = "";
  const int button = min(x / BUTTON_STEP, 4);
  if (screen == Screen::Home) {
    if (x < 12 || x >= 228 || y < 78 || y >= 294 || (y - 78) % 56 >= 48) return;
    switch ((y - 78) / 56) {
      case 0: showCard(); break;
      case 1: openLife(); break;
      case 2:
        diceReturn = Screen::Home;
        showTablePage(Screen::Dice);
        break;
      case 3: openSettings(false); break;
    }
  } else if (screen == Screen::TokenMenu) {
    switch (popupRow(x, y, TOKEN_MENU_ROWS)) {
      case 0: openPicker(); break;
      case 1: showTablePage(Screen::Decks); break;
      case 2: openSettings(true); break;
      case 3: showTablePage(Screen::Home); break;
      default: showCard(); break;
    }
  } else if (screen == Screen::Precons) {
    if (y >= BAR_Y - 4) {
      if (button == 0 || button == 4) {
        const size_t pages = preconPageCount();
        preconPage = (preconPage + (button == 0 ? pages - 1 : 1)) % pages;
        drawTablePage();
      } else if (button == 1) {
        openKeyboard("FIND PRECON", preconQuery, NAME_LIMIT, false);
      } else if (button == 2) {
        showTablePage(Screen::Decks);
      } else {
        newEmptyDeck();
      }
    } else if (y >= LIST_Y) {
      const int row = (y - LIST_Y) / ROW_H;
      const size_t position = preconPage * ROWS_PER_PAGE + row;
      if (row >= ROWS_PER_PAGE || position >= preconMatchCount) return;
      const size_t index = preconMatches[position];
      if (!importPrecon(index)) {
        tableError("All 8 deck slots are in use - DEL one in DECKS");
        drawTablePage();
        return;
      }
      tableMessage = String("Imported ") + PRECONS[index].name;
      showTablePage(Screen::Decks);
    }
  } else if (screen == Screen::Decks) {
    if (y >= BAR_Y - 4) {
      if (button == 4) showCard();
      else if (button == 0) {
        if (freeDeckSlot() == tabletop::MAX_DECKS) {
          tableError("All 8 deck slots are in use - DEL one first");
          drawTablePage();
          return;
        }
        rebuildPreconMatches();
        showTablePage(Screen::Precons);
      } else if (deckBook.active) {
        if (button == 1) {
          openKeyboard("DECK NAME", deckBook.decks[deckBook.active - 1].name, tabletop::DECK_NAME_LIMIT, false);
        } else if (button == 2) {
          editingDeckTokens = true;
          clearSearch();
          pickerPage = 0;
          navigate(Screen::Picker);
          drawPicker();
        } else if (button == 3) {
          tablePrompt = TablePrompt::DeleteDeck;
          showTablePage(Screen::Confirm);
        }
      } else {
        tableError("Select or create a named deck");
        drawTablePage();
      }
    } else if (y >= LIST_Y) {
      const uint8_t slot = (y - LIST_Y) / ROW_H;
      if (slot <= tabletop::MAX_DECKS) {
        if (slot && !deckBook.decks[slot - 1].name[0]) {
          tableError("Use NEW to create a deck");
        } else {
          deckBook.active = slot;
          scheduleTableSave();
        }
        drawTablePage();
      }
    }
  } else if (screen == Screen::Match) {
    handleLifeTouch(x, y, hadMessage);
  } else if (screen == Screen::MatchSetup) {
    if (y >= BAR_Y - 4) {
      if (button == 0) openLife();
      if (button == 4) {
        tablePrompt = TablePrompt::NewMatch;
        showTablePage(Screen::Confirm);
      }
    } else {
      if (y >= 54 && y < 90 && (x < 54 || x >= 186)) {
        const int next = setupPlayers + (x < 54 ? -1 : 1);
        if (next < 1 || next > tabletop::MAX_PLAYERS) tableError("Players: 1 to 8");
        else setupPlayers = next;
      } else if (y >= 138 && y < 170) {
        const int next = setupLife + tableDelta(x);
        if (next < 1 || next > tabletop::LIFE_LIMIT) tableError("Initial life: 1 to 9999");
        else setupLife = next;
      } else if (y >= 188 && y < 224) {
        static const int16_t PRESETS[4] = {20, 25, 30, 40};
        setupLife = PRESETS[min(x / 60, 3)];
      }
      drawTablePage();
    }
  } else if (screen == Screen::Dice) {
    if (y >= BAR_Y - 4) {
      if (button == 0) {
        if (diceReturn == Screen::Match) openLife();
        else showTablePage(Screen::Home);
      } else if (button == 2) {
        rollDice();
      }
    } else if (y >= DICE_AREA_Y - 24) {
      rollDice();
    } else if (y >= 28 && y < 108) {
      const uint8_t index = ((y - 28) / 40) * 4 + x / 60;
      if (index < sizeof(tabletop::DIE_SIDES)) {
        dieIndex = index;
        drawTablePage();
      }
    } else if (y >= 112 && y < 144 && (x < 54 || x >= 186)) {
      const int next = diceCount + (x < 54 ? -1 : 1);
      if (next < 1 || next > tabletop::MAX_DICE) tableError("Roll count: 1 to 20");
      else diceCount = next;
      drawTablePage();
    }
  } else if (screen == Screen::Confirm && y >= BAR_Y - 4) {
    if (button == 0) showTablePage(tablePrompt == TablePrompt::DeleteDeck ? Screen::Decks : Screen::MatchSetup);
    else if (button == 4) {
      if (tablePrompt == TablePrompt::DeleteDeck) {
        deckBook.decks[deckBook.active - 1] = tabletop::Deck{};
        deckBook.active = 0;
        scheduleTableSave();
        showTablePage(Screen::Decks);
      } else {
        match.reset(setupPlayers, setupLife);
        for (uint8_t player = 0; player < tabletop::MAX_PLAYERS; ++player) {
          lifeDelta[player] = 0;
          damageSlot[player] = 0;
        }
        scheduleTableSave();
        openLife();
      }
    }
  }
}

void pressKey(char value) {
  size_t length = strlen(editBuffer);
  switch (value) {
    case KEY_SHIFT:
      keyShift = !keyShift;
      drawKeyboard();
      return;
    case KEY_LAYER:
      keyLayer ^= 1;
      drawKeyboard();
      return;
    case KEY_DEL:
      if (length > 0) editBuffer[length - 1] = '\0';
      break;
    case KEY_RET:
      if (!editMultiline) {
        closeKeyboard(true);
        return;
      }
      [[fallthrough]];
    default:
      if (length >= editLimit) return;
      editBuffer[length] = keyShift ? toupper(value) : value;
      editBuffer[length + 1] = '\0';
      if (keyShift) {
        keyShift = false;
        drawKeyboard();
      }
  }
  drawEditBuffer();
}

// Shows "12/76" over the art for a moment; updateIdleState takes it away again. Called on every
// token change, so a quantity flash from the previous token does not carry over.
void showPosition() {
  positionVisible = true;
  positionShownAt = millis();
  countFlash = false;
}

void selectToken(int step) {
  selectedToken = deckBook.next(selectedToken, step, TOKEN_COUNT);
  validateMode();
  showPosition();
  drawScreen();
  scheduleSave();
}

void flashQuantity() {
  countFlash = true;
  countShownAt = millis();
}

void cycleMode() {
  do {
    mode = static_cast<Mode>((static_cast<uint8_t>(mode) + 1) % MODE_COUNT);
  } while (!modeAvailable(mode));
  if (mode == Mode::Quantity) flashQuantity();
  drawCardValues();
  drawControls();
}

// Tapping the art taps every untapped token, or untaps all if none are left untapped.
void toggleAllTapped() {
  TokenState &state = states[selectedToken];
  if (state.count == 0) return;
  state.tapped = state.tapped < state.count ? state.count : 0;
  drawArt();
  scheduleSave();
}

void adjust(int delta) {
  TokenState &state = states[selectedToken];
  if (mode == Mode::Quantity) {
    flashQuantity();
    if (delta > 0) {
      if (state.count >= 999) {
        drawArt();
        return;
      }
      state.count++;
      if (quantityTapped) state.tapped++;
    } else if (delta < 0) {
      if (quantityTapped) {
        if (!state.tapped) {
          drawArt();
          return;
        }
        state.tapped--;
      } else if (state.count <= state.tapped) {
        drawArt();
        return;
      }
      state.count--;
    } else {
      return;
    }
    drawCardValues();
    scheduleSave();
    return;
  }
  int16_t *value = &state.count;
  int minimum = -99;
  int maximum = 99;
  switch (mode) {
    case Mode::Quantity:
      minimum = 0;
      maximum = 999;
      break;
    case Mode::Tapped:
      value = &state.tapped;
      minimum = 0;
      maximum = state.count;
      break;
    case Mode::Power:
      value = &state.powerMod;
      break;
    case Mode::Toughness:
      value = &state.toughnessMod;
      break;
  }
  int next = *value + delta;
  if (next < minimum || next > maximum) return;
  *value = next;
  if (mode == Mode::Quantity) {
    countFlash = true;
    countShownAt = millis();
  }
  drawCardValues();
  scheduleSave();
}

bool quantityGroupHit(int x, int y, bool tapped) {
  const int iconW = tapped ? 16 : 11;
  const int iconH = tapped ? 11 : 16;
  const int groupX = tapped ? G.groupRightX : G.groupLeftX;
  const int left = groupX - 5;
  const int right = groupX + iconW + 26;
  return x >= left && x <= right && abs(y - G.groupY) <= iconH / 2 + 6;
}

enum class Hit : uint8_t { None, Prev, Menu, Search, Next, Minus, Plus, Mode };

// The control under (x, y) in the full-screen layouts. Touch areas reach a little past each button.
Hit overlayHit(int x, int y) {
  if (x < G.artX || x >= G.artX + G.artW || y < G.artY || y >= G.artY + G.artH) return Hit::None;
  if (y < G.artY + 2 * OV_MARGIN + OV_BUTTON_H + 2) {
    static const Hit SLOT_HITS[4] = {Hit::Prev, Hit::Menu, Hit::Search, Hit::Next};
    for (int slot = 0; slot < 4; slot++) {
      if (abs(x - overlaySlotX(G, slot) - OV_BUTTON_W / 2) <= OV_BUTTON_W / 2 + OV_MARGIN) return SLOT_HITS[slot];
    }
    return Hit::None;
  }
  const int reach = OV_BIG_R + 8;
  if (abs(y - G.countY) <= reach) {
    if (abs(x - (G.artX + OV_BIG_INSET)) <= reach) return Hit::Minus;
    if (abs(x - (G.artX + G.artW - OV_BIG_INSET)) <= reach) return Hit::Plus;
  }
  if (abs(x - (G.artX + G.artW / 2)) <= OV_CHIP_W / 2 + 8 && abs(y - G.groupY) <= OV_CHIP_H / 2 + 6) {
    return Hit::Mode;
  }
  return Hit::None;
}

void handleCardTouch(int x, int y) {
  if (fullBleed()) {
    switch (overlayHit(x, y)) {
      case Hit::Prev:
        selectToken(-1);
        return;
      case Hit::Menu:
        showTablePage(Screen::TokenMenu);
        return;
      case Hit::Search:
        startSearch();
        return;
      case Hit::Next:
        selectToken(1);
        return;
      case Hit::Minus:
        adjust(-1);
        return;
      case Hit::Plus:
        adjust(1);
        return;
      case Hit::Mode:
        cycleMode();
        return;
      case Hit::None:
        break;
    }
  } else if (y < 44) {
    // The margins beside the top of the card hold the menu and search icons.
    if (x < 32) {
      showTablePage(Screen::TokenMenu);
      return;
    }
    if (x >= SCREEN_W - 32 && y < 44) {
      startSearch();
      return;
    }
  }

  bool insideCard = x >= G.cardX && x < G.cardX + G.cardW;
  if (insideCard && y >= G.titleY && y < G.titleY + G.titleH) {
    openPicker();
    return;
  }
  if (x >= G.artX && x < G.artX + G.artW && y >= G.artY && y < G.artY + G.artH) {
    if (mode == Mode::Quantity && tapGroupsVisible() && quantityGroupHit(x, y, false)) {
      quantityTapped = false;
      flashQuantity();
      drawCardValues();
      return;
    }
    if (mode == Mode::Quantity && tapGroupsVisible() && quantityGroupHit(x, y, true)) {
      quantityTapped = true;
      flashQuantity();
      drawCardValues();
      return;
    }
    if (config.drawOpen == static_cast<uint8_t>(DrawOpen::Button)) {
      toggleAllTapped();
    } else {
      artHoldPending = true;
      artHoldAt = millis();
    }
    return;
  }
  // The text box opens the counters. The custom token keeps it for its editor, except for the strip
  // at the bottom where the counters show.
  const int countersTop = selectedToken == CUSTOM_INDEX ? badgeRowY() - 2 : G.textY;
  if (insideCard && y >= countersTop && y < G.cardY + G.cardH) {
    openCounters();
    return;
  }
  if (selectedToken == CUSTOM_INDEX && insideCard && y >= G.typeY && y < G.cardY + G.cardH) {
    openEditor();
    return;
  }
  if (fullBleed() || y < BAR_Y - 4) return;
  switch (min(x / BUTTON_STEP, 4)) {
    case 0:
      selectToken(-1);
      break;
    case 1:
      adjust(-1);
      break;
    case 2:
      cycleMode();
      break;
    case 3:
      adjust(1);
      break;
    case 4:
      selectToken(1);
      break;
  }
}

void handlePickerTouch(int x, int y) {
  if (y >= BAR_Y - 4) {
    switch (min(x / BUTTON_STEP, 4)) {
      case 0:
        pickerPage = (pickerPage + pageCount() - 1) % pageCount();
        drawPicker();
        break;
      case 1:
        startSearch();
        break;
      case 2:
        if (editingDeckTokens) {
          editingDeckTokens = false;
          showTablePage(Screen::Decks);
        } else {
          showCard();
        }
        break;
      case 3:
        editingDeckTokens = false;
        showTablePage(Screen::Decks);
        break;
      case 4:
        pickerPage = (pickerPage + 1) % pageCount();
        drawPicker();
        break;
    }
    return;
  }
  if (y < LIST_Y) return;
  int row = (y - LIST_Y) / ROW_H;
  size_t position = pickerPage * ROWS_PER_PAGE + row;
  if (row >= ROWS_PER_PAGE || position >= matchCount) return;
  if (editingDeckTokens) {
    deckBook.decks[deckBook.active - 1].toggle(matches[position]);
    scheduleTableSave();
    awaitRelease = true;
    drawPicker();
    return;
  }
  selectedToken = matches[position];
  showPosition();
  scheduleSave();
  showCard();
}

void setBrightness(int level) {
  level = constrain(level, 1, BRIGHTNESS_LEVELS);
  if (level == config.brightness) return;
  config.brightness = level;
  applyBacklight();
  drawBrightnessPanel();
  scheduleSave();
}

void setTimeout(int index) {
  index = constrain(index, 0, TIMEOUT_COUNT - 1);
  if (index == config.timeout) return;
  config.timeout = index;
  drawTimeoutPanel();
  scheduleSave();
}

void setLayout(int value) {
  value = constrain(value, 0, LAYOUT_COUNT - 1);
  if (value == config.layout) return;
  config.layout = value;
  applyLayout();
  overlaysVisible = true;
  drawLayoutPanel();
  scheduleSave();
}

void setTone(int level) {
  level = constrain(level, 0, TONE_LEVELS - 1);
  if (level == config.tone) return;
  config.tone = level;
  applyTone();
  drawTonePanel();
  scheduleSave();
}

void setFlipped(bool flipped) {
  if (flipped == (config.flipped != 0)) return;
  config.flipped = flipped;
  applyRotation();
  drawSettings();
  // The finger is now over a different control of the turned screen.
  awaitRelease = true;
  scheduleSave();
}

void setGamma(int index) {
  config.gammaMode = (index + GAMMA_COUNT) % GAMMA_COUNT;
  applyGamma();
  drawGammaPanel();
  // One step per tap: holding the button must not cycle through the profiles.
  awaitRelease = true;
  scheduleSave();
}

void setDrawOption(uint8_t &option, int value) {
  if (option == value) return;
  option = value;
  // Saved ink is read again from the new place; unsaved session ink stays.
  if (&option == &config.drawStore) forgetSavedDoodles();
  drawDoodlePanels();
  awaitRelease = true;
  scheduleSave();
}

void handleSettingsTouch(int x, int y) {
  if (y >= BAR_Y - 4) {
    const int pages = cardOptions ? CARD_PAGES : SETTINGS_PAGES;
    switch (min(x / BUTTON_STEP, 4)) {
      case 0:
        settingsPage = (settingsPage + pages - 1) % pages;
        drawSettings();
        break;
      case 2:
        closeSettings();
        break;
      case 4:
        settingsPage = (settingsPage + 1) % pages;
        drawSettings();
        break;
    }
    return;
  }

  auto inPanel = [y](int top, int height) { return y >= top + 14 && y < top + height; };
  const int minusEnd = SET_X + 4 + SET_STEP_W + 4;
  const int plusStart = SET_X + SET_W - 4 - SET_STEP_W - 4;
  switch (settingsKind()) {
    case 0:
      if (inPanel(SET_BRIGHTNESS_Y, SET_PANEL_H)) {
        if (x < minusEnd) {
          setBrightness(config.brightness - 1);
        } else if (x >= plusStart) {
          setBrightness(config.brightness + 1);
        } else {
          setBrightness((x - SET_BAR_X) / SET_BAR_STEP + 1);
        }
      } else if (inPanel(SET_TIMEOUT_Y, SET_PANEL_H)) {
        if (x < minusEnd) setTimeout(config.timeout - 1);
        if (x >= plusStart) setTimeout(config.timeout + 1);
      } else if (inPanel(SET_SCREEN_Y, SET_PANEL_H)) {
        setFlipped(x >= SCREEN_W / 2);
      }
      break;
    case 1:
      if (inPanel(SET_GAMMA_Y, SET_PANEL_H)) {
        if (x < minusEnd) setGamma(config.gammaMode - 1);
        if (x >= plusStart) setGamma(config.gammaMode + 1);
      }
      break;
    case 2:
      if (inPanel(SET_LAYOUT_Y, SET_LAYOUT_H)) setLayout((x - SET_X) / THUMB_STEP);
      break;
    case 3:
      if (inPanel(SET_TONE_Y, SET_TONE_H)) {
        if (x < minusEnd) setTone(config.tone - 1);
        if (x >= plusStart) setTone(config.tone + 1);
      }
      break;
    default:
      if (inPanel(SET_DRAW_AREA_Y, SET_PANEL_H)) {
        setDrawOption(config.drawArea, choiceAt(x, 2));
      } else if (inPanel(SET_DRAW_OPEN_Y, SET_PANEL_H)) {
        setDrawOption(config.drawOpen, choiceAt(x, DRAW_OPTION_COUNT));
      } else if (inPanel(SET_DRAW_STORE_Y, SET_PANEL_H)) {
        setDrawOption(config.drawStore, choiceAt(x, DRAW_OPTION_COUNT));
      }
      break;
  }
}

void stepStat(int8_t &value, int delta) {
  value = constrain(value + delta, -99, 99);
}

bool insideStatButton(int x, int left) {
  return x >= left && x < left + STAT_BUTTON_W;
}

void handleEditorTouch(int x, int y) {
  if (y >= BAR_Y - 4) {
    switch (min(x / BUTTON_STEP, 4)) {
      case 0:
        showCard();
        break;
      case 4:
        if (draft.name[0] == '\0') strlcpy(draft.name, "Custom", sizeof(draft.name));
        custom = draft;
        saveCustom();
        showCard();
        break;
    }
    return;
  }

  auto inRow = [y](int top, int height) { return y >= top && y < top + height; };
  if (inRow(EDIT_NAME_Y, EDIT_ROW_H)) {
    openKeyboard("NAME", draft.name, NAME_LIMIT, false);
  } else if (inRow(EDIT_TYPE_Y, EDIT_ROW_H)) {
    openKeyboard("TYPE LINE", draft.type, TYPE_LIMIT, false);
  } else if (inRow(EDIT_TEXT_Y, EDIT_TEXT_H)) {
    openKeyboard("ORACLE TEXT", draft.text, TEXT_LIMIT, true);
  } else if (inRow(EDIT_COLOR_Y, EDIT_ROW_H)) {
    if (x < COLOR_PICK_X - COLOR_PICK_STEP / 2) return;
    int index = (x - COLOR_PICK_X + COLOR_PICK_STEP / 2) / COLOR_PICK_STEP;
    if (index >= COLOR_COUNT) return;
    draft.color = index;
    drawEditor();
  } else if (inRow(EDIT_PT_Y, EDIT_ROW_H)) {
    if (x < POWER_MINUS_X) {
      draft.hasPT = !draft.hasPT;
    } else if (!draft.hasPT) {
      return;
    } else if (insideStatButton(x, POWER_MINUS_X)) {
      stepStat(draft.power, -1);
    } else if (insideStatButton(x, POWER_PLUS_X)) {
      stepStat(draft.power, 1);
    } else if (insideStatButton(x, TOUGHNESS_MINUS_X)) {
      stepStat(draft.toughness, -1);
    } else if (insideStatButton(x, TOUGHNESS_PLUS_X)) {
      stepStat(draft.toughness, 1);
    } else {
      return;
    }
    drawEditor();
  }
}

void handleKeyboardTouch(int x, int y) {
  if (y >= BAR_Y - 4) {
    int button = min(x / BUTTON_STEP, 4);
    if (button == 0) closeKeyboard(false);
    if (button == 4) closeKeyboard(true);
    return;
  }
  if (y < KEY_Y || y >= KEY_Y + KEY_ROWS * KEY_H) return;
  const Key *row = KEYBOARD[keyLayer][(y - KEY_Y) / KEY_H];
  int right = 0;
  for (int col = 0; col < KEY_COLS && row[col].value; col++) {
    right += row[col].units * KEY_UNIT;
    if (x < right) {
      pressKey(row[col].value);
      return;
    }
  }
}

void handleCountersTouch(int x, int y) {
  if (y >= BAR_Y - 4) {
    const size_t pages = counterPageCount();
    switch (min(x / BUTTON_STEP, 4)) {
      case 0:
        counterPage = (counterPage + pages - 1) % pages;
        drawCounters();
        break;
      case 1:
        if (config.drawOpen != static_cast<uint8_t>(DrawOpen::Hold)) openDrawing();
        break;
      case 2:
        showCard();
        break;
      case 4:
        counterPage = (counterPage + 1) % pages;
        drawCounters();
        break;
    }
    return;
  }
  if (y < LIST_Y || y >= LIST_Y + ROWS_PER_PAGE * ROW_H) return;
  const int row = counterPage * ROWS_PER_PAGE + (y - LIST_Y) / ROW_H;
  if (row >= counterRowCount()) return;
  const int kind = rowKind(row);
  int delta = 0;
  if (x >= COUNTER_MINUS_X - 6 && x < COUNTER_MINUS_X + COUNTER_BUTTON_W + 6) {
    delta = -1;
  } else if (x >= COUNTER_PLUS_X - 6) {
    delta = 1;
  } else if (kind == CUSTOM_KIND && x < COUNTER_LABEL_END) {
    openKeyboard("COUNTER NAME", counterNames[selectedToken], COUNTER_NAME_LIMIT, false);
    return;
  } else {
    return;
  }
  TokenState &state = states[selectedToken];
  if (kind == PLUS_ONE_ROW) {
    if (abs(state.counters + delta) > 99) return;
    state.counters += delta;
  } else if (kind == OUTSIDE_ROW) {
    uint8_t &cards = outsideCards[selectedToken];
    if (cards + delta < 0 || cards + delta > OUTSIDE_MAX) return;
    cards += delta;
    outsideCardsChanged = true;
  } else if (kind == FOOD_ROW) {
    foodTypes[selectedToken] = delta > 0 ? 1 : 0;
    foodTypesChanged = true;
  } else {
    if (state.kinds[kind] + delta < 0 || state.kinds[kind] + delta > KIND_MAX) return;
    state.kinds[kind] += delta;
  }
  drawCounterRow(row);
  scheduleSave();
}

void handleDrawingTouch(int x, int y) {
  if (y >= BAR_Y - 4) {
    if (doodleDown) {
      doodleDown = false;
      awaitRelease = true;
      return;
    }
    awaitRelease = true;
    const int button = min(x / BUTTON_STEP, 4);
    if (doodlePalette) {
      doodlePalette = false;
      if (button == 1) {
        drawScreen();
        return;
      }
    }
    switch (button) {
      case 0:
        showCard();
        break;
      case 1:
        doodlePalette = true;
        drawDoodlePalette();
        break;
      case 2: {
        Doodle &drawing = doodles[selectedToken];
        if (drawing.count) {
          do { drawing.count--; } while (drawing.count && !(drawing.points[drawing.count].style & DOODLE_START));
          drawing.changed = true;
        }
        drawScreen();
        break;
      }
      case 3:
        openDrawingTools(DoodlePrompt::Clear);
        break;
      case 4:
        requestDoodleSave();
        break;
    }
    return;
  }
  if (doodlePalette) {
    awaitRelease = true;
    doodlePalette = false;
    if (x >= PALETTE_X && x < PALETTE_X + PALETTE_W && y >= PALETTE_Y && y < PALETTE_Y + PALETTE_H) {
      if (y < PALETTE_SPLIT_Y) {
        doodleColor = min((x - PALETTE_X) / PALETTE_COLOR_W, 7);
        doodleEraser = false;
      } else {
        const int item = min((x - PALETTE_X) / PALETTE_BRUSH_W, 3);
        doodleEraser = item == 3;
        if (!doodleEraser) doodleBrush = item;
      }
    }
    drawScreen();
    return;
  }
  const bool artOnly = drawArtOnly();
  const int left = artOnly ? G.artX : G.cardX, top = artOnly ? G.artY : G.cardY;
  const int width = artOnly ? G.artW : G.cardW, height = artOnly ? G.artH : G.cardH;
  if (x < left || x >= left + width || y < top || y >= top + height) {
    doodleDown = false;
    awaitRelease = true;
    return;
  }
  Doodle &drawing = doodles[selectedToken];
  if (!drawing.loaded || drawing.failed) {
    doodleError("Clear unreadable drawing first");
    openDrawingTools();
    return;
  }
  if (doodleEraser) {
    if (eraseStrokeAt(x, y)) drawScreen();
    return;
  }
  const DoodlePoint point{static_cast<uint8_t>(doodleX(x, false)),
                          static_cast<uint8_t>(doodleColor | (doodleBrush << 3) | (doodleDown ? 0 : DOODLE_START)),
                          static_cast<uint16_t>(doodleY(y, false))};
  if (doodleDown && drawing.count) {
    const DoodlePoint &previous = drawing.points[drawing.count - 1];
    if (abs(static_cast<int>(point.x) - previous.x) + abs(static_cast<int>(point.y) - previous.y) < 2) return;
  }
  if (drawing.count == DOODLE_MAX_POINTS) {
    doodleError("Drawing full: Undo or Clear");
    openDrawingTools();
    return;
  }
  if (drawing.count == drawing.capacity &&
      !reserveDoodle(drawing, min(DOODLE_MAX_POINTS, static_cast<uint16_t>(max(64, drawing.capacity * 2))))) {
    openDrawingTools();
    return;
  }
  const DoodlePoint &previous = doodleDown && drawing.count ? drawing.points[drawing.count - 1] : point;
  display.setViewport(left, top, width, height, false);
  drawDoodleSegment(display, previous, point);
  display.resetViewport();
  drawing.points[drawing.count++] = point;
  drawing.changed = true;
  doodleDown = true;
}

void handleDrawingToolsTouch(int x, int y) {
  if (y >= BAR_Y - 4) {
    const int button = min(x / BUTTON_STEP, 4);
    if (doodlePrompt != DoodlePrompt::None) {
      if (button == 0) {
        doodlePrompt = DoodlePrompt::None;
        awaitRelease = true;
        drawDrawingTools();
      } else if (button == 4) {
        if (doodlePrompt == DoodlePrompt::Clear) {
          Doodle &drawing = doodles[selectedToken];
          doodleCapacity -= drawing.capacity;
          free(drawing.points);
          const bool saved = drawing.saved;
          drawing = Doodle{};
          drawing.loaded = true;
          drawing.changed = true;
          drawing.saved = saved;
          doodleMessage = "Cleared for this session";
        } else {
          LittleFS.end();
          doodleStorageReady = LittleFS.format() && LittleFS.begin(false, "/littlefs", 3, "spiffs");
          if (!doodleStorageReady) {
            doodleError("Could not initialize storage");
          } else {
            for (Doodle &drawing : doodles) {
              drawing.saved = false;
              if (drawing.count) drawing.changed = true;
            }
            saveDoodle();
          }
        }
        doodlePrompt = DoodlePrompt::None;
        awaitRelease = true;
        drawDrawingTools();
      }
      return;
    }
    if (button == 0) {
      navigate(Screen::Drawing);
      drawScreen();
    } else if (button == 4) {
      requestDoodleSave();
    }
    return;
  }
  if (doodlePrompt != DoodlePrompt::None) return;
  if (y >= 48 && y < 136) {
    doodleColor = min(x / 60, 3) + (y >= 92 ? 4 : 0);
    doodleEraser = false;
  } else if (y >= 163 && y < 199) {
    const int item = min(x / 60, 3);
    doodleEraser = item == 3;
    if (!doodleEraser) doodleBrush = item;
  } else {
    return;
  }
  awaitRelease = true;
  drawDrawingTools();
}

int clampCoordinate(long value, int maximum) {
  if (value < 0) return 0;
  if (value >= maximum) return maximum - 1;
  return static_cast<int>(value);
}

#ifdef CYD_SERIAL_SHOTS
// Debug build only (env:shots): tools/screenshot.py fakes taps and reads the screen over serial.
struct InjectedTouch {
  bool active = false;
  int x = 0;
  int y = 0;
  uint32_t until = 0;
};
InjectedTouch injected;

void dumpScreen() {
  const int w = display.width();
  const int h = display.height();
  // This panel's readback arrives one byte late, so every row is sent with one pixel of the next
  // row and the script realigns the colors.
  static uint16_t rows[SCREEN_H * 2];
  Serial.printf("\nSHOT %d %d\n", w, h);
  for (int y = 0; y < h; ++y) {
    display.readRect(0, y, w, y + 1 < h ? 2 : 1, rows);
    if (y + 1 == h) rows[w] = rows[w - 1];
    Serial.write(reinterpret_cast<const uint8_t *>(rows), (w + 1) * 2);
  }
  Serial.println("\nEND");
}

void handleSerialCommands() {
  static String line;
  while (Serial.available()) {
    const char c = static_cast<char>(Serial.read());
    if (c == '\r') continue;
    if (c != '\n') {
      if (line.length() < 40) line += c;
      continue;
    }
    int x = 0, y = 0, ms = 80;
    if (line == "S") {
      dumpScreen();
    } else if (sscanf(line.c_str(), "T %d %d %d", &x, &y, &ms) >= 2) {
      // Captures are minutes apart: wake the screen so the tap is not spent waking it.
      lastActivityAt = millis();
      if (!screenOn) {
        screenOn = true;
        applyBacklight();
      }
      injected = {true, x, y, millis() + static_cast<uint32_t>(ms)};
      Serial.println("OK");
    }
    line = "";
  }
}
#endif

bool touchDown() {
#ifdef CYD_SERIAL_SHOTS
  if (injected.active) {
    if (static_cast<int32_t>(millis() - injected.until) < 0) return true;
    injected.active = false;
  }
#endif
  return touch.touched();
}

void handleTouch() {
  if (!touchDown()) {
    if (fingerDown) {
      fingerDown = false;
      ++touchReleases;
    }
    awaitRelease = false;
    doodleDown = false;
    if (artHoldPending) {
      // Let go before the hold opened drawing mode: an ordinary tap on the art.
      artHoldPending = false;
      if (screen == Screen::Card) toggleAllTapped();
    }
    return;
  }
  const uint32_t now = millis();
  lastActivityAt = now;
  fingerDown = true;
  if (artHoldPending) {
    if (now - artHoldAt >= DRAW_HOLD_MS) {
      artHoldPending = false;
      openDrawing();
    }
    return;
  }
  if (!screenOn) {
    // The touch that wakes the screen does nothing else, except bring back hidden controls.
    if (screen == Screen::Card && !controlsVisible()) {
      overlaysVisible = true;
      drawArt();
    }
    screenOn = true;
    applyBacklight();
    awaitRelease = true;
    lastTouchAt = now;
    return;
  }
  if (awaitRelease || now - lastTouchAt < (screen == Screen::Drawing ? 20u : TOUCH_REPEAT_MS)) return;

  TS_Point point = touch.getPoint();
  // Touch calibration is in landscape (rotation 1); convert to the portrait display.
  int landscapeX = clampCoordinate(map(point.x, TOUCH_X_MIN, TOUCH_X_MAX, 0, SCREEN_H - 1), SCREEN_H);
  int landscapeY = clampCoordinate(map(point.y, TOUCH_Y_MIN, TOUCH_Y_MAX, 0, SCREEN_W - 1), SCREEN_W);
  int x = SCREEN_W - 1 - landscapeY;
  int y = landscapeX;
  // The touch panel does not turn with the display.
  if (config.flipped) {
    x = SCREEN_W - 1 - x;
    y = SCREEN_H - 1 - y;
  }
#ifdef CYD_SERIAL_SHOTS
  if (injected.active) {
    x = injected.x;
    y = injected.y;
  }
#endif
  lastTouchAt = now;
  if (screen != Screen::Drawing)
    Serial.printf("touch raw=%d,%d z=%d -> %d,%d\n", point.x, point.y, point.z, x, y);

  if (screen == Screen::Card && !controlsVisible()) {
    // The first tap on a bare card only brings the controls back.
    overlaysVisible = true;
    awaitRelease = true;
    drawArt();
    return;
  }

  switch (screen) {
    case Screen::Card:
      handleCardTouch(x, y);
      break;
    case Screen::Picker:
      handlePickerTouch(x, y);
      break;
    case Screen::Editor:
      handleEditorTouch(x, y);
      break;
    case Screen::Keyboard:
      handleKeyboardTouch(x, y);
      break;
    case Screen::Settings:
      handleSettingsTouch(x, y);
      break;
    case Screen::Counters:
      handleCountersTouch(x, y);
      break;
    case Screen::Drawing:
      handleDrawingTouch(x, y);
      break;
    case Screen::DrawingTools:
      handleDrawingToolsTouch(x, y);
      break;
    default:
      handleTableTouch(x, y);
      break;
  }
}

// Turns the screen off after the chosen idle time, tucks the card-only controls away and takes the
// token position and a brief 0/1 quantity off the art.
void updateIdleState() {
  const uint32_t now = millis();
  const uint32_t idle = now - lastActivityAt;
  const uint32_t timeout = TIMEOUT_SECONDS[config.timeout] * 1000UL;
  if (screenOn && timeout != 0 && idle > timeout) {
    screenOn = false;
    applyBacklight();
  }
  bool redraw = false;
  if (positionVisible && now - positionShownAt > POSITION_SHOW_MS) {
    positionVisible = false;
    redraw = true;
  }
  if (countFlash && now - countShownAt > COUNT_SHOW_MS) {
    countFlash = false;
    redraw = states[selectedToken].count <= 1 || redraw;
  }
  if (screenOn && screen == Screen::Card && layout() == Layout::CardOnly && overlaysVisible &&
      idle > OVERLAY_HIDE_MS) {
    overlaysVisible = false;
    redraw = true;
  }
  // Drawing with the backlight off is fine: the card is up to date when it comes back on.
  if (redraw && screen == Screen::Card) drawArt();
}

}  // namespace

void setup() {
  Serial.begin(115200);
  // Start dark: the backlight comes up once the first screen is drawn, at the saved brightness.
  ledcAttach(BACKLIGHT_PIN, BACKLIGHT_FREQ_HZ, BACKLIGHT_BITS);
  ledcWrite(BACKLIGHT_PIN, 0);
  loadState();
  loadTableState();
  applyLayout();
  applyTone();
  clearSearch();
  display.init();
  applyRotation();
  applyGamma();
  touchSpi.begin(TOUCH_SCLK_PIN, TOUCH_MISO_PIN, TOUCH_MOSI_PIN, TOUCH_CS_PIN);
  touch.begin(touchSpi);
  touch.setRotation(1);
  initSdArt();
  doodleStorageReady = LittleFS.begin(false, "/littlefs", 3, "spiffs");
  if (!doodleStorageReady) Serial.println("drawing storage not mounted; SAVE can initialize it with confirmation");
  showPosition();
  showTablePage(Screen::Home);
  lastActivityAt = millis();
  applyBacklight();
  Serial.printf("CYD tokens ready, %u tokens in catalog, display gamma: %s\n", static_cast<unsigned>(TOKEN_COUNT),
                GAMMA_PROFILES[config.gammaMode].label);
}

void loop() {
#ifdef CYD_SERIAL_SHOTS
  handleSerialCommands();
#endif
  handleTouch();
  updateIdleState();
  tableTick();
  // Batch writes to spare the flash while tapping +/- repeatedly.
  if (saveScheduled && millis() - lastChangeAt > SAVE_DELAY_MS) saveState();
  if (tableSaveScheduled && millis() - tableChangedAt > SAVE_DELAY_MS) {
    saveTableState();
    // Only a failed save has something new to show.
    if (screen >= Screen::Home && tableMessage.length()) drawTablePage();
  }
}